## google-modules/power/mitigation/Documentation/devicetree/bindings/power/mitigation/max77759_bcl_irq.yaml
```yaml
# SPDX-License-Identifier: (GPL-2.0-only OR BSD-2-Clause)
# Copyright 2025 Google LLC
%YAML 1.2
---

$schema: http://devicetree.org/meta-schemas/core.yaml#

title: MAX77759 BCL IRQ driver

maintainers:
  - Sam Ou <samou@google.com>
  - Hiroshi Akiyama <hiroshiakiyama@google.com>
  - Allen Jiang <alljiang@google.com>
  - Jasmine Cha <chajasmine@google.com>
  - Maggie Cheng <maggiecheng@google.com>

compatible: "max77759-bcl-irq"

description: |
  MAX77759 BCL IRQ driver

  Main hardware driver for max77759 BCL.

properties:
  # A dictionary of DT properties for this binding schema
  compatible:
    const: "max77759-bcl-irq"

  gpios:
    $ref: /schemas/types.yaml#/definitions/gpio-cells
    dscription:
      List of gpio lines used for BCL interrupt

  "#address-cells":
    const: 1
  "#size-cells":
    const: 0

  ifpmic:
    description: Phandle to MAX77759 charger device node.
    $ref: /schemas/types.yaml#/definitions/phandle

  max77759-bcl-interrupts:
    type: object
    description: Container node for MAX77759 BCL interrupt definitions.
                 Each node represents a interrupt line

    properties:
      "#address-cells":
        const: 1
      "#size-cells":
        const: 0

      patternProperties:
        "^interrupt@[0-9a-f]+$": # Matches IRQ node names
          type: object
          description: BCL IRQ definition

          properties:
            reg:
              description: Address of interrupt.
              $ref: /schemas/types.yaml#/definitions/uint32
              minimum: 0

            label:
              description: Human-readable label for interrupt line.
              $ref: /schemas/types.yaml#/definitions/string

            interrupts-extended:
              description: Phandle to interrupt controller and cells.
              minItems: 1
              maxItems: 1

            interrupt-parent:
              description: Phandle to parent interrupt controller.
              $ref: /schemas/types.yaml#/definitions/phandle

            gpio:
              description: GPIO for triggering IRQ source
              $ref: /schemas/types.yaml#/definitions/gpio-cells
              minItems: 1
              maxItems: 1

            interrupt-name:
              description: Name or interrupt line
              $ref: /schemas/types.yaml#/definition/string

            irq-handler:
              description: Specifies interrupt handler type that IRQ dispatches
              type: string
              enum: [ "vdroop", "irqb" ]

            irq-class:
              description: Optional specific class or interrupt.
              type: string
              const: "intb"

          required:
            - reg
            - label
            - interrupts-extended
            - interrupt-name
            - irq-handler

          additionalProperties: false

    required:
      - "#address-cells"
      - "#size-cells"

    additionalProperties: false

required:
  - compatible
  - max77759-bcl-interrupts

additionalProperties: false
```

## google-modules/power/mitigation/Kconfig
```kconfig
# SPDX-License-Identifier: GPL-2.0

config GOOGLE_BCL
	tristate "Google Battery current limiter"
	depends on SOC_GS101 || SOC_GS201 || SOC_ZUMA || SOC_LGA || SOC_RDO || SOC_MBU
	# GOOGLE_MODEMCTL is an optional dependency.
	depends on GOOGLE_MODEMCTL || !GOOGLE_MODEMCTL
	help
	  This enables the monitoring and reporting of different types of system
	  throttling as a result of battery current limiter.

config GOOGLE_BCL_MAX77779
	bool "Google BCL IF-PMIC MAX77779"
	depends on GOOGLE_BCL
	help
	  This enables BCL support of the MAX77779. This allows the kernel to monitor
	  and configure the IF-PMIC hazard detection. Select this configuration if
	  this device uses the MAX77779.

config GOOGLE_BCL_MAX77759
	bool "Google BCL IF-PMIC MAX77759"
	depends on GOOGLE_BCL
	help
	  This enables BCL support of the MAX77759. This allows the kernel to monitor
	  and configure the IF-PMIC hazard detection. Select this configuration if
	  this device uses the MAX77759.
```

## google-modules/power/mitigation/test/Kconfig
```kconfig
# SPDX-License-Identifier: GPL-2.0-only
#
config GOOGLE_DA918X_BCL_KUNIT_TEST
	tristate "Google LLC DA918x BCL tests" if !KUNIT_ALL_TESTS
	depends on KUNIT
	default KUNIT_ALL_TESTS
	help
		This enables the test suite that will test DA918x BCL functionality. This suite
		tests functionality such as calculating register values and reading register values.

config GOOGLE_MAX77779_BCL_IRQ_KUNIT_TEST
	tristate "Google LLC max77779 BCL IRQ tests" if !KUNIT_ALL_TESTS
	depends on KUNIT
	default KUNIT_ALL_TESTS
	help
		This enables the KUnit test suite for the max77779 BCL IRQ handler. This suite
		tests various aspects of the max77779_bcl_irq functionality, including the
		Interrupt Service Routine (ISR) behavior under different conditions and the
		correct functioning of the associated API calls. Enabling this will build and run
		tests for the max77779 BCL IRQ driver.

config GOOGLE_MAX77759_BCL_IRQ_KUNIT_TEST
	tristate "Google LLC max77759 BCL IRQ tests" if !KUNIT_ALL_TESTS
	depends on KUNIT
	default KUNIT_ALL_TESTS
	help
		This enables the KUnit test suite for the max77759 BCL IRQ handler. This suite
		tests various aspects of the max77759_bcl_irq functionality, including the
		Interrupt Service Routine (ISR) behavior under different conditions and the
		correct functioning of the associated API calls. Enabling this will build and run
		tests for the max77759 BCL IRQ driver.
```
