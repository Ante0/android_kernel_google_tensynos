## google-modules/noa/common/md/mediatek/Kconfig
```kconfig
# SPDX-License-Identifier: GPL-2.0-only
#
# Mediatek modem features for NOA driver
#

menuconfig NOA_MD_MTK_FEATURES
	bool "NOA Mediatek modem features support"
	depends on NOA_MD_MEDIATEK_COMMON_SUPPORT
	default y
	help
	  Enables the submenu for all platform-specific features related to
	  MediaTek modems. This includes options for specific chipsets
	  (like T900), data path optimizations, and related debugging
	  interfaces.

if NOA_MD_MTK_FEATURES

config NOA_MD_MEDIATEK_T900_SUPPORT
	bool "NOA Mediatek T900 Modem Driver"
	depends on NOA_MD_MEDIATEK_SUPPORT
	default n
	help
	  NOA Modem driver support for Mediatek T900 platform.

config NOA_MD_MEDIATEK_T900_UNIFIED_DESC
	bool "NOA Mediatek T900 unified descriptor"
	depends on NOA_MD_MEDIATEK_T900_SUPPORT
	default y
	help
	  Unified descriptor for Mediatek T900 platform.

config DATA_CPU_LOADING_OPTIMIZE
	bool "Data CPU loading optimize"
	depends on MTK_DATA_CPU_LOADING_OPTIMIZE
	default y
	help
	  Data CPU loading optimize for Mediatek fullsoc support

config NOA_MD_MEDIATEK_T900_TCP_SLOW_START
	bool "NOA Mediatek T900 TCP slow start"
	depends on NOA_MD_MEDIATEK_T900_SUPPORT
	default y
	help
	  TCP slow start for Mediatek T900 platform.

config NOA_MD_MEDIATEK_DEBUG_FS
	bool "NOA Mediatek debug fs"
	depends on NOA_MD_MEDIATEK_SUPPORT || NOA_MD_MEDIATEK_FULLSOC_SUPPORT
	depends on DEBUG_FS
	default y
	help
	  Debug FS for Mediatek platform.

config NOA_MD_MEDIATEK_T900_DEBUG_FS
	bool "NOA Mediatek T900 Debug fs"
	depends on NOA_MD_MEDIATEK_SUPPORT || NOA_MD_MEDIATEK_FULLSOC_SUPPORT
	depends on NOA_MD_MEDIATEK_T900_SUPPORT
	depends on DEBUG_FS
	default y
	help
	  Debug FS for Mediatek T900 platform.

endif
```

## google-modules/noa/common/md/mediatek/debugfs/Kconfig
```kconfig
# SPDX-License-Identifier: GPL-2.0-only
#
# Debug features for NOA modem driver
#

menuconfig NOA_MD_DEBUG_SUPPORT
	bool "NOA Mediatek modem debug support"
	depends on NOA_MD_MEDIATEK_SUPPORT
	depends on NOA_MD_MEDIATEK_DEBUG_FS
	depends on NOA_MD_MEDIATEK_T900_SUPPORT
	depends on DEBUG_FS
	default n
	help
	  Enables debugfs support for the MediaTek modem, creating files in
	  /sys/kernel/debug/noa_md/ for inspecting internal states and
	  triggering tests.

	  This adds overhead and should be disabled in production builds.

if NOA_MD_DEBUG_SUPPORT

config NOA_MD_DEBUG_DISABLE_DPMAIF_SW_INIT
	bool "Disable DPMAIF SW_INIT for debugging"
	default n
	help
	  This option stops the DPMAIF software setup process.
	  It is only for special, low-level hardware tests.

config NOA_MD_DEBUG_ENABLE_NOA_PATH
	bool "Enable NOA path for debugging"
	default n
	help
	  This option turns on the NOA data path completely.
	  This is useful for testing the control path by itself.

config NOA_MD_DEBUG_DISABLE_DYNAMIC_SWITCH
	bool "Disable dynamic data path switching by default"
	default n
	help
	  This option disables the dynamic data path switching event handling by
	  default upon driver load. When disabled dynamic switch, the data path
	  defaults to the NOA (offload) path, and the corresponding PCIe MSI
	  controls for the AP will be turned off.

	  It can still be re-enabled at runtime via the
	  /sys/kernel/debug/noa_md/control/dynamic_switch_disabled interface
	  This is useful for debugging scenarios where you want to prevent path
	  switches from occurring until manually re-enabled.

endif
```

## google-modules/perf/Kconfig
```kconfig
# SPDX-License-Identifier: GPL-2.0-only

config PIXEL_CME
	bool "Support Compute Matrix Engine (CME) block"
	help
	  Select Y if the SOC support CME block to run
	  Scalable Matrix Extension (SME) and Streaming
	  Scalable Vector Extension (SSVE) instructions.
	  Those instructions accelerate matrix operations.


source "$(KCONFIG_EXT_MODULES_PREFIX)private/google-modules/perf/core/Kconfig"

source "$(KCONFIG_EXT_MODULES_PREFIX)private/google-modules/perf/thermal/Kconfig"

source "$(KCONFIG_EXT_MODULES_PREFIX)private/google-modules/perf/memory/Kconfig"
```

## google-modules/perf/core/Kconfig
```kconfig
# SPDX-License-Identifier: GPL-2.0-only
#
# core modules configuration
#

source "$(KCONFIG_EXT_MODULES_PREFIX)private/google-modules/perf/core/gs_perf_mon/Kconfig"
source "$(KCONFIG_EXT_MODULES_PREFIX)private/google-modules/perf/core/gs_domain_idle/Kconfig"
source "$(KCONFIG_EXT_MODULES_PREFIX)private/google-modules/perf/core/irm_devfreq/Kconfig"
```

## google-modules/perf/core/gs_domain_idle/test/Kconfig
```kconfig
#
# SPDX-License-Identifier: GPL-2.0-only
#

config GS_DOMAIN_IDLE_KUNIT_TEST
	tristate "KUnit test for gs_domain_idle" if !KUNIT_ALL_TESTS
	depends on GS_DOMAIN_IDLE && KUNIT
	default KUNIT_ALL_TESTS
	help
	  This builds unit tests for the gs_domain_idle driver.

	  For more information on KUnit and unit tests in general,
	  please refer to the KUnit documentation in Documentation/dev-tools/kunit/.

	  If unsure, say N.
```

## google-modules/perf/core/gs_perf_domain/Kconfig
```kconfig
# SPDX-License-Identifier: GPL-2.0-only
#
# Configurations for Google Perf Domain Driver
#

config GS_PERF_DOMAIN
	tristate "Perf Domain"
	default n
	help
	  Enable support for google sources perf domain driver.
	  This driver obtains performance domain information
	  from the cpm, and allows control of device frequencies
	  based on devfreq framework.
```

## google-modules/perf/thermal/Kconfig
```kconfig
# SPDX-License-Identifier: GPL-2.0-only
#
# thermal modules configuration

config GOOGLE_THERMAL_SENSOR
	tristate "Google LLC thermal sensor driver"
	depends on THERMAL && GOOGLE_THERMAL && PIXEL_METRICS
	help
	  This driver configures and enables the NTC thermistors. The
	  configuration includes enabling the NTC channel, configuring the
	  polling rate and setting the thresholds for software monitoring
	  and hardware protection.

config GOOGLE_THERMAL_CPM_MBOX
	tristate "Google LLC thermal cpm mailbox driver"
	help
	  This driver provide mailbox interface for different thermal
	  functionalities. It provide send message and send request to
	  CPM, and it also provide RX callback when CPM send a message
	  to thermal service.

config GOOGLE_POWERCAP
	tristate "Google LLc powercap framework"
	depends on POWERCAP && OF
	help
	  This driver provides the infrastructure for building the powertree
	  for pixel devices. The tree nodes can be real power consuming devices
	  like CPU, GPU, etc. and virtual nodes, which will manage the power
	  between the child nodes. Enable this framework for thermal monitoring
	  in userspace to provide a power budget for the powertree to control
	  thermal.

config GOOGLE_THERMAL_UCLAMP
	tristate "Google LLC thermal sensor driver"
	depends on THERMAL && PIXEL_EM && OF
	depends on VH_SCHED || !VH_SCHED
	help
	  This module will register cooling device to place thermal auto uclamp max
	  for each cluster. There will be one cooling device per cluster and thermal
	  governors can use these cooling device to mitigate CPU to selectively allow
	  ADPF tasks to use the max CPU capacity.

config GOOGLE_THERMAL_SENSOR_STATS
	tristate "Google LLC thermal sensor stats driver"
	depends on GOOGLE_THERMAL_CPM_MBOX && PIXEL_METRICS
	help
	  This driver registers CPM HW thermal zone to the Pixel metrics
	  framework. It also provides callback functions to access CPM shared
	  memory for data and configuration of thermal stats, including
	  temperature residency and daily max/min temperature.

config GOOGLE_THERMAL_PRESSURE_TJ
	tristate "Google LLC tj thermal pressure driver"
	depends on GOOGLE_THERMAL_CPM_MBOX && GOOGLE_CPU_FREQ
	help
	  This driver reads tj thermal pressure from shared memory and applies
	  thermal pressure to scheduler using exported API from cpufreq. Thermal
	  pressure indicates the frequency capping applied by tj loops to control
	  junction temperature. Such frequency capping would result in change in
	  CPU capacity. Applying thermal pressure lets the scheduler be aware of
	  change in CPU capacity.
```

## google-modules/perf/thermal/test/Kconfig
```kconfig
# SPDX-License-Identifier: GPL-2.0-only
#
# thermal test configuration
config DEVFREQ_TJ_CDEV_HELPER_KUNIT_TEST
	tristate "Google LLC devfreq tj cdev heper tests" if !KUNIT_ALL_TESTS
	depends on KUNIT
	default KUNIT_ALL_TESTS
	help
		This enables the test suite that will test all the helper functions
		used by devfreq tj cooling device(cdev) driver. This tests the probe
		function, cooling device registration, driver exit cleanup and the
		callback to place the frequency QOS requests.

config GOOGLE_THERMAL_HELPER_KUNIT_TEST
	tristate "Google LLC thermal helper tests" if !KUNIT_ALL_TESTS
	depends on KUNIT
	default KUNIT_ALL_TESTS
	help
		This enables the test suite that will test all the
		helper functions used by thermal. All the different thermal helper
		test suites are enabled by this config.

config GOOGLE_THERMAL_CPM_MBOX_KUNIT_TEST
	tristate "Google LLC thermal cpm mbox tests" if !KUNIT_ALL_TESTS
	depends on KUNIT
	default KUNIT_ALL_TESTS
	help
		This enables the test suite that will test thermal
		cpm mbox used by thermal. All the thermal cpm mbox related
		test are enable by this config, including test the interface
		for sending message/request to CPM, and the rx callback flow
		when CPM send a request to Linux.

config GOOGLE_THERMAL_STATS_KUNIT_TEST
	tristate "Google LLC thermal stats tests" if !KUNIT_ALL_TESTS
	depends on KUNIT
	default KUNIT_ALL_TESTS
	help
		This enables the test suite that will test all the helper functions
		used by thermal sensor stats driver. This tests the device tree parse
		function, shared memory access, cpm mbox IPCs, as well as thermal
		metrics registration and callback functions.

config CDEV_HELPER_KUNIT_TEST
	tristate "Google LLC cdev helper tests" if !KUNIT_ALL_TESTS
	depends on KUNIT
	default KUNIT_ALL_TESTS
	help
		This enables the test suite for the devfreq and cpufreq helper modules.
		This tests all the functions that will be used by the powercap, devfreq
		Tj cdev and cpu thermal pressure drivers.

config GOOGLE_POWERCAP_KUNIT_TEST
	tristate "Google LLC google powercap helper tests" if !KUNIT_ALL_TESTS
	depends on KUNIT
	default KUNIT_ALL_TESTS
	help
		This enables the test suite for testing the powercap framework helper,
		CPU client helper, devfreq client helper and powercap tree builder modules.

config GOOGLE_UCLAMP_CDEV_HELPER_KUNIT_TEST
	tristate "Google LLC uclamp cdev helper tests" if !KUNIT_ALL_TESTS
	depends on KUNIT
	default KUNIT_ALL_TESTS
	help
		This enables the test suite that will test all the helper functions
		used by uclamp cooling device(cdev) driver. This tests the probe
		function, cooling device registration, driver exit cleanup.
```
