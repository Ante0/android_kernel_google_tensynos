## google-modules/soc/gs/drivers/block/zram/Kconfig
```kconfig
# SPDX-License-Identifier: GPL-2.0
config ZRAM_GS
	tristate "Compressed RAM block device support"
	depends on BLOCK && SYSFS && MMU
	select ZSMALLOC
	help
	  Creates virtual block devices called /dev/zramX (X = 0, 1, ...).
	  Pages written to these disks are compressed and stored in memory
	  itself. These disks allow very fast I/O and compression provides
	  good amounts of memory savings.

	  It has several use cases, for example: /tmp storage, use as swap
	  disks and maybe many more.

	  See Documentation/admin-guide/blockdev/zram.rst for more information.

config ZCOMP_CPU
	tristate "CPU compression"
	depends on ZRAM_GS
	default n
	help
	  Support CPU compressor. User should configuire it via echo
	  "lzo" > /sys/block/zramX/comp_algorithm

config ZCOMP_EH
	tristate "Support Emerald Hill HW compressor"
	depends on ZRAM_GS
	select GOOGLE_EH
	default n
	help
	  Support Emerald Hill HW compressor. User should configure it via
	  echo "lz77eh" > /sys/block/zramX/comp_algorithm

config ZRAM_GS_BACKEND_LZO
	bool "lzo and lzo-rle compression support"
	depends on ZRAM_GS
	select LZO_COMPRESS
	select LZO_DECOMPRESS

config ZRAM_GS_BACKEND_LZ4
	bool "lz4 compression support"
	depends on ZRAM_GS
	select LZ4_COMPRESS
	select LZ4_DECOMPRESS

config ZRAM_GS_BACKEND_LZ4HC
	bool "lz4hc compression support"
	depends on ZRAM_GS
	select LZ4HC_COMPRESS
	select LZ4_DECOMPRESS

config ZRAM_GS_BACKEND_ZSTD
	bool "zstd compression support"
	depends on ZRAM_GS
	select ZSTD_COMPRESS
	select ZSTD_DECOMPRESS

config ZRAM_GS_BACKEND_DEFLATE
	bool "deflate compression support"
	depends on ZRAM_GS
	select ZLIB_DEFLATE
	select ZLIB_INFLATE

config ZRAM_GS_BACKEND_842
	bool "842 compression support"
	depends on ZRAM_GS
	select 842_COMPRESS
	select 842_DECOMPRESS

choice
	prompt "Default zram compressor"
	default ZRAM_GS_DEF_COMP_LZORLE
	depends on ZRAM_GS

config ZRAM_GS_DEF_COMP_LZORLE
	bool "lzo-rle"
	depends on ZRAM_GS_BACKEND_LZO

config ZRAM_GS_DEF_COMP_LZO
	bool "lzo"
	depends on ZRAM_GS_BACKEND_LZO

config ZRAM_GS_DEF_COMP_LZ4
	bool "lz4"
	depends on ZRAM_GS_BACKEND_LZ4

config ZRAM_GS_DEF_COMP_LZ4HC
	bool "lz4hc"
	depends on ZRAM_GS_BACKEND_LZ4HC

config ZRAM_GS_DEF_COMP_ZSTD
	bool "zstd"
	depends on ZRAM_GS_BACKEND_ZSTD

config ZRAM_GS_DEF_COMP_DEFLATE
	bool "deflate"
	depends on ZRAM_GS_BACKEND_DEFLATE

config ZRAM_GS_DEF_COMP_842
	bool "842"
	depends on ZRAM_GS_BACKEND_842

endchoice

config ZRAM_GS_DEF_COMP
	string
	depends on ZRAM_GS
	default "lzo-rle" if ZRAM_GS_DEF_COMP_LZORLE
	default "lzo" if ZRAM_GS_DEF_COMP_LZO
	default "lz4" if ZRAM_GS_DEF_COMP_LZ4
	default "lz4hc" if ZRAM_GS_DEF_COMP_LZ4HC
	default "zstd" if ZRAM_GS_DEF_COMP_ZSTD
	default "deflate" if ZRAM_GS_DEF_COMP_DEFLATE
	default "842" if ZRAM_GS_DEF_COMP_842
	default "unset-value"

config ZRAM_GS_WRITEBACK
       bool "Write back incompressible or idle page to backing device"
       depends on ZRAM_GS
       help
	 This lets zram entries (incompressible or idle pages) be written
	 back to a backing device, helping save memory.
	 For this feature, admin should set up backing device via
	 /sys/block/zramX/backing_dev.

	 With /sys/block/zramX/{idle,writeback}, application could ask
	 idle page's writeback to the backing device to save in memory.

	 See Documentation/admin-guide/blockdev/zram.rst for more information.

config ZRAM_GS_TRACK_ENTRY_ACTIME
	bool "Track access time of zram entries"
	depends on ZRAM_GS
	help
	  With this feature zram tracks access time of every stored
	  entry (page), which can be used for a more fine grained IDLE
	  pages writeback.

config ZRAM_GS_MEMORY_TRACKING
	bool "Track zRam block status"
	depends on ZRAM_GS && DEBUG_FS
	select ZRAM_GS_TRACK_ENTRY_ACTIME
	help
	  With this feature, admin can track the state of allocated blocks
	  of zRAM. Admin could see the information via
	  /sys/kernel/debug/zram/zramX/block_state.

	  See Documentation/admin-guide/blockdev/zram.rst for more information.

config ZRAM_GS_MULTI_COMP
	bool "Enable multiple compression streams"
	depends on ZRAM_GS
	help
	  This will enable multi-compression streams, so that ZRAM can
	  re-compress pages using a potentially slower but more effective
	  compression algorithm. Note, that IDLE page recompression
	  requires ZRAM_TRACK_ENTRY_ACTIME.

config ZRAM_GS_SLOWPATH_COMP
	bool "Enable slow path compression stream"
	depends on ZRAM_GS_MULTI_COMP
	help
	  This will enable a secondary compression algorithm for ZRAM's slow path.
	  This allows ZRAM to use a different compression algorithm, which may be
	  slower but can achieve a higher compression ratio. This more effective
	  compression is used when system is not under memory pressure, potentially
	  saving more memory.

config ZRAM_GS_ANDROID_IOCTL
       bool "zram ioctl interface for Android"
       depends on ZRAM_GS_WRITEBACK
       help
	 With this feature, admin can use the zram ioctl interface to operate
	 on a target process's virtual memory areas (VMAs) in zram. Then we can
	 invokes the corresponding operations like writeback the compressed
	 pages into the backing device.

config ZRAM_GS_VENDOR_HOOK
	bool "Enable zram vendor hooks"
	depends on ZRAM_GS
	default n
	help
	  Enable the zram vendor hooks. It provides a set of hooks for vendor
	  to implement their own logic.
	  For example, vendor could implement their block device read/write
	  page functions to improve performance.
```

## google-modules/soc/gs/drivers/block/zram/defconfig
```kconfig
CONFIG_ZRAM_GS=m
CONFIG_ZCOMP_CPU=m
CONFIG_ZCOMP_EH=m
CONFIG_ZRAM_GS_WRITEBACK=y
CONFIG_ZRAM_GS_MULTI_COMP=y
CONFIG_ZRAM_GS_SLOWPATH_COMP=y
CONFIG_ZRAM_GS_BACKEND_LZO=y
CONFIG_ZRAM_GS_BACKEND_LZ4=y
CONFIG_ZRAM_GS_BACKEND_LZ4HC=y
CONFIG_ZRAM_GS_BACKEND_ZSTD=y
CONFIG_ZRAM_GS_BACKEND_DEFLATE=y
#CONFIG_ZRAM_GS_BACKEND_842=y
CONFIG_ZRAM_GS_VENDOR_HOOK=y
CONFIG_ZRAM_GS_ANDROID_IOCTL=y
```

## google-modules/soc/gs/drivers/dma-buf/heaps/Kconfig
```kconfig
# SPDX-License-Identifier: GPL-2.0
config DMABUF_HEAPS_DEFERRED_FREE
	tristate "DMA-BUF heaps deferred-free library"

config DMABUF_HEAPS_PAGE_POOL
	tristate "DMA-BUF heaps page-pool library"

source "$(KCONFIG_SOC_GS_PREFIX)drivers/dma-buf/heaps/samsung/Kconfig"
```

## google-modules/soc/gs/drivers/input/Kconfig
```kconfig
# SPDX-License-Identifier: GPL-2.0-only
#
# Input device configuration
#

if INPUT

config INPUT_KEYDEBUG
	tristate "Long Press Key Debugging"
	depends on INPUT && KERNEL_TOP
	select INPUT_KEYCOMBO
	help
	  Say Y here if you want to hook debug function to dump information
	  to debug device hang when some keys are long pressed.

config INPUT_POWER_KEYDEBUG
	tristate "Long Press Power Key Debugging"
	depends on INPUT && KERNEL_TOP
	help
	  Say Y here if you want to enable debug functionality specifically
	  for long presses of power-related keys. This option allows
	  the system to dump valuable debug information when a power key
	  is held down for an extended period, which can be crucial
	  for diagnosing system hangs or other issues related to power management.
	  It helps in understanding the device state during such scenarios.

config INPUT_KEYCOMBO
	tristate "Key combo"
	depends on INPUT
	help
	  Say Y here if you want to take action when some keys are pressed;


source "$(KCONFIG_SOC_GS_PREFIX)drivers/input/misc/Kconfig"

source "$(KCONFIG_SOC_GS_PREFIX)drivers/input/keyboard/Kconfig"

endif
```

## google-modules/soc/gs/drivers/misc/sscoredump/test/Kconfig
```kconfig
#
# SPDX-License-Identifier: GPL-2.0-only
#

config SUBSYSTEM_COREDUMP_KUNIT_TEST
	tristate "KUnit test for sscoredump" if !KUNIT_ALL_TESTS
	depends on SUBSYSTEM_COREDUMP && KUNIT
	default KUNIT_ALL_TESTS
	help
	  This builds unit tests for the sscoredump driver.

	  For more information on KUnit and unit tests in general,
	  please refer to the KUnit documentation in Documentation/dev-tools/kunit/.

	  If unsure, say N.
```

## google-modules/soc/gs/drivers/soc/google/Kconfig
```kconfig
# SPDX-License-Identifier: GPL-2.0-only
#
# Google SoC drivers
#

menu "Google SoC drivers"

config SOC_GOOGLE
	bool "Google SoC driver support"

config SOC_GS101
	bool "Google GS101"
	depends on SOC_GOOGLE

config SOC_GS201
	bool "Google GS201"
	depends on SOC_GOOGLE

config BOARD_SLIDER
	bool "Google Slider Board"
	depends on SOC_GS101

config BOARD_CLOUDRIPPER
	bool "Google Cloudripper Board"
	depends on SOC_GS201

config BOARD_EMULATOR
	bool "Google Zuma emulator"
	help
	  Common configuration for both hybrid and full emulator.

config SOC_ZUMA
	bool "Google Zuma"
	depends on SOC_GOOGLE

config SOC_ZUMAPRO
	bool "Google Zuma Pro"
	depends on SOC_GOOGLE
	depends on SOC_ZUMA

config BOARD_RIPCURRENT
	bool "Google Ripcurrent Board"
	depends on SOC_ZUMA

config BOARD_ZUMA_EMULATOR
	bool "Google Zuma on full emulator"
	depends on SOC_ZUMA
	select BOARD_EMULATOR
	help
	Support Zuma on emulator

config BOARD_ZUMA_HYBRID
	bool "Google Zuma on hybrid emulator"
	depends on SOC_ZUMA
	select BOARD_EMULATOR
	help
	Support Zuma on hybrid emulator

config GS_CHIPID
	tristate "GS Chipid controller driver"
	depends on ARM64
	depends on SOC_GOOGLE
	select SOC_BUS
	default y

config EXYNOS_BCM_DBG
	tristate "EXYNOS_BCM_DBG driver support"
	help
	Enable exynos-bcm_dbg driver support

config EXYNOS_BCM_DBG_DUMP
	tristate "EXYNOS_BCM_DBG dump support"
	depends on EXYNOS_BCM_DBG
	default y if EXYNOS_BCM_DBG
	help
	Enable exynos-bcm_dbg dump support

config EXYNOS_BCM_DBG_DUMP_FILE
	bool "EXYNOS_BCM_DBG dump file support"
	depends on EXYNOS_BCM_DBG_DUMP
	default n
	help
	Enable exynos-bcm_dbg dump file support

config EXYNOS_BCM_DBG_PPMU
	bool "EXYNOS_BCM_DBG PPMU support"
	depends on EXYNOS_BCM_DBG
	default n if EXYNOS_BCM_DBG
	help
	Enable exynos-bcm_dbg PPMU perf_event support

config CAL_IF
       tristate "Exynos Chip Abstraction Layer Interface"
       help
       Support PMU/CMU CAL for Exynos SoC.

config CMUCAL
	tristate "Exynos CMU Chip Abstraction Layer"
	default y
	depends on CAL_IF
	help
	Support CMUCAL for Exynos SoC.

config CMUCAL_DEBUG
	tristate "CMUCAL Debug Interface"
	default y
	depends on CMUCAL

config CMUCAL_QCH_IGNORE_SUPPORT
	tristate "CMUCAL QCH IGNORE Support"
	default y
	depends on CMUCAL

config PMUCAL
        bool "Exynos PMU Chip Abstraction Layer"
        depends on CAL_IF
        default y
        help
        Support PMUCAL for Exynos SoC.

config PMUCAL_DBG
        tristate "Exynos PMUCAL debugging interface"
        depends on PMUCAL
        help
        Support PMUCAL debugging for Exynos SoC.

config EXYNOS_PMU_IF
	tristate "Exynos PMU controller Interface driver"
	help
	Support PMU register API for Exynos SoC.

config EXYNOS_PD
	tristate "Exynos PM domain Support"
	depends on CAL_IF && CMUCAL
	depends on PM
	select PM_GENERIC_DOMAINS

config EXYNOS_PD_DBG
	tristate "Exynos PM domain Support"
	depends on CAL_IF && CMUCAL
	depends on PM
	select PM_GENERIC_DOMAINS

config EXYNOS_PD_EL3
	tristate "Exynos PD Save/Restore Support"
	default m
	help
	Support Exynos Power Domain Save/Restore

config EXYNOS_PD_HSI0
	tristate "Exynos PD HSI0 driver"
	depends on EXYNOS_PD
	default m
	help
	Support PD driver to control HSI0 ldos.

config EXYNOS_PM
	tristate "Enable Exynos PM Support"
	help
	Support EXYNOS_PM for Exynos SoC.

config EXYNOS_CPUPM
	tristate "CPU Power Management driver"
	depends on PMUCAL
	help
	Support CPU Power Control for GS SoC.

source "$(KCONFIG_SOC_GS_PREFIX)drivers/soc/google/acpm/Kconfig"

config ACPM_DVFS
	tristate "ACPM DVFS manager"
	depends on CAL_IF && CMUCAL
	help
	Support ACPM DVFS for GS SoC.

config ECT
	tristate "Enable Exynos Characteristic Table File"
	default n
	help
	Support ECT for Exynos SoC.

config EXYNOS_DVFS_MANAGER
	tristate "Exynos DVFS Manager"
	help
	Enable DVFS Manager for Exynos SoC.
	This module controls constraint between each DVFS domains.

config EXYNOS_PM_QOS
	tristate "Exynos PM QOS"
	help
	Support Exynos PM QOS

config EXYNOS_CPUHP
	tristate "CPU Hotplug driver support"
	depends on HOTPLUG_CPU
	default n
	help
	Support CPU Hotplug for Exynos SoC.

config VH_KERNEL
	bool "Vendor kernel modules"
	default y
	help
	Modules for vendor kernel hooks.

config PIXEL_STAT
	tristate "Enable Pixel statistics"
	default n
	help
	Support Pixel statistics.

config PIXEL_STAT_MM
	tristate "Enable Pixel memory statistics"
	depends on PIXEL_STAT
	depends on VH_SCHED
	default n
	help
	Support Pixel memory statistics.

config EXYNOS_SECURE_LOG
	tristate "Exynos Secure Log"
	default n
	help
	Support Exynos Secure Log

config EXYNOS_CONTENT_PATH_PROTECTION
	tristate "Exynos Content Path Protection"
	default n
	help
	  Enable content path protection of EXYNOS.

config PERF_TRACE_CTRS
	tristate "perf_trace_counters support"
	default n
	help
	Support perf_trace_counters

source "$(KCONFIG_SOC_GS_PREFIX)drivers/soc/google/debug/Kconfig"

source "$(KCONFIG_SOC_GS_PREFIX)drivers/soc/google/gnssif_spi/Kconfig"

source "$(KCONFIG_SOC_GS_PREFIX)drivers/soc/google/gcma/Kconfig"

source "$(KCONFIG_SOC_GS_PREFIX)drivers/soc/google/pt/Kconfig"

source "$(KCONFIG_SOC_GS_PREFIX)drivers/soc/google/pa_kill/Kconfig"

source "$(KCONFIG_SOC_GS_PREFIX)drivers/soc/google/smra/Kconfig"

source "$(KCONFIG_SOC_GS_PREFIX)drivers/soc/google/s2mpu/Kconfig"

source "$(KCONFIG_SOC_GS_PREFIX)drivers/soc/google/vh/kernel/Kconfig"

source "$(KCONFIG_SOC_GS_PREFIX)drivers/soc/google/boot_control/Kconfig"

config HARDLOCKUP_DEBUG
	tristate "Hardlockup Debugging"
	depends on ARM64

config HARDLOCKUP_WATCHDOG
	tristate "Hardlockup Watchdog"
	default n
	help
	The module is a driver for detecting individual core lockup.

config DBGCORE_DUMP
	tristate "Debug Core Framework"
	depends on DEBUG_SNAPSHOT && EXYNOS_ADV_TRACER
	default n
	help
	This module supports the Debug Core Framework functionality.

config SYSRQ_HOOK
	tristate "Sysrq hook to overwrite panic message"
	depends on MAGIC_SYSRQ
	default n
	help
	Modules for sysrq hooks.

source "$(KCONFIG_SOC_GS_PREFIX)drivers/soc/google/pkvm-smc/Kconfig"

config PKVM_S2MPU
	tristate "S2MPU driver compatible with pKVM"
	default n
	help
	This module is a driver for the stage-2 IOMMU controlled by hypervisor.

config PKVM_S2MPU_V9
	tristate "S2MPU V9 driver compatible with pKVM"
	default n
	help
	This module is a driver for the stage-2 IOMMU controlled by hypervisor.

config S2MPU_BYPASS
	tristate "S2MPU driver of bypass mode"
	default n
	depends on !PKVM_S2MPU && !PKVM_S2MPU_V9
	help
	  This option enables a minimal S2MPU driver that puts the S2MPU
	  (Stage 2 Memory Protection Unit) into bypass mode.

	  When the S2MPU comes out of reset, it blocks all DMA traffic,
	  preventing devices from accessing the memory system. This minimal
	  driver initializes the S2MPU to a bypass mode, allowing devices
	  to function.

	  The primary purpose of this driver is to facilitate early kernel
	  bring-up during in-market kernel upgrades. The full S2MPU
	  driver has a dependency on the pKVM IOMMU framework, which can
	  undergo significant changes between kernel versions, making it
	  challenging to integrate during upgrades.

	  This minimal driver, in contrast, uses stable Linux kernel APIs
	  that are less likely to change, ensuring forward compatibility.
	  It is intended to be used until the pKVM IOMMU framework in a
	  given Android LTS kernel is stable.

	  If you are not performing an in-market kernel upgrade or require
	  the full functionality of the pKVM IOMMU, you should say N here.

config KERNEL_TOP
	tristate "Display processes statistic"
	default n
	help
	  This module exposes kernel function for modules to debugging
	  processes statistic.

config GOOGLE_MODEMCTL
	tristate "Common modem control interfaces"
	default n
	help
	  This module provides common helpers and control interfaces for modems
	  and clients that may want to interact with them.

endmenu
```
