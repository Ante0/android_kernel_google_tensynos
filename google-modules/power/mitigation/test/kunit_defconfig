## google-modules/power/mitigation/test/kunit_defconfig
```kconfig
CONFIG_GOOGLE_DA918X_BCL_KUNIT_TEST=m
CONFIG_GOOGLE_MAX77779_BCL_IRQ_KUNIT_TEST=m
CONFIG_GOOGLE_MAX77759_BCL_IRQ_KUNIT_TEST=m
```

## google-modules/powervr/Kconfig
```kconfig
source "$(KCONFIG_EXT_MODULES_PREFIX)private/google-modules/powervr/pvrsrvkm/Kconfig"

source "$(KCONFIG_EXT_MODULES_PREFIX)private/google-modules/powervr/tc/Kconfig"

source "$(KCONFIG_EXT_MODULES_PREFIX)private/google-modules/powervr/pixel/Kconfig"
```

## google-modules/powervr/pixel/Kconfig
```kconfig
config BUILD_POWERVR_PIXEL
	bool "PowerVR Pixel support"
	default y
	depends on POWERVR_ROGUE

config POWERVR_RDO
	bool "PowerVR Redondo support"
	default n
	depends on POWERVR_ROGUE && BUILD_POWERVR_PIXEL

config POWERVR_LGA
	bool "PowerVR Laguna support"
	default n
	depends on POWERVR_ROGUE && BUILD_POWERVR_PIXEL

config POWERVR_MBU
	bool "PowerVR Malibu support"
	default n
	depends on POWERVR_ROGUE && BUILD_POWERVR_PIXEL

config POWERVR_PIXEL_SLC
	bool "SoC SLC integration"
	default y
	depends on POWERVR_RDO || POWERVR_LGA

config POWERVR_PIXEL_IIF
	bool "SoC IIF integration"
	default n
	depends on POWERVR_RDO || POWERVR_LGA || POWERVR_MBU

config POWERVR_BRINGUP_MODE
	bool "Disable optional functionality (for bringup and testing purposes)"
	default n
	depends on POWERVR_RDO || POWERVR_LGA || POWERVR_MBU

config POWERVR_DISABLE_PM_RUNTIME
	bool "Disables PM runtime integration. Requires that GPU power is force-on"
	default n
	depends on POWERVR_BRINGUP_MODE

config POWERVR_DISABLE_APM
	bool "Disables Active Power Management"
	default n
	depends on POWERVR_BRINGUP_MODE
```

## google-modules/radio/common/radio-bridge/Kconfig
```kconfig
# SPDX-License-Identifier: GPL-2.0-only

config GOOGLE_RADIO_BRIDGE
	tristate "Google Radio Bridge Module"
	depends on ARCH_GOOGLE
	help
	  This driver helps facilitate notifications between the radio kernel driver
	  and other subsystems. Every client can register a callback to listen
	  on events like modem reset, voice call termination etc.
```

## google-modules/radio/mediatek/t900/wwan/tmi3/make/Kconfig
```kconfig
config MTK_WWAN_PWRCTL_SUPPORT
	bool "Enable MTK GPIO control from MTK PCIe driver"
	default n
	help
	  Enable the MTK PCIe host driver to call power control function
	  from the wwan_pwrctl driver. This is required to sync the reset
	  logic from PCIe and inform the wwan_pwrctl driver about the
	  power reset.

config MTK_HOST_DRV_WWAN_SUPPORT
	bool "Enable MTK WWAN support"
	default n
	help
	  Use the wwan functions instead of the generic cdev functions for
	  the supported /dev nodes.

config MTK_DATA_CPU_LOADING_OPTIMIZE
	bool "Enable AP optimizations for DPMAIF"
	default n
	help
	  Enable caching and CPU affinity for the data path (DPMAIF).

config MTK_DEVLINK
	bool "Enable devlink interface for MTK modem"
	default n
	help
	  Enable the devlink interface for the MTK modem. This maybe used
	  to expose things to the userspace that are not directly related
	  to a device class like char/wwan node, but rather the whole modem
	  itself.

config MTK_DEVLINK_COREDUMP_SUPPORT
	bool "Enable postdump support for MTK modem"
	select MTK_DEVLINK
	default n
	help
	  Enable the postdump support for MTK modem.

config MTK_DEVLINK_LOGDUMP_SUPPORT
	bool "Enable logdump from MTK modem"
	select MTK_DEVLINK
	default n
	help
	  Enable the logdump support from MTK modem.

config MTK_MEMLOG_EVENT_SUPPORT
	bool "Support memlog event in Thin MD host driver"
	default n
	help
	  Used to control the memlog event feature of the Thin MD host driver.
	  When this option is enabled, host driver will print
	  high-frequency logs in hex format.
	  The logs printed in hex format need to be parsed into
	  plain text using a post-processing tool.
	  Say Y here if need to enable memlog event in host driver.
	  If unsure, say N.

config GOOGLE_ASPM_CONTROL
	bool "Enable upstream style ASPM control"
	depends on ARCH_GOOGLE
	default y
	help
	  Replace vendor's direct register accesses with Linux standard API:
	  pci_enable_link_state. This ensures the driver following PCI spec
	  correctly and allows consistent system-wide policy to be overlaid on top
	  of any driver-specific requests.

config GOOGLE_WWAN_PKT_PRIO
	bool "Google WWAN packet prioritization"
	depends on ARCH_GOOGLE
	default n
	help
	  Enable support for Google-specific WWAN packet prioritization
	  based on skb->mark bits 29 and 30. This is used by the
	  MediaTek WWAN driver.

config GOOGLE_LINK_DOWN_MMIO_PROTECT
	bool "Enable link down MMIO protection"
	depends on ARCH_GOOGLE
	default y
	help
	  This enables link checks in resume and REBOOTINT flow to avoid
	  bus hang when link up failed.

config GOOGLE_ATR_WRITE_RETRY
	bool "Enable retry for ATR programming"
	depends on ARCH_GOOGLE
	default y
	help
	  This enables retry mechanism for ATR programming to mitigate the
	  BAR2/3 access issue which may result in resume timeout or SRAMROM
	  violation.

config GOOGLE_B503643353_DEBUG
	bool "b/503643353 debug patch"
	depends on ARCH_GOOGLE
	default y
	help
	  This adds verbose logging for usr_cnt of cldma1q4.

config GOOGLE_B493109074_DEBUG
	bool "b/493109074 debug patch"
	depends on ARCH_GOOGLE
	default y
	help
	  Enable debug patch for b/493109074.
	  This patch dumps more fields other than the sequence number. This
	  could help us to understand the corrupted pattern further.

config GOOGLE_B495424578_DEBUG
	bool "b/495424578 debug patch"
	depends on ARCH_GOOGLE
	default y
	help
	  This dumps BAR2/3 ATR after setup.

config GOOGLE_B507778536_DEBUG
	bool "b/507778536 debug patch"
	depends on ARCH_GOOGLE
	default y
	help
	  This enables link error reporting when both MHCCIF stat and mask
	  are 0xffffffff.

config GOOGLE_B528903481_DEBUG
	bool "b/528903481 debug patch"
	depends on ARCH_GOOGLE
	default y
	help
	  This dumps CLDMA/DPMAIF registers when a link error is detected.
```

## google-modules/radio/mediatek/t900/wwan/tmi3/pcie/customize/google/Kconfig
```kconfig
# SPDX-License-Identifier: GPL-2.0-only

config GOOGLE_MODEM_CDD
	bool "Enable Crash Debug Dump reporting"
	depends on GOOGLE_CRASH_DEBUG_DUMP
	default n

config GOOGLE_MD2AP_WAKEUP_MONITOR
	bool "Enable MD-to-AP wakeup monitor"
	default n

config GOOGLE_MODEM_DATA_EXT
	bool "Enable Google Data Extensions"
	depends on ARCH_GOOGLE
	default y
	help
	  Main switch for all Google-specific data plane enhancements.

config GOOGLE_MODEM_DATA_FAST_DMA_SYNC
	bool "Fast DMA Sync Optimization"
	depends on GOOGLE_MODEM_DATA_EXT
	default y

config GOOGLE_MODEM_DATA_AFFINITY
	bool "Google Custom CPU Affinity"
	depends on GOOGLE_MODEM_DATA_EXT
	default y
	help
	  Use Google's custom CPU affinity tables instead of vendor defaults.
	  Includes a runtime size check to ensure safety.

config GOOGLE_MODEM_SOC_BW_QOS
	depends on GOOGLE_IRM && GOOGLE_MODEM_DATA_EXT
	bool "Enable modem SOC QOS for DDR bandwidth"
	default n

config GOOGLE_MODEM_DATA_LRO_SIZE_LIMIT
	bool "Limit RX LRO packets max size"
	depends on GOOGLE_MODEM_DATA_EXT
	default y
	help
	  Limit max Large Receive Offload (LRO) size to avoid skb_over_panic on
	  certain network device (e.g. USB NCM).
```

## google-modules/soc/gs/Documentation/devicetree/bindings/regulator/sgm38122-regulator.yaml
```yaml
# SPDX-License-Identifier: GPL-2.0-only OR BSD-2-Clause
%YAML 1.2
---
$schema: http://devicetree.org/meta-schemas/core.yaml#

title: SGMICRO SGM38122 Voltage Regulator

maintainers:
  - Xu Han <xuhanyz@google.com>
  - Kamal Shafi <kamalshafi@google.com>

properties:
  compatible:
    enum:
      - sgm,sgm38122

  reg:
    maxItems: 3

  enable-gpios:
    description: A connection of the 'enable' gpio line.
    maxItems: 1

  enable-supply:
    description:
      A connection of the 'enable' pin.

  vio-supply:
    description:
      Supply to enable device I/O.

  in1-supply:
    description:
      Input supply for dvdd regulator.

  in2-supply:
    description:
      Input supply for avdd1 and avdd2 regulator.

  in3-supply:
    description:
      Input supply for avdd3 regulator.

  google,enable-pin-can-restart:
    description:
      Used to indicate that the enable supply/pin may restart on its own.
    type: boolean

  regulators:
    type: object
    additionalProperties: false

    patternProperties:
      "^dvdd$":
        type: object
        $ref: /schemas/regulator/regulator.yaml#
        unevaluatedProperties: false

        required:
          - regulator-name

      "^avdd[1-3]$":
        type: object
        $ref: /schemas/regulator/regulator.yaml#
        unevaluatedProperties: false

        required:
          - regulator-name

required:
  - compatible
  - reg
  - regulators

additionalProperties: false

examples:
  - |
    i2c {
      sgm38122@29 {
        compatible = "sgm,sgm38122";
        reg = <0x29>;
        enable-supply = <&enable_reg>;
        status = "ok";

        regulators {
          dvdd {
            regulator-name = "dvdd";
            regulator-min-microvolt = <528000>;
            regulator-max-microvolt = <1800000>;
            in1-supply = <&reg1>;
          };

          avdd1 {
            regulator-name = "avdd1";
            regulator-min-microvolt = <1504000>;
            regulator-max-microvolt = <3424000>;
            in2-supply = <&reg2>;
          };

          avdd2 {
            regulator-name = "avdd2";
            regulator-min-microvolt = <1504000>;
            regulator-max-microvolt = <3424000>;
            in2-supply = <&reg2>;
          };

          avdd3 {
            regulator-name = "avdd3";
            regulator-min-microvolt = <1504000>;
            regulator-max-microvolt = <3424000>;
            in3-supply = <&reg3>;
          };
        };
      };
    };
```

## google-modules/soc/gs/Documentation/devicetree/bindings/regulator/sy70206-regulator.yaml
```yaml
# SPDX-License-Identifier: GPL-2.0-only OR BSD-2-Clause
%YAML 1.2
---
$schema: http://devicetree.org/meta-schemas/core.yaml#

title: Silergy SY70206 Voltage Regulator

maintainers:
  - Xu Han <xuhanyz@google.com>
  - Kamal Shafi <kamalshafi@google.com>

properties:
  compatible:
    enum:
      - sy,sy70206

  reg:
    maxItems: 3

  enable-gpios:
    description: A connection of the 'enable' gpio line.
    maxItems: 1

  regulator-initial-mode:
    enum: [1, 2]
    description: 1 - Forced PWM mode, 2 - Auto PFM mode

  regulator-allowed-modes:
    description: |
        1: Forced PWM mode
        2: Auto PFM mode
    items:
      enum: [1, 2]

  google,disable-auto-headroom:
    description:
      Used to indicates the regulator with auto headroom disabled.
    type: boolean

required:
  - compatible
  - reg

additionalProperties: false

examples:
  - |
    i2c {
      sy70206@63 {
        compatible = "sy,sy70206";
        reg = <0x63>;
        enable-gpios = <&enable_gpio 9 GPIO_ACTIVE_HIGH>;
        status = "ok";
        regulator-name = "sy70206-regulator";
        regulator-min-microvolt = <3200000>;
        regulator-max-microvolt = <3200000>;
        regulator-always-on;
        /* REGULATOR_MODE_NORMAL (auto) */
        regulator-initial-mode = <0x2>;
        /* Allow for NORMAL (auto) and FAST (FPWM) mode */
        regulator-allowed-modes = <0x2>, <0x1>;
      };
    };
```

## google-modules/soc/gs/Documentation/devicetree/bindings/usb/google,usb-role-sw.yaml
```yaml
# SPDX-License-Identifier: (GPL-2.0 OR BSD-2-Clause)
%YAML 1.2
---
$schema: http://devicetree.org/meta-schemas/core.yaml#

title: google role switch driver device tree bindings

maintainers:
  - Guan-Yu Lin <guanyulin@google.com>

description: |
  The driver collects USB data role switch requests from other drivers,
  determines appropriate data role, and pass the data role request to
  downstream dwc3 glue driver.

properties:
  disable-aoc-voter:
    description: disable AOC_VOTER on systems without such voter present.
    type: boolean

  host-mode-aoc-optional:
    description: aoc is not required for host mode functionality except
    for audio offloading feature.
    type: boolean

  eusb-role-sw-dev:
    description: Downstream eusb repeater phandle with usb-role-switch
    capability. If set, the driver will issue data role switch request to
    eusb repeater phandle via USB Role Switch framework.
    $ref: /schemas/types.yaml#/definitions/phandle

  role-sw-dev:
    description: Downstream dwc3 phandle with usb-role-switch capability.
    If set, the driver will use USB Role Switch framework to handle role
    switch request. Otherwise, the driver will use extcon (External
    connector class) instead.
    $ref: /schemas/types.yaml#/definitions/phandle
```

## google-modules/soc/gs/Documentation/devicetree/bindings/usb/max77759tcpc.yaml
```yaml
# SPDX-License-Identifier: (GPL-2.0 OR BSD-2-Clause)
%YAML 1.2
---
$schema: http://devicetree.org/meta-schemas/core.yaml#

title: max77759tcpc driver device tree bindings

maintainers:
  - Badhri Jagan Sridharan <badhri@google.com>

description: |
  The max77759tcpc driver implements usb typec driver.

properties:
  bcl-usb-voting:
    description: Allow USB to vote to change BCL's BATOILO1/2 threshold
    type: boolean

  goog,pmic-agpio-alert-config:
    description: AGPIO pin can be configured as GPIO or Alert. This property
      enables a workaround that configures agpio5 as alert. This may be required
      during bringup when BMS stack is not up yet.
    type: boolean

  enable-otg-direct:
    description: Enables reverse boost for IFPMIC directly from TCPC driver.
      Typically used during bringup.
    type: boolean
```
