## google-modules/soc/gs/drivers/soc/google/gsa/Kconfig
```kconfig
# SPDX-License-Identifier: GPL-2.0

config GSA
	tristate "GSA driver"
	default n

config GSA_LINUX_MAILBOX
	bool "Use the linux mailbox framework (not the legacy driver)."

config GSA_LEGACY_MAILBOX
	bool "Use legacy mailbox"
	depends on !GSA_LINUX_MAILBOX
	default y

config GSA_LOG_REGION_SIZE
	hex "The size of the GSA log region in bytes."
	depends on GSA
	default 0x1000

config GSA_PATCH_VERSION
	bool "Enable reading the GSA ROM patch version."
	default y
	help
	  Enabling this option will query the GSA ROM patch version on boot.
	  After the module is initialized, the ROM patch version can be accessed via
	  a sysfs file.
	  This option should be enabled in hardware, and disabled for emulation.
	  When this option is disabled, the ROM patch version will read as -ENODATA.

config GSA_DEBUGFS
	bool "Enable debugfs interface on the GSA driver"
	depends on GSA
	default y
	help
	  Enabling this option will enable a debugfs interface.
	  These interfaces can be used to test the mailbox driver and facilitate
	  functional tests.
	  Currently, `version`, `stay_awake`, and `trace` interfaces are exposed
	  as well as `pm_state` power-state statistics.

config GSA_PKVM
	bool "Support pKVM"
	depends on GSA
	depends on PKVM_S2MPU_V9 || PKVM_S2MPU || S2MPU_BYPASS
	default n

config GSA_GSC
	tristate "GSC Proxy"
	depends on GSA
	default n

config TZ_PROT
	tristate "TZ Prot"
	depends on GSA
	default n

config GSA_IPC
	tristate "GSA IPC support"
	depends on GSA
	help
	  Enabling this option will enable "gsa_ipc" kernel module.
	  This module implements GSA IPC infrastructure that allows the user space apps
	  to communicate with GSA core using Trusty IPC compatible IPC protocol. Both
	  simple message exchange and memory sharing is supported.

config GSA_WAKELOCK
	bool "Hold wakelock during mailbox transactions"
	depends on GSA
	default n
	help
	  Enabling this option will hold a wakelock during GSA mailbox
	  transactions to prevent the system from suspending while a
	  transaction is in progress.
```

## google-modules/soc/gs/drivers/soc/google/pixel_trim/Kconfig
```kconfig
# SPDX-License-Identifier: GPL-2.0
config PIXEL_TRIM
       tristate "Trim"
       help
         This option enables support for Trim framework for Pixel devices.
         System will call the Trim operation to alleviate memory pressure.
```

## google-modules/soc/gs/drivers/soc/google/pkvm-smc/Kconfig
```kconfig
# SPDX-License-Identifier: GPL-2.0-only
config PKVM_PIXEL_SMC
    tristate "Pixel pKVM SMC module"
    default n
    help
      This module filters Secure Monitor Calls (SMCs) at the pKVM level for
      pixel devices, making sure only allowed and authorized SMCs are forwarded.
```

## google-modules/soc/gs/drivers/usb/role-sw/Kconfig
```kconfig
# SPDX-License-Identifier: GPL-2.0

config GOOGLE_USB_ROLE_SW
	tristate "USB data role switch for Google devices"
	depends on EXTCON
	select GOOGLE_VOTABLE
	help
	  'GOOGLE_USB_ROLE_SW' is a virtual device for collecting any
	  Google specific USB data role switch limitations. The virtual
	  device will aggregate usb data role switch requests from
	  different drivers and elect a valid one, then pass it to down-
	  stream device. Say 'Y' or 'M' if you need this device.

config GOOGLE_USB_ROLE_SW_KUNIT_TEST
	tristate "Google USB role switch driver tests" if !KUNIT_ALL_TESTS
	depends on KUNIT
	default KUNIT_ALL_TESTS
	help
	  This will build the test suite that will verify the functionalities of
	  the Google USB Role Switch driver.

	  This config is only meant to be used in development of the driver, not
	  for distribution.
```

## google-modules/soc/gs/drivers/usb/typec/tcpm/google/Kconfig
```kconfig
# SPDX-License-Identifier: GPL-2.0-only
#
# Copyright (C) 2021, Google LLC

if TYPEC_TCPM

config USB_PSY
	tristate

config TYPEC_COOLING_DEV
	tristate "USB TYPE-C port cooling device"
	depends on EXTCON
	select THERMAL
	select GOOGLE_VOTABLE
	help
	  Type-C port passive cooling device to throttle when the port is hot.

config GOOGLE_TCPCI_SHIM
	tristate "Type-C Port Controller Shim Interface Driver"
	depends on I2C
	select REGMAP_I2C
	help
	  Type-C Port Controller Shim Interface Driver for TCPCI-compliant
	  controller.

config TYPEC_FUSB307
	tristate "Fairchild FUSB307B Type-C chip driver"
	select USB_PSY
	select GOOGLE_TCPCI_SHIM
	help
	  The Fairchild FUSB307 Type-C chip driver that works with
	  Type-C Port Controller Manager to provide USB PD and USB
	  Type-C functionalities.

config TYPEC_MAX77759
	tristate "Maxim MAX77759 Type-C module"
	select USB_PSY
	select GOOGLE_TCPCI_SHIM
	select GPIOLIB
	help
	  MAX77759 TCPCI module to interface with TCPM. Needs to be used
	  with a bus driver like TYPEC_MAX777X9_I2C driver.

config TCPCI_VENDOR_HOOKS
	bool "Enable TCPCI vendor hooks"
	depends on TYPEC_MAX77759
	default n
	help
	  This config is used to enable/disable the TCPCI vendor hooks.

config TYPEC_MAX77759_CONTAMINANT
	tristate "Maxim MAX77759 specific contaminant detection routines"
	depends on TYPEC_MAX77759
	help
	  Maxim MAX77759 specific contaminant detection routines.

config TYPEC_MAX77779_CONTAMINANT
        tristate "Maxim MAX77779 specific contaminant detection routines"
        depends on TYPEC_MAX77759
        help
          Maxim MAX77779 specific contaminant detection routiness.

config TYPEC_MAX777X9_I2C
	tristate "Maxim MAX77759 Type-C driver using I2C bus"
	select TYPEC_MAX77759
	select REGMAP_I2C
	help
	   MAX77759 TCPCI driver using I2C Bus to communicate with IF-PMIC.

config TYPEC_MAX777X9_SPMI
	tristate "Maxim MAX77759 Type-C driver using SPMI bus"
	select TYPEC_MAX77759
	select REGMAP_SPMI
	help
	   MAX77759 TCPCI driver using SPMI Bus to communicate with IF-PMIC.

endif # TYPEC_TCPM

config POGO_TRANSPORT
	tristate "Pogo transport management driver"
	depends on TYPEC_MAX77759
	select GOOGLE_LOGBUFFER
	help
	  Pogo transport management driver
```

## google-modules/soc/rdo/Documentation/devicetree/bindings/clk/clock.yaml
```yaml
# SPDX-License-Identifier: (GPL-2.0-only OR BSD-2-Clause)
# Copyright 2026 Google LLC
%YAML 1.2
---
$id: http://devicetree.org/schemas/clk/google,clock.yaml#
$schema: http://devicetree.org/meta-schemas/core.yaml#

title: Google CPM Clocks

description:
  This binding describes clocks managed by CPM clock controller.

properties:
  restore-rate-on-aoss-ssr:
    type: boolean
    description:
      Workaround for b/441499672, remove once b/441499672 is fixed. If present,
      clock rate is restored after AOSS sub-system reset. Only meaningful
      for clocks whose rate may be reset by SSR.
```
