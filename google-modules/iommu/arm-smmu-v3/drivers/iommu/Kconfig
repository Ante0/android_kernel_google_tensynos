## google-modules/soc/rdo/Documentation/devicetree/bindings/clock-manager/google,google-lcm.yaml
```yaml
# SPDX-License-Identifier: (GPL-2.0-only OR BSD-2-Clause)
# Copyright 2023 Google LLC
%YAML 1.2
---
$id: http://devicetree.org/schemas/lcm/google,google-lcm.yaml#
$schema: http://devicetree.org/meta-schemas/core.yaml#

title: Google Local Clock Manager

maintainers:
  - Aniket <aniketmaurya@google.com>

description:
  The Google LCM consists of programmable clock gates, multiplexer and divider.
  Gates without reset are referred here as gate_nr and gate_r otherwise.
  This supports gating and ungating of the clock, and static setting of clock
  frequency through mux and div values specified in DT. Dynamic frequency
  scaling is not supported.
  This driver implements both clock provider and reset provider operations.
  Use macros from linux_drivers/include/dt-bindings/lcm/google,rdo.h

properties:
  compatible:
    const: google,google-lcm

  reg:
    minItems: 3
    maxItems: 4
    description:
      This is an array describing the physical addresses and sizes of the various
      LCM hardware blocks register area e.g. gates , mux, etc.

  reg-names:
    minItems: 3
    items:
      - const: gate
      - const: gate_nr
      - const: mux
      - const: div
    description:
      The register area name.
      Gate, mux and div are always present.

  "#clock-cells":
    const: 3
    description: |
      The client needs to specify three integers along
      with the clock phandle. Those are:
      1. hw_type: LCM_GATE_R, LCM_GATE_NR, LCM_MUX or LCM_DIV.
      2. hw index: index within the hw_type.
      3. hw_val:
          For LCM_GATE_R, LCM_GATE_NR: can be left 0 or set to the
            clock frequency expected by the client. Remember that
            the actual frequency depends upon settings of the mux
            and div of the clock. Setting this frequency does not
            change the actual frequency.
          For LCM_MUX: mux select,
          For LCM_DIV: divider value.

  "#reset-cells":
    const: 1
    description:
      Only gate_r hw has reset, so reset index should not
      exceed number of gate_r in a sswrp.

  clocks:
    description:
      Some devices may need some clocks to be configured at bootup,
      specify them here. So these clocks would be auto enabled and
      consumers do not need to handle them. The clocks are enabled
      in the order they are specified.

  resets:
    description:
      Describes a set of resets the driver should assert and deassert
      while initializing itself. This may be useful for devices that
      do not handle the reset explicitly but need to do so outside of the driver.

required:
  - compatible
  - reg
  - reg-names
  - "#clock-cells"
  - "#reset-cells"

additionalProperties: true

examples:
    -  |
      /* clock provider node for LSIO_S */
      lsios_lcm: lsios_lcm@3bc0d600 {
          compatible = "google,google-lcm";
          reg = <0 0x3bc0d600 0 0x680>,
                <0 0x3bc0dca0 0 0x040>,
                <0 0x3bc0dd00 0 0x070>,
                <0 0x3bc0df00 0 0x100>;
          reg-names = "gate_r","gate_nr","mux","div";

          #clock-cells = <3>;
          #reset-cells = <1>;

          /* These clocks are auto enabled during probe of this node */
          clocks = <&lsios_lcm LCM_MUX 4 1>,
                   <&lsios_lcm LCM_MUX 2 1>,
                   <&lsios_lcm LCM_DIV 13 1>,
                   <&lsios_lcm LCM_DIV 3 2>,
                   <&lsios_lcm LCM_GATE_R 48 0>;
          clock-names = <"mux_lsio_s_cfg_clk">,
                        <"mux_lsio_s_ic_clk">,
                        <"div_lsio_s_cfg_clk">,
                        <"div_lsio_s_ic_clk">,
                        <"cg_lsio_s_cfg_clk">;

          /* These resets are auto asserted and deasserted */
          resets = <&lsios_lcm 48>,
                   <&lsios_lcm 27>;
          reset-names = <"rst_lsio_s_cfg_clk">,
                        <"rst_lsio_s_cli3_cfg_clk">;
      };

      /* clock consumer/client node for CLI3 */
      i2c0: i2c@3bf40000 {
          compatible = "google,i2c";
          reg = <0x0 0x3bf40000 0x0 0x100>;

          /* clocks and resets in clients are handled by respective client drivers*/

          clocks = <&lsios_lcm LCM_GATE_R 23 200000000>, /* cg_lsio_s_cli3_i2c_clk, 200Mhz */
                   <&lsios_lcm LCM_GATE_R 27 300000000>; /* cg_lsio_s_cli3_cfg_clk, 300Mhz */
          clock-names = "ic_clk","pclk";

          resets = <&lsios_lcm 23>;  /* rst_lsio_s_cli3_cfg_clk */
          reset-names = "ic_rst";
      };
```

## google-modules/soc/rdo/Documentation/devicetree/bindings/cpu_lpm_stats/google,cpu-lpm-stats.yaml
```yaml
# SPDX-License-Identifier: (GPL-2.0-only OR BSD-2-Clause)
# Copyright 2024 Google LLC
%YAML 1.2
---
$id: http://devicetree.org/schemas/cpu_lpm_stats/google,cpu-lpm-stats.yaml#
$schema: http://devicetree.org/meta-schemas/base.yaml#

title: Google CPUSS Power Mode Latency Driver

maintainers:
  - Mariano Marciello <mmarciello@google.com>
  - Mahesh Sivasubramanian <msivasub@google.com>
  - Marcin Wasowicz <mkwasowicz@google.com>

description:
  This defines the CPUs and cluster power domains for which the driver will
  monitor and record the total active time and the activation/deactivation
  timestamps of each power domain.

properties:
  compatible:
    description: "google,cpu-lpm-stats"
      Each subnode in the device represents a power domain for a CPU or a
      cluster. These power domains are used to collect latency and residency
      data through the cpu_lpm_stats driver.

  $nodename:
    pattern: "^power-domain-.*"
    description:
      This node designates a CPU or cluster power domain that the cpu_lpm_stats
      driver will utilize for gathering latency and residency data.
    properties:
      "power-domains":
        type: object
        description: Reference to the specific power domain to be monitored.

      "power-state":
        type: integer
        description: The id of low power state of specific power domain. This id
          is used to calculate memory location where statistics for specific
          power domain low power state are stored.

examples:
	cpu_lpm_stats: cpu_lpm_stats {
		compatible = "google,cpu-lpm-stats";

		power-domain-cpu0 {
			power-domains = <&CPU_PD0>;
			power-state = <C2_CORE0>;
		};

		power-domain-cpu1 {
			power-domains = <&CPU_PD1>;
			power-state = <C2_CORE1>;
		};

		power-domain-cpu2 {
			power-domains = <&CPU_PD2>;
			power-state = <C2_CORE2>;
		};

		power-domain-cpu3 {
			power-domains = <&CPU_PD3>;
			power-state = <C2_CORE3>;
		};

		power-domain-cpu4 {
			power-domains = <&CPU_PD4>;
			power-state = <C2_CORE4>;
		};

		power-domain-cpu5 {
			power-domains = <&CPU_PD5>;
			power-state = <C2_CORE5>;
		};

		power-domain-cpu6 {
			power-domains = <&CPU_PD6>;
			power-state = <C2_CORE6>;
		};

		power-domain-cpu7 {
			power-domains = <&CPU_PD7>;
			power-state = <C2_CORE7>;
		};

		power-domain-top-cluster {
			power-domains = <&CPU_TOP_CL>;
			power-state = <C4>;
		};

		power-domain-cluster-1 {
			power-domains = <&CPUCL1>;
			power-state = <C3_CLUSTER1>;
		};

		power-domain-cluster-2 {
			power-domains = <&CPUCL2>;
			power-state = <C3_CLUSTER2>;
		};
	};
```

## google-modules/soc/rdo/Documentation/devicetree/bindings/cstate-ctrl/cstate-ctrl.yaml
```yaml
# SPDX-License-Identifier: (GPL-2.0-only OR BSD-2-Clause) Copyright 2024 Google
# LLC
%YAML 1.2 --- $id:
  http://devicetree.org/schemas/cstate-ctrl/google,cstate-ctrl.yaml# $schema:
    http://devicetree.org/meta-schemas/core.yaml#

title: Google CPU cluster C-state control

maintainers: - Henry Chow<henrychow@google.com>

description:
  Defines the power domain properties to control during runtime.

properties:
  power-domains:
    description:
      Defines the genpd power domain for the driver to vote for in order
      to prevent it from being powered down even if all client votes are
      relinquished.

  debugfs-name:
    description:
      Optionally define the name of the debugfs node. If absent, the genpd
      power domain name will be used.

  disable-on-boot:
    description:
      Optional flag to automatically prevent this CPU cluster from being
      powered down.
```

## google-modules/soc/rdo/Documentation/devicetree/bindings/dma/google,gpdma.yaml
```yaml
# SPDX-License-Identifier: (GPL-2.0-only OR BSD-2-Clause)
# Copyright 2023 Google LLC
%YAML 1.2
---
$id: http://devicetree.org/schemas/dma/google,gpdma.yaml#
$schema: http://devicetree.org/meta-schemas/core.yaml#

title: Google General Purpose DMA Driver

maintainers:
  - Joy Chakraborty <joychakr@google.com>

description:
  The Google General Purpose DMA Driver configures Google SOC specific components
  placed around a dma-controller to meet SOC requirements.
  The HW wrapper is present around a PL330 DMA controller which houses a REQ-ACK
  matrix resposible for routing Peripheral request/acknowledge signals to DMA
  inputs and contains registers to drive AxUser signals required for QoS.

properties:
  compatible:
    enum:
      - google,gpdma

  reg:
    items:
      - description: DMA Request/Acknowledgment Matrix Registers
      - description: AxUser Signal manipulation Registers

  reg-names:
    items:
      - const: req_ack_csr
      - const: axuser_csr

  power-domains:
    maxItems: 1

  "#dma-cells":
    const: 2
    description: DMA Request router needs 2 arguments
                 1. Type of channel, 0 - TX and 1 - RX
                 2. Peripheral source index.
  dma-channels:
    description: Number of physical channels of DMA controller child.

  dma-requests:
    description: Number of peripheral requests supported by DMA
                 controller child.

  google,qos-vc:
    description: Virtual Channel to meet QoS required.
    $ref: /schemas/types.yaml#/definitions/uint32
    enum: [0,1,2,3,4,5]

  "#address-cells": true
  "#size-cells": true
  ranges: true

patternProperties:
  "^dma-controller@[0-9a-f]+$":
    oneOf:
      - $ref: /schemas/dma/arm,pl330.yaml

required:
  - compatible
  - reg
  - reg-names
  - "#dma-cells"
  - dma-channels
  - dma-requests
  - qos-vc
  - "#address-cells"
  - "#size-cells"
  - ranges

additionalProperties: false

examples:
  - |
    gpdma0: gpdma_wrapper@3b990000 {
      compatible = "google,gpdma";
      reg = <0 0x3b9d0000 0 0x80>,
            <0 0x3b9910c0 0 0x90>;
      reg-names = "req_ack_csr", "axuser_csr";
      #address-cells = <2>;
      #size-cells = <2>;
      #dma-cells = <2>;
      dma-channels = <9>;
      dma-requests = <32>;
      google,qos-vc = <1>;
      power-domains = <&sswrp_gpdma_pd>;
      ranges;
      dma-controller@12680000 {
          compatible = "arm,pl330", "arm,primecell";
          reg = <0x12680000 0x1000>;
          interrupts = <99>;
          #dma-cells = <1>;
      };
    };

...
```

## google-modules/soc/rdo/Documentation/devicetree/bindings/dvfs-helper/google,dvfs-helper.yaml
```yaml
# SPDX-License-Identifier: (GPL-2.0-only OR BSD-2-Clause)
# Copyright 2023 Google LLC
%YAML 1.2
---
$id: http://devicetree.org/schemas/dvfs-helper/google,dvfs-helper.yaml#
$schema: http://devicetree.org/meta-schemas/core.yaml#

title: Google DVFS Helper

maintainers:
  - Vinod Modhe <vmodhe@google.com>

description:
  The Google DVFS Helper reads the DVFS tables from the CPM firmware via mailbox
  and makes them available to voting clients like the CPU freq driver. The client
  device node needs to have a 'dvfs-helper-domain-name' string property containing
  the domain string used in CPM firmware.

properties:
  compatible:
    const: google,dvfs-helper

  mba-dest-channel:
    description:
      Mailbox service ID.

  mboxes:
    description:
      Mailbox to use.

required:
  - compatible
  - mba-dest-channel
  - mboxes

additionalProperties: false

examples:
    - |
      dvfs_helper {
        compatible = "google,dvfs-helper";
        mba-dest-channel = <0xE>; // PWRBLK mbox service ID on CPM
        mboxes = <&mbactrl_ap_cpm 19>;
      };
```

## google-modules/soc/rdo/Documentation/devicetree/bindings/interrupt-controller/google,irq-gia.yaml
```yaml
# SPDX-License-Identifier: GPL-2.0-only OR BSD-2-Clause
# Copyright 2024 Google LLC
%YAML 1.2
---
$id: http://devicetree.org/schemas/interrupt-controller/google,irq-gia.yaml#
$schema: http://devicetree.org/meta-schemas/core.yaml#

title: Google Generic Interrupt Aggregator (GIA)

maintainers:
  - Chintan Pandya <chintanpandya@google.com>
  - Trevor van Leeuwen <tvanl@google.com>

allOf:
  - $ref: /schemas/interrupt-controller.yaml#

description: |
  The Google GIA is a scalable interrupt controller designed to handle
  various types of interrupts efficiently. It supports level-triggered,
  pulse-triggered, and wide (multi-bank) configurations.

properties:
  compatible:
    enum:
      - google,wide-level-gia
      - google,level-gia
      - google,pulse-gia
    description: Identifies the specific GIA variant.

  interrupt-controller: true

  reg:
    maxItems: 1
    description:
      Address and length of the GIA register space. For the wide GIA cases,
      size should account for all bank's combined size.

  interrupts:
    description: An array of output interrupts handled by this GIA.

  interrupt-parent:
    description: phandle to the interrupt domain this device belongs to.

  "#interrupt-cells":
    const: 1
    description: Number of cells required to specify a single interrupt.

  "nr-irq-chips":
    type: integer
    default: 1
    description: |
      Number of register banks in the GIA. Only applicable to
      "google,wide-level-gia" variants.

  "next-bank-offset":
    type: integer
    description: |
      Offset between the base addresses of consecutive register banks.
      Only applicable to "google,wide-level-gia" variants.

  power-domains:
    description: phandle to GenPD domain this device gets power from.

required:
  - compatible
  - reg
  - interrupt-controller
  - "#interrupt-cells"

examples:
  - |
    // Level GIA:
    eh_multicast_aggr_3_intr: eh-multicast-aggr-3-intr@23e8e000
    {
	compatible = "google,level-gia";
	power-domains = <&sswrp_eh_pd>;
	interrupt-controller;
        #interrupt-cells = <1>;
	reg = <0x0 0x23e8e000 0 0x10>;
	interrupts = <GIC_SPI SSWRP_EH_INTR_EH_AP_NS_AGGR IRQ_TYPE_LEVEL_HIGH>;
    };

    // Pulse GIA:
    eh_pulse_aggr_0_intr: eh-pulse-aggr-0-intr@23e89000
    {
	compatible = "google,pulse-gia";
	power-domains = <&sswrp_eh_pd>;
	interrupt-controller;
	interrupt-parent = <&eh_multicast_aggr_3_intr>;
        #interrupt-cells = <1>;
	reg = <0x0 0x23e89000 0 0x14>;
	interrupts = <EH_GIA_MULTICAST_AGGR_3_AUX_GIA_PULSE_AGGR_0_INTR>;
    };

    // Wide level GIA (non-interleaved):
    lsios_level_aggr_0_intr: lsios-level-aggr-0-intr@3bd60000
    {
	compatible = "google,wide-level-gia";
	power-domains = <&lsio_s_cli_gpio_pd>;
	interrupt-controller;
        #interrupt-cells = <1>;
	reg = <0x0 0x3bd60000 0 0x10>;
	nr-irq-chips = <2>;
	next-bank-offset = <0x10>;
	interrupts =
		<GIC_SPI SSWRP_LSIOS_LSIOS_AP_GPIOA_INTR IRQ_TYPE_LEVEL_HIGH>;
    };
...
```
