## google-modules/iommu/arm-smmu-v3/drivers/iommu/Kconfig
```kconfig
# SPDX-License-Identifier: GPL-2.0-only
config IOMMU_IO_PGTABLE_PIXEL
	tristate "ARMv7/v8 Long Descriptor Format"
	depends on ARM || ARM64 || COMPILE_TEST
	help
	  Enable support for the ARM long descriptor pagetable format.
	  This allocator supports 4K/2M/1G, 16K/32M and 64K/512M page
	  sizes at both stage-1 and stage-2, as well as address spaces
	  up to 48-bits in size.

config ARM_SMMU_V3_PIXEL
	tristate "ARM Ltd. System MMU Version 3 (SMMUv3) Support"
	depends on ARM64
	depends on IOMMU_API
	select IOMMU_IO_PGTABLE_PIXEL
	help
	  Support for implementations of the ARM System MMU architecture
	  version 3 providing translation support to a PCIe root complex.

	  Say Y here if your system includes an IOMMU device implementing
	  the ARM SMMUv3 architecture.

config ARM_SMMU_V3_PKVM_PIXEL
	tristate "ARM SMMUv3 support for protected Virtual Machines"
	depends on KVM && ARM64
	select IOMMU_IO_PGTABLE_PIXEL
	help
	  Enable a SMMUv3 driver in the KVM hypervisor, to protect VMs against
	  memory accesses from devices owned by the host.

	  Say Y here if you intend to enable KVM in protected mode.

config GOOGLE_ACFW_DEBUG
	tristate "Driver to trigger dumping of ACFW logs into Trusty logs"
	help
	  Enable a driver that registers a kernel panic handler which calls
	  into ACFW to dump the event queues of all SMMU instance into the
	  Trusty logs.
	  Enable this driver only if you intend to use ACFW.
```

## google-modules/lwis/Kconfig
```kconfig
#
# LWIS camera drivers
#

config LWIS
      tristate "Drivers under LWIS implementation"
      depends on ARCH_GOOGLE
      default n
      help
		    This is the LWIS implementation
```

## google-modules/misc/h2omg/Kconfig
```kconfig
config GOOGLE_H2OMG
	tristate "Google Water Detection"
	default n
	help
	  Say Y here to enable new Google Water Detection.
	  This Google Water Detection driver (h2omg) exposes the internal
	  sensors, external sensors and a fuse through sysfs.

	  To compile this driver as a module, choose M here: the module will be
	  called h2omg.
```

## google-modules/perf/core/gs_domain_idle/Kconfig
```kconfig
# SPDX-License-Identifier: GPL-2.0-only
#
# Configurations for Google Idle Domain Driver
#

config GS_DOMAIN_IDLE
	tristate "Google Domain Idle Driver"
	default n
	help
	  A driver for controlling power domain idle states
	  for Google Pixel devices.
```

## google-modules/perf/core/irm_devfreq/Kconfig
```kconfig
# SPDX-License-Identifier: GPL-2.0-only
#
# Configurations for irm devfreq driver
#

config GOOGLE_IRM_DEVFREQ
	tristate "Google Irm Devfreq"
	default n
	help
	  A devfreq driver for irm backed devfreq.
	  Support gmc/memss frequency vote in low latency
```

## google-modules/perf/thermal/test/kunit_defconfig
```kconfig
CONFIG_DEVFREQ_TJ_CDEV_HELPER_KUNIT_TEST=m
CONFIG_GOOGLE_THERMAL_HELPER_KUNIT_TEST=m
CONFIG_GOOGLE_THERMAL_CPM_MBOX_KUNIT_TEST=m
CONFIG_GOOGLE_THERMAL_STATS_KUNIT_TEST=m
```

## google-modules/power/reset/Kconfig
```kconfig
# SPDX-License-Identifier: GPL-2.0

config PIXEL_POWER_REBOOT
	tristate "Pixel Power Reboot driver"
	help
	  Reboot driver support for Pixel devices.
```

## google-modules/powervr/tc/Kconfig
```kconfig
config POWERVR_TC
	tristate "PowerVR test chip support"
	depends on X86
	default n
```

## google-modules/radio/common/metrics_collection/Kconfig
```kconfig
# SPDX-License-Identifier: GPL-2.0-only

config METRICS_COLLECTION_FRAMEWORK
	tristate "Kernel metrics collection framework driver"
	default n
```

## google-modules/soc/gs/Documentation/devicetree/bindings/iommu/pixel-iova.yaml
```yaml
# SPDX-License-Identifier: (GPL-2.0-only OR BSD-2-Clause)
%YAML 1.2
---
$schema: http://devicetree.org/meta-schemas/core.yaml#

title: Pixel IOVA allocator optimizations

description: |
  Enable Pixel-specific allocator optimizations in the I/O Virtual Address
  (IOVA) allocator code.

properties:
  iova_max_align_shift:
    type: integer
    description: |
      This allows limiting the maximum alignment automatically applied by the
      IOVA framework during allocation. By default, the framework aligns
      allocations to the smallest power-of-2 multiple of PAGE_SIZE that is
      greater than or equal to the requested allocation size. For very large
      allocations (e.g., > 64 MB), this default behavior can lead to
      excessively large alignments, which quickly exhausts the available IOVA
      space, particularly for devices limited to 32-bit DMA addresses.

      This feature introduces a configurable cap on the maximum alignment the
      IOVA allocator will impose. Use the Device Tree property
      "iommu-max-align-shift = <n>;" to specify the maximum alignment shift
      value (n). The automatically calculated alignment will not exceed 2^n
      pages, even if the allocation size might otherwise dictate a larger
      alignment.
    required: false
    example: 9 # Alignment on 2MB Boundary

  iommu_best_fit_algo:
    type: boolean
    description: |
      Enable or disable the IOVA best-fit allocation algorithm. This algorithm
      attempts to find the smallest available memory region that can
      accommodate a given allocation request. When disabled, the default
      allocation strategy is used (e.g., first-fit). Setting this property to
      true will enable the best-fit algorithm."
    required: false
    example: true # Example when it is enable.
```

## google-modules/soc/gs/Documentation/devicetree/bindings/usb/usb_phy.yaml
```yaml
# SPDX-License-Identifier: (GPL-2.0 OR BSD-2-Clause)
%YAML 1.2
---
$schema: http://devicetree.org/meta-schemas/core.yaml#

title: google-usb-phy driver device tree bindings

maintainers:
  - RD Babiera <rdbabiera@google.com>

description:
  The Google USB PHY driver manages PHY access for the USB and DPTX controllers.

properties:
  dp_tune_params:
    description: |+
      if present, uses the DP TX_EQ override registers belonging to PIPE message
      bus instead of the hardware defaults when setting voltage swing and
      preemphasis levels.
    type: object
    properties:
      dp_tune_<rate>_vs_<vs>_pe_<pe>:
        description: |+
          Child node of dp_tune_params used to describe tuning values for a
          rate, vs, and pe combination. <rate> is one of [rbr, hbr, hbr2, hbr3],
          while <vs> and <pe> are in range [0,3] where vs + pe < 4.
        properties:
          tune_value:
            description: |+
              Array that defines main, pre, and post coefficients for the
              parent property.
            $ref: /schemas/types.yaml#/definitions/uint32-array
            minItems: 3
            maxItems: 3

examples:
  - |+
    &usb_phy {
      dp_tune_params {
        dp_tune_rbr_vs_1_pe_1 {
          tune_value = <30 0 5>;
        };
      };
    };
```

## google-modules/soc/gs/drivers/soc/google/gnssif_spi/Kconfig
```kconfig
config EXYNOS_GNSS_IF_SPI
	tristate "Exynos GNSS SPI interface driver"
	default n
	help
	  Exynos GNSS SPI interface driver

config EXYNOS_GNSS_IF_SPI_DMA_SAFE_BUFFER
	bool "Allocate DMA-safe buffer for Exynos GNSS SPI interface"
	default n
	depends on EXYNOS_GNSS_IF_SPI
	help
	  This option enables the Exynos GNSS SPI interface driver to allocate
	  a DMA-safe buffer. This buffer is used by the SPI driver for
	  communication with the GNSS chip under DMA. LGA platform using this
	  explicitly, while others(Zuma) handle DMA buffer allocation internally.
```

## google-modules/soc/gs/drivers/soc/google/pt/Kconfig
```kconfig
# SPDX-License-Identifier: GPL-2.0-only

config SLC_PARTITION_MANAGER
	tristate "PT API framework"
	default n
	help
	Enable PT framework for managing system level cache.

config SLC_PARTITION_MANAGER_LEGACY
	bool "Enable legacy PT API framework support"
	depends on SLC_PARTITION_MANAGER
	default n
	help
	Enable legacy PT framework for managing system level cache.

config GS_SLC_ACPM
	tristate "PT ACPM driver"
	depends on SLC_PARTITION_MANAGER && GS_ACPM
	default n
	help
	Support PT ACPM drvier

config SLC_PMON
	bool "Enable SLC perf counter support"
	depends on GS_SLC_ACPM
	default n
	help
	Enable SLC perf counter support in PT ACPM driver.
```

## google-modules/soc/rdo/Documentation/devicetree/bindings/booker-ci/google,booker-ci.yaml
```yaml
# SPDX-License-Identifier: (GPL-2.0-only OR BSD-2-Clause)
# Copyright 2023 Google LLC
%YAML 1.2
---
$id: http://devicetree.org/schemas/booker-ci/google,booker-ci.yaml#
$schema: http://devicetree.org/meta-schemas/core.yaml#

title: ARM Booker-CI coherrent interconnect

maintainers:
  - Ivan Zaitsev <zaitsev@google.com>

description:
  Provides access to Booker-CI configuration
  Provides details for detected Booker-CI errors and faults

properties:
  compatible:
    const: google,booker-ci

  reg_base:
    Items:
      - description: Base address for Booker-CI registers

  interrupts:
    minItems: 4
    maxItems: 4
    items:
      - description: Non-secure error interrupt
      - description: Secure error interrupt
      - description: Non-secure fault interrupt
      - description: Secure fault interrupt

  interrupt-names:
    minItems: 4
    maxItems: 4
    - enum: [ BCI: Non-secure error, BCI: Non-secure error,
      BCI: Non-secure fault, BCI: Secure fault ]
    description: Array of interrupt names

  interrupt-is-secure:
    minItems: 4
    maxItems: 4
    - enum: [ 0, 1 ]
    description: One item per interrupt describing if corresponding interrupt
      triggers for secure(1) or non-secure(0) events

  interrupt-is-error:
    minItems: 4
    maxItems: 4
    - enum: [ 0, 1 ]
    description: One item per interrupt describing if corresponding interrupt
      triggers for error(1) or fault(0) events

  patternProperties:
  '^node([0-99]*)':
    type: object
    description: Booker-CI consists of nodes connected into mesh network.
      Memory layout for BCI nodes depends on topology which was selected
      during IP instantiation. Booker does support auto discovery mechanism.
      This logic is implemented in the ARM CMN driver. Once functionality
      of this driver merged into ARM CMN we'll switch to auto discovery.
    properties:
      device_type:
        items:
          - enum:
            - booker-cfg
            - booker-mtsx
            - booker-hnf
            - booker-rnf
            - booker-rnd
            - booker-hnd
            - booker-hni
            - booker-xp

      offset:
        items:
          - description: Node base address offset in Booker-CI address range.

      id:
        items:
          - description: Topology specific node ID. Should be taken from
            Booker-CI design documentation.

    required:
      - device_type
      - offset
      - id

required:
  - reg_base
  - interrupts
  - interrupt-names
  - interrupt-is-secure
  - interrupt-is-error

additionalProperties: false

examples:
  - |
    booker {
    compatible = "google,booker-ci";
    reg_base = <0x10000000>;
    interrupts = <GIC_SPI 71 IRQ_TYPE_LEVEL_HIGH>,
                 <GIC_SPI 72 IRQ_TYPE_LEVEL_HIGH>,
                 <GIC_SPI 73 IRQ_TYPE_LEVEL_HIGH>,
                 <GIC_SPI 74 IRQ_TYPE_LEVEL_HIGH>;
    interrupt-names = "BCI: Non-secure error",
                      "BCI: Secure error",
                      "BCI: Non-secure fault",
                      "BCI: Secure fault";
    interrupt-is-secure = <0>, <1>, <0>, <1>;
    interrupt-is-error = <1>, <1>, <0>, <0>;
    status = "ok";
    node0 {
      device_type = "booker-cfg";
      offset = <0x0>;
      id = <20>;
    };
...
```
