## google-modules/display/common/gs_panel/Documentation/devicetree/bindings/display/gs-panel.yaml
```yaml
# SPDX-License-Identifier: GPL-2.0-only
%YAML 1.2
---
$id: http://devicetree.org/schemas/display/gs-panel.yaml#
$schema: http://devicetree.org/meta-schemas/core.yaml#

title: Google Silicon Display Panel Driver (Generic)

maintainers:
  - Taylor Nelms <tknelms@google.com>

description:
  This document describes device tree properties for Google Silicon's display
  panel driver framework.

properties:
  compatible:
    $ref: /schemas/dtcore.yaml#/properties/compatible
    items:
      anyOf:
        - pattern: "^google,gs-.*$"
        - enum:
          - google,panel-gs-simple
          - google,panel-gs-simple-command

  label:
    $ref: /schemas/display/panel/panel-common.yaml#/properties/label
    maxItems: 1
    description: String used to match detected panel to panel driver.
      Used directly in bootloader handoff.

  channel:
    const: 0
    description: virtual channel id.

  allowed-hs-clks:
    description: allowed MIPI clock rates(Mbps) to be written in hs_clock node.

  reset-gpios:
    $ref: /schemas/display/panel/panel-common.yaml#/properties/reset-gpios
  tout-gpios:
    maxItems: 1
    description: Specifier for a GPIO for the proximity sensor synchronization
      signal. It also indicates the current refresh rate.
  err_fg-gpios:
    maxItems: 1
    description: Specifier for a GPIO for error reports from a DDIC

  vci-supply:
    description: VCI power supply for the panel
  vddi-supply:
    description: VDDI power supply for the panel
  vddd-supply:
    description: VDDD power supply for the panel
  vddd-gpios:
    maxItems: 1
    description: Specifier for a GPIO to control the vddd supply to the panel

  touch:
    $ref: /schemas/types.yaml#/definitions/phandle
    maxItems: 1
    description: Connection to touch node

  width-mm:
    $ref: /schemas/display/panel/panel-common.yaml#/properties/width-mm
  height-mm:
    $ref: /schemas/display/panel/panel-common.yaml#/properties/height-mm

  orientation:
    description: 0 is normal, 1 is bottom up, 2 is left up, 3 is right up
    enum: [0, 1, 2, 3]

  panel-timing:
    $ref: /schemas/display/panel/panel-common.yaml#/properties/panel-timing
    description: Optional panel timing override spec for drivers that support it

required:
  - compatible
  - label
  - channel

examples:
  - |
    panel_gs_simple_command_0: panel-gs-simple-command {
          compatible = "google,panel-gs-simple-command";
          label = "panel-gs-simple-command";
          channel = <0>;

          width-mm = <64>;
          height-mm = <48>;

          panel-timing {
                  clock-frequency = <22464000>;
                  hactive = <640>;
                  hback-porch = <36>;
                  hfront-porch = <32>;
                  hsync-len = <12>;
                  vactive = <480>;
                  vback-porch = <24>;
                  vfront-porch = <12>;
                  vsync-len = <4>;
          };
    };
    google_gs_hk3: panel@0 {
        compatible = "google,gs-hk3";
        label = "google-hk3";
        channel = <0>;
        touch = <&spitouch>;

        /* reset, power */
        reset-gpios = <&gpp0 0 GPIO_ACTIVE_HIGH>;
        tout-gpios = <&gpp14 1 GPIO_ACTIVE_HIGH>;
        err_fg-gpios = <DISP0_2_AP_ERR_FG(GPIO_ACTIVE_HIGH)>;
        vci-supply = <&m_ldo14_reg>;
        vddi-supply = <&s_bucka_reg>;
        vddd-supply = <&disp_vddd>;
        vddd-gpios = <&gpp21 5 GPIO_ACTIVE_HIGH>;
    };
```

## google-modules/display/vsi-drm/Documentation/devicetree/bindings/display/synopsys/dw-cdphy.yaml
```yaml
# SPDX-License-Identifier: (GPL-2.0-only OR BSD-2-Clause)
%YAML 1.2
---
$id: http://devicetree.org/schemas/display/synopsys/dw-cdphy.yaml#
$schema: http://devicetree.org/meta-schemas/core.yaml#

title: Synopsys DSI2 CDPhy controller

description: |
  This document defines device tree properties for the Synopsys DSI2 CDPhy
  controller.

properties:
  compatible:
    enum:
      - synopsys,dw-mipi-cdphy
      - synopsys,dw-mipi-cdphy-v1

  is_cphy:
    type: boolean
    description: false for DPHY, true for CPHY

  non24x_fix:
    type: boolean
    description: true for enabling the HW fix applicable to panel widths not multiple of 24

  clocks:
    minItems: 1
    items:
      - description: PLL reference clock

  clock-names:
    minItems: 1
    items:
      - const: pllref

required:
  - compatible
  - clocks
  - clock-names

example:
  - |
    dw_mipi_cdphy_g301: dw_mipi_cdphy@3c0000 {
        compatible = "synopsys,dw-mipi-cdphy";
        reg = <0x3c0000 0x18000>, <0x3d8800 0x800>;
        reg-names = "cdphy-tx", "u0-apb-regbank";
        #phy-cells = <1>;
        /* 0: dphy, 1: cdphy */
        is_cphy = <0>;
        clocks = <&osc_cdphy>;
        clock-names = "pllref";
    };
```

## google-modules/display/vsi-drm/Documentation/devicetree/bindings/display/verisilicon/dpu_fe.yaml
```yaml
# SPDX-License-Identifier: (GPL-2.0-only OR BSD-2-Clause)
%YAML 1.2
---
$id: http://devicetree.org/schemas/display/verisilicon/dpu_fe.yaml#
$schema: http://devicetree.org/meta-schemas/core.yaml#

title: Verisilicon DPU Front-End (FE)

maintainers:
  - Amine Najahi <anajahi@google.com>
  - Chirayush Patel <chirayushpatel@google.com>
  - Jing-Ping Jan <jingpingjan@google.com>
  - Rushi Sheth <rushikesh@google.com>
  - Taylor Nelms <tknelms@google.com>

description: |
  The Front-End (FE) component of the Verisilicon Display Processing Unit (DPU).
  It is responsible for fetching and preprocessing layer data before passing it
  to the Back-End (BE).

properties:
  compatible:
    const: verisilicon,dpu_fe

  fe_id:
    $ref: /schemas/types.yaml#/definitions/uint32
    enum: [0, 1]
    description: Identification index for the FE component (0 for FE0, 1 for FE1).

  power-domains:
    $ref: /schemas/power-domain/power-domain-consumer.yaml#/properties/power-domains
    maxItems: 1

  power-domain-names:
    $ref: /schemas/power-domain/power-domain-consumer.yaml#/properties/power-domain-names
    maxItems: 1

  interrupts:
    $ref: /schemas/interrupts.yaml#/properties/interrupts

  interrupts-extended:
    $ref: /schemas/interrupts.yaml#/properties/interrupts-extended

  interrupt-names:
    $ref: /schemas/interrupts.yaml#/properties/interrupt-names

required:
  - compatible
  - fe_id
  - power-domains

oneOf:
  - required:
      - interrupts
  - required:
      - interrupts-extended

additionalProperties: false

examples:
  - |
    dpu_fe0: dpu_fe0@0 {
            compatible = "verisilicon,dpu_fe";
            fe_id = <0>;

            power-domains = <&dpu_fe0_pd>;
            power-domain-names = "dpu_fe0_pd";

            interrupts-extended = <&dpu_multicast_aggr_0 DPU_GIA_MULTICAST_AGGR_0_FE_0_IRQ_DPU_FE_LAYER_FRM_DONE_0>,
                         <&dpu_multicast_aggr_0 DPU_GIA_MULTICAST_AGGR_0_FE_0_IRQ_DPU_FE_LAYER_FRM_DONE_1>,
                         <&dpu_multicast_aggr_0 DPU_GIA_MULTICAST_AGGR_0_FE_0_IRQ_DPU_FE_LAYER_FRM_DONE_2>,
                         <&dpu_multicast_aggr_0 DPU_GIA_MULTICAST_AGGR_0_FE_0_IRQ_DPU_FE_LAYER_FRM_DONE_3>,
                         <&dpu_multicast_aggr_0 DPU_GIA_MULTICAST_AGGR_0_FE_0_IRQ_DPU_FE_LAYER_FRM_DONE_4>,
                         <&dpu_multicast_aggr_0 DPU_GIA_MULTICAST_AGGR_0_FE_0_IRQ_DPU_FE_LAYER_FRM_DONE_5>,
                         <&dpu_multicast_aggr_0 DPU_GIA_MULTICAST_AGGR_0_FE_0_IRQ_FE_SW_RST_DONE>;
            interrupt-names = "fe0_layer_frm_done0",
                              "fe0_layer_frm_done1",
                              "fe0_layer_frm_done2",
                              "fe0_layer_frm_done3",
                              "fe0_layer_frm_done4",
                              "fe0_layer_frm_done5",
                              "fe0_sw_rst_done";
    };
```

## google-modules/display/vsi-drm/Documentation/devicetree/bindings/display/verisilicon/vs-dc.txt
```
device-tree bindings for VeriSilicon Display Controller

Display controller is used to transfers the image data from a video memory
buffer to output interface.

Required properties:
- compatible: value should be "verisilicon,dc8200"/"verisilicon,dc9x00".

- reg: host interface and display physical base address and length.

- interrupts: interrupt which controller used.

- clocks: must include clock specifiers corresponding to entries in the
		clock-names property.

- clock-names: Must contain
		core_clk: core clock.

- iommus: iommu node

- port: A port node with endpoint definitions as defined in
  Documentation/devicetree/bindings/media/video-interfaces.txt.

Optional properties:
- min-rd-avg-bw: minimum real-time average read bandwidth in MBps.
- min-rd-peak-bw: minimum real-time peak read bandwidth in MBps.
- min-wr-avg-bw: minimum real-time average write bandwidth in MBps.
- min-wr-peak-bw: minimum real-time peak write bandwidth in MBps
- min-core-clk: minimum core clock in Hz.
- tzprot-device: trust zone kernel device, for secure mode.
- fab-bus-name: Name of the dpu fabric devfreq provider.
- boost-fab-freq: target dpu fabric frequency in kHz during frequency boost stage.
- boost-core-freq: target dpu core frequency in kHz during frequency boost stage.

Example 1:

dc9400@90c0000 {
	compatible = "verisilicon,dc9x00";
	reg = <0x0 0x90c0000 0x0 0x200000>;
	interrupts = <0x0 0x0b 0x4>;
	interrupt-names = "dc9400_irq";
	clocks = <&vout_clk>, <&disp_clk>, <&axi_clk>;
	clock-names = "core_clk", "pix_clk", "axi_clk";

	fab-bus-name = "fabdisp";
	boost-fabrt-freq = <480000>;
	boost-core-freq = <666000>

	ports {
		#address-cells = <1>;
		#size-cells = <0>;
		dc_out_0: port@0 {
			reg = <0>;
		};
		dc_out_1: port@1 {
			reg = <1>;
		};
		dc_out_2: port@2 {
			reg = <2>;
		};
		dc_out_3: port@3 {
			reg = <3>;
		};
		dc_out_4: port@4 {
			reg = <4>;
		};
	};
};
```

## google-modules/display/vsi-drm/verisilicon/Kconfig
```kconfig
# SPDX-License-Identifier: GPL-2.0

config DRM_VERISILICON
	tristate "DRM Support for VeriSilicon"
	depends on DRM
	select DRM_KMS_HELPER
	help
	  Choose this option if you have a VeriSilicon soc chipset.
	  This driver provides VeriSilicon kernel mode
	  setting and buffer management. It does not
	  provide 2D or 3D acceleration.

if DRM_VERISILICON
config VERISILICON_CHIP_9x00
	bool "VeriSilicon display controller of 9x00"
	depends on DRM_VERISILICON
	default y
	help
	  Choose this option if you have a VeriSilicon display controller of
	  9x00 series, otherwise, say N.

config VERISILICON_DC9400_0x316
	bool "VeriSilicon Chip Id 0x316"
	depends on VERISILICON_CHIP_9x00
	default y
	help
	  Choose this option if you want to get VeriSilicon display info of
	  9400_0x316.

config VERISILICON_DC9400_0x32a
	bool "VeriSilicon Chip Id 0x32a"
	depends on VERISILICON_CHIP_9x00
	help
	  Choose this option if you want to get VeriSilicon display info of
	  9400_0x32a.

config VERISILICON_PLANE_RCD
	bool "Adds support for VeriSilicon plane based RCD"
	depends on VERISILICON_CHIP_9x00
	default y
	help
	  Choose this option to enable plane based rounded corner implementation
	  for devices that support it.

config VERISILICON_DC9400_0x20000005
	bool "VeriSilicon Chip Id 0x20000005"
	depends on VERISILICON_CHIP_9x00
	default y
	help
	  Choose this option if you want to get VeriSilicon display info of
	  9400_0x20000005.

config VERISILICON_MIPI_DSI2H
	bool "Integration with Synopsis MIPI DSI2 Host driver"
	select DRM_DW_MIPI_DSI2H
	help
	  Choose this option to add support for MIPI DSI using Verisilicon
	  display controller along with Synopsis MIPI DSI2 Host.

config VERISILICON_DISPLAYPORT
	bool "Enables DisplayPort encoder driver"
	default y if DWC_DPTX
	help
	  Enable this option to include the DisplayPort encoder driver,
	  which allows connecting a DisplayPort encoder to the
	  DPTX driver,
	  otherwise, say N.

config VERISILICON_RECORD_DRM_STATE
	bool "Enables recording short-term DRM state history for debugging"
	depends on DRM_VERISILICON
	default y
	help
	  Enable this option to allow maintaining a record of drm_atomic_states
	  processed by the VeriSilicon drm device, such that in anomalous
	  circumstances, the previous committed states can be retrieved for
	  inspection and debugging.
endif
```

## google-modules/display/vsi-g2d/google/Kconfig
```kconfig
# SPDX-License-Identifier: MIT

config DRM_G2D
	tristate "VSI G2D support using DRM/KMS"
	depends on DRM
	select DRM_KMS_HELPER
	help
	  Choose this option if you have a VeriSilicon G2D block
	  and want to use the DRM KMS driver for it developed by Google.

config VERISILICON_ONE_LAYER_G2D
	bool "G2D with one layer"
	depends on DRM
	default y if SOC_MBU
	help
		Choose this option to use register addresses that are
		compatible with a G2D module that uses only one layer.
		Enable this if your specific System-on-Chip (SoC) variant
		lacks hardware support for multi-layer G2D.
```

## google-modules/dpa/Documentation/devicetree/bindings/google,dpa.yaml
```yaml
# SPDX-License-Identifier: (GPL-2.0-only OR BSD-2-Clause)
# Copyright 2024 Google LLC
%YAML 1.2
---
$id: http://devicetree.org/schemas/soc/google/dpa/google,google-irq.yaml#
$schema: http://devicetree.org/meta-schemas/core.yaml#

title: Google DPA Driver

maintainers:
  - Koudai Iwahori <koudai@google.com>

description:
  DPA device provides networking offloading features. google-dpa module
  provides features like booting/communicating DPA firmware.

properties:
  compatible:
    enum:
      - google,dpa

  reg:
    description: |
      Address regions for DPA in the SoC view. Should contain an entry for
      each value in reg-names.

  reg-names:
    description: |
      Names for each of address regions defined in the reg property.
      Expects the names from the following list. Each of them represents the
      corresponding address region.
      "dpa" is DPA CSR region. "lpm" is DPA's LPM CSR region.
    items:
      - const: dpa
      - const: lpm

  in_emulation:
    description: |
      Flag to specify that the system is running on the hybrid emulation platform.
      In the hybrid emulation, Linux runs faster and some parameters like boot completion timeout
      need to be extended.

  fw-image-carveout:
    description: |
      Phandle to the reserved memory for loading firmware image.
      The predefined physically contiguous DRAM region is required for the firmware image authentication.

required:
  - compatible
  - reg
  - reg-names

additionalProperties: false

examples:
  - |
    google_dpa: dpa@123000 {
      compatible = "google,dpa";
      reg = <0x0 0x123000 0x0 0x10000>,
            <0x0 0x456000 0x0 0x10000>;
      reg-names = "dpa", "lpm";
    };

...
```

## google-modules/dpa/Kconfig
```kconfig
# SPDX-License-Identifier: GPL-2.0-only

config GOOGLE_DPA
	tristate "Google DPA driver"
	depends on ARCH_GOOGLE
	default n
	help
	  Support for DPA (NOA) device.
	  DPA device provides network offloading features. This driver provides
	  features like booting DPA firmware.

config GOOGLE_DPA_TEST
	tristate "Test client driver for DPA"
	depends on ARCH_GOOGLE
	help
	  DPA driver exposes APIs to client drivers.
	  This driver is a client driver for testing APIs exported by DPA
	  driver.
	  As this is for verification purpose, select "N" if unsure.
```

## google-modules/fingerprint/goodix/gw9608/Kconfig
```kconfig
# SPDX-License-Identifier: GPL-2.0

config GOODIX_FINGERPRINT_GW9608
	tristate "generic goodix fingerprint driver"
	default n
	help
	add support for goodix fingerprint driver.
```
