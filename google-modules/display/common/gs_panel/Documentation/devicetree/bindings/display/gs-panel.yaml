## google-modules/gpu/mali_kbase/platform/pixel/Kconfig
```kconfig
# SPDX-License-Identifier: GPL-2.0

#
# Mali Pixel integration configuration
#
# Copyright 2020 Google LLC.
#

config MALI_PIXEL_GPU_QOS
	bool "Enable QOS requests for GPU"
	depends on MALI_MIDGARD_DVFS && PM_DEVFREQ && CPU_FREQ
	help
		Turns on quality of service (QOS) requests on MIF, INT
		and the CPU clusters based on GPU utilization. Frequency
		values, thresholds and hysteresis valus are specified for
		each GPU OPP in the GPU device tree entry.

config MALI_PIXEL_GPU_BTS
	bool "Enable Bus Traffic Shaping for GPU"
	depends on MALI_PIXEL_GPU_QOS && EXYNOS_BTS
	help
		Enables the setting of Bus Traffic Shaping scenarios when
		GPU utilization is at a specific level. Configuration for
		this feature is specified on the GPU device tree entry and
		allows for setting the BTS scenario to use, and the GPU OPP
		at which it is triggered.

config MALI_PIXEL_GPU_THERMAL
	bool "Enable support for constraining GPU clocks due to thermal events"
	depends on MALI_MIDGARD_DVFS && GPU_THERMAL
	help
		Sets up the GPU driver to register for thermal events that
		require it to clock down the GPU to remain within thermal
		bounds.

config MALI_PIXEL_GPU_SECURE_RENDERING
	bool "Enable Pixel GPU Secure Rendering Support"
	depends on MALI_MIDGARD && EXYNOS_CONTENT_PATH_PROTECTION
	help
		Enables support for the GPU to render into secure memory.

config MALI_PIXEL_GPU_PM
	bool "Enable support for Pixel PM callback functions"
	help
		Enables support for Pixel PM callback functions

config MALI_PIXEL_GPU_SLC
	bool "Enable support for SLC memory"
	help
		Enables support for SLC memory

config MALI_PIXEL_GPU_SSCD
	bool "Enable Subsystem Coredump"
	help
		Enables Subsystem Coredump functionality


#
# Options with external dependencies
#

config MALI_PM_RUNTIME_S2MPU_CONTROL
	bool "Enable S2MPU support"
	depends on SOC_ZUMA
	default y
	help
		Enables S2MPU support

config MALI_PIXEL_GPU_SLEEP
	bool "Enable GPU sleep mode support"
	depends on SOC_ZUMA
	default y
	help
		Enables support for GPU sleep mode

config MALI_PIXEL_GPU_HARD_FMAX
	bool "Enable maximum GPU frequency cap"
	depends on SOC_ZUMA
	default y
	help
		Sets hard maximum GPU frequency limit

config PIXEL_GPU_SLC_ACPM_SIGNAL
	bool "Enable support for Pixel GPU SLC ACPM signal"
	depends on MALI_PIXEL_GPU_SLC && SOC_ZUMA
	default y
	help
		Enables support for Pixel GPU SLC ACPM signal
```

## google-modules/gpu/mali_pixel/defconfig
```kconfig
CONFIG_MALI_MEMORY_GROUP_MANAGER=y
CONFIG_MALI_PRIORITY_CONTROL_MANAGER=y
CONFIG_MALI_PROTECTED_MEMORY_ALLOCATOR=y
CONFIG_MALI_PIXEL_STATS=y
CONFIG_MALI_PIXEL_GPU_SLC=y
```

## google-modules/iommu/arm-smmu-v3/drivers/perf/Kconfig
```kconfig
# SPDX-License-Identifier: GPL-2.0-only
#
# Performance Monitor Drivers
#

config ARM_SMMU_V3_PMU_PIXEL
	 tristate "ARM SMMUv3 Performance Monitors Extension"
	 depends on ARM64 || (COMPILE_TEST && 64BIT)
	 depends on GENERIC_MSI_IRQ
	   help
	   Provides support for the ARM SMMUv3 Performance Monitor Counter
	   Groups (PMCG), which provide monitoring of transactions passing
	   through the SMMU and allow the resulting information to be filtered
	   based on the Stream ID of the corresponding master.
```

## google-modules/misc/examples/full/Documentation/devicetree/bindings/example/google,foo.yaml
```yaml
# SPDX-License-Identifier: GPL-2.0-only OR BSD-2-Clause
%YAML 1.2
---
$id: http://devicetree.org/schemas/example/foo.yaml#
$schema: http://devicetree.org/meta-schemas/core.yaml#

title: Example Foo Device

maintainers:
  - Example Maintainer <example@google.com>

properties:
  compatible:
    const: google,foo

required:
  - compatible

additionalProperties: false
```

## google-modules/misc/examples/full/drivers/example/Kconfig
```kconfig
# SPDX-License-Identifier: GPL-2.0-only

config EXAMPLE_FOO
	tristate "Example Foo Driver"
	help
	  This is an example foo driver that demonstrates Kleaf DDK capabilities.
	  It shows how to structure a driver, export APIs, and integrate
	  Device Tree bindings.

	  If unsure, say N.

config EXAMPLE_BAR
	tristate "Example Bar Driver"
	help
	  This is an example bar driver that depends on the foo driver.
	  It demonstrates inter-module dependencies and how to handle
	  optional dependencies using inline stubs when foo is disabled.

	  If unsure, say N.
```

## google-modules/misc/examples/kunit/Kconfig
```kconfig
config SAMPLE_KUNIT_EXAMPLE
	tristate "KUnit example module"
	help
	  This is an example of a KUnit module that demonstrates how to use
	  ddk_module and KUNIT_STATIC_STUB_REDIRECT for function mocking.
	  It provides a simple API that can be used to understand the KUnit
	  integration.

	  If unsure, say N.
```

## google-modules/misc/examples/kunit/test/Kconfig
```kconfig
# SPDX-License-Identifier: GPL-2.0-only

config SAMPLE_KUNIT_EXAMPLE_TEST
	tristate "KUnit test for kunit_example" if !KUNIT_ALL_TESTS
	depends on SAMPLE_KUNIT_EXAMPLE && KUNIT
	default KUNIT_ALL_TESTS
	help
	  This builds unit tests for the kunit_example module.
	  It demonstrates how to mock internal functions using static stubs.
	  The tests cover both real and mocked implementations of the internal
	  logic via the public API.

	  If unsure, say N.
```

## google-modules/misc/examples/minimal/Kconfig
```kconfig
# SPDX-License-Identifier: GPL-2.0-only
config SAMPLE_MINIMAL_C
	tristate "Minimal C sample"
	help
	  This is a minimal sample of a C kernel module. It demonstrates the
	  basic structure of an out-of-tree kernel module built with Kleaf,
	  including basic module init and exit functions.

	  If unsure, say N.
```

## google-modules/misc/examples/rust_minimal/Kconfig
```kconfig
config SAMPLE_RUST_MINIMAL
	tristate "Rust minimal sample"
	help
	  This is a minimal sample of a Rust kernel module that demonstrates
	  how to use ddk_module with Rust source files in the Kleaf build
	  system. It provides a basic starting point for Rust development.

	  If unsure, say N.
```

## google-modules/misc/h2omg/Documentation/devicetree/bindings/h2omg/google,h2omg.yaml
```yaml
# SPDX-License-Identifier: (GPL-2.0 OR BSD-2-Clause)
# Copyright 2024 Google LLC
%YAML 1.2
---
$id: http://devicetree.org/schemas/h2omg/google,h2omg.yaml#
$schema: http://devicetree.org/meta-schemas/core.yaml#

title: Google Water Intrusion Detection Driver

maintainers:
  - James Wylder <jwylder@google.com>

description: |
  This describes the device tree I2C bindings for the H2OMG chip.

properties:
  compatible:
    const: google,h2omg

  h2omg_irq-gpios:
    description:
       Gpio used for interrupts.

  control:
    description:
       Eight bit value providing initial startup configuration.
       See go/h2omg for chip dependent settings.

  dual-trigger:
    description:
       When this is set, the fuse will only be blown when both sensor
       inputs detect water.

  trigger_delay_ms:
    description:
       When dual-trigger is set and this is set to a value greater
       than 10 ms, the fuse will blow if both sensors detect water
       at the same time, or if one sensor is continuously wet for the
       duration specified by the timer.

  vref_div:
    description:
       When this is set, it indicates the board has a divider on the
       vref line.  The configuration needs to use a lower comparator
       voltage setting.

required:
  - compatible

examples:
  - |
    h2omg: h2omg@70 {
        reg = <0x70>;

        compatible = "google,h2omg";

        control = /bits/ 8 <0x4f>;

        pinctrl-names = "default";
        pinctrl-0 = <&bg_cpm_alrt_od_l>;
        h2omg_irq-gpios = <BG_CPM_ALRT_OD_L(GPIO_ACTIVE_LOW)>;
    };
```

## google-modules/nfc/Documentation/devicetree/bindings/nfc/st,st21nfc.yaml
```yaml
# SPDX-License-Identifier: (GPL-2.0-only OR BSD-2-Clause)
# Copyright 2025 Google LLC
%YAML 1.2
---

$schema: http://devicetree.org/meta-schemas/core.yaml#

title: Google ST21NFC NFC Controller Driver

description: NFC driver for STMicroelectronics ST54K/L
maintainers:
  - George Chang <georgekgchang@google.com>

properties:
  compatible:
    type: string
    description: Compatible string for the device.
    const: "st,st21nfc"

  reg:
    description: I2C address of the device.

  reset-gpios:
    description: GPIO descriptor for the Reset line.

  irq-gpios:
    description: GPIO descriptor for the IRQ line.

  pidle-gpios:
    description: GPIO descriptor for the PIDLE line.

  st,extpad_control_en:
    description: Flag to set whether to use external pad for clock control.

  st,clk_pinctrl_switch:
    description: Flag to set whether to use pinctrl for clock switching.

  st,pidle_active_check:
    description: Flag to enables active monitoring of power states using a delayed work queue.

  st,reduce-timeout:
    description: Flag to enables reduce the wakelock timeout for specific commands.

  pinctrl-names:
      type: array
      description: Names of pinctrl states.
      items:
          type: string
      default: ["default", "func"]

  pinctrl-0:
      type: array
      description: Pinctrl configuration for "default" state.

  pinctrl-1:
      type: array
      description: Pinctrl configuration for "func" state.


required:
  - compatible
  - reg
  - reset-gpios
  - irq-gpios

examples:
  - |
    st21nfc@8 {
      compatible = "st,st21nfc";
      reg = <0x08>;
      interrupt-parent = <&gdmc_pinctrl>; # Example interrupt parent
      reset-gpios = <&ap2nfc_chip_en_1v2 GPIO_ACTIVE_HIGH>; # Example GPIO specifier
      irq-gpios = <&nfc2ap_host_irq_1v2 GPIO_ACTIVE_HIGH>; # Example GPIO specifier
      pidle-gpios = <&nfc2ap_pwr_state_1v2 GPIO_ACTIVE_HIGH>; # Example GPIO specifier
      st,extpad_control_en;
      st,clk_pinctrl_switch;
      st,reduce-timeout;
      pinctrl-names = "default", "func";
      pinctrl-0 = <&nfc2ap_clk_req_1v2_sleep>, <&ap2nfc_clk_1v2_sleep>;
      pinctrl-1 = <&nfc2ap_clk_req_1v2>, <&ap2nfc_clk_1v2_func>;
      status = "ok"; # Example status, but not a property of the device itself.
    };
```

## google-modules/noa/common/Kconfig
```kconfig
# SPDX-License-Identifier: GPL-2.0-only
#
# Driver for NOA WiFi Driver
#

config NOA_SUPPORT
	tristate "Network offload accelerator driver"
	default n
	help
	  Enable NOA driver.

config NOA_WLAN_SUPPORT
	tristate "NOA WiFi Driver"
	depends on NOA_SUPPORT
	default m
	help
	  NOA WiFi driver support.

config NOA_WLAN_BRCM_SUPPORT
	tristate "NOA BRCM WiFi Driver"
	depends on NOA_WLAN_SUPPORT
	default m
	help
	  NOA WiFi driver for BRCM chip support.

config NOA_WLAN_QCA_SUPPORT
	tristate "NOA QCA WiFi Driver"
	depends on NOA_WLAN_SUPPORT
	default m
	help
	  NOA WiFi driver for QCA chip support.

config NOA_MD_SUPPORT
	bool "NOA Modem Driver"
	depends on NOA_SUPPORT
	default y
	help
	  NOA MD driver support.

config NOA_MD_SAMSUNG_SUPPORT
	bool "NOA Samsung Modem Driver"
	depends on NOA_MD_SUPPORT
	default y
	help
	  NOA Samsung Modem driver support.

config NOA_MD_SAMSUNG_UL_SUPPORT
	bool "NOA Samsung Modem Uplink Driver"
	depends on NOA_MD_SUPPORT
	default y
	help
	  NOA Samsung Modem Uplink driver support.

config NOA_MD_SAMSUNG_DATA_PATH
	bool "NOA Samsung Data path"
	depends on NOA_MD_SAMSUNG_SUPPORT
	depends on !NOA_MD_MEDIATEK_T900_SUPPORT
	default y
	help
	  Data path implementation for Samsung platform.

config NOA_MD_MEDIATEK_SUPPORT
	bool "NOA Mediatek Modem Driver"
	depends on NOA_MD_SUPPORT
	depends on MTK_HOST_DRV_WWAN_SUPPORT
	default y
	help
	  NOA Mediatek Modem driver support.

config NOA_MD_MEDIATEK_DATA_PATH
	bool "NOA Mediatek data path"
	depends on NOA_MD_MEDIATEK_T900_SUPPORT
	default y
	help
	  Data path implementation for Mediatek T900 platform.

config NOA_MD_MEDIATEK_FULLSOC_SUPPORT
	bool "Support NOA Mediatek MD Full SoC mode"
	depends on NOA_MD_SUPPORT
	default n
	help
	  Enable Full SoC mode for Mediatek NOA modem driver.

config NOA_MD_MEDIATEK_COMMON_SUPPORT
	bool "NOA Mediatek Common Support"
	depends on NOA_MD_MEDIATEK_SUPPORT || NOA_MD_MEDIATEK_FULLSOC_SUPPORT
	default y
	help
	  Common codes for Mediatek platform.

config NOA_SIM_SUPPORT
	tristate "NOA Driver Mode Simulator Support"
	depends on NOA_SUPPORT
	default m
	help
	  NOA Driver Mode simulator support.

config NOA_FULLSOC_SUPPORT
	tristate "NOA FullSoC Mode Support"
	depends on NOA_SUPPORT
	default n
	help
	  NOA FullSoC mode support.

config NOA_WIFI_FW_V1
	tristate "NOA WiFi Firmware version 1"
	depends on NOA_SIM_SUPPORT
	default n
	help
	  NOA Driver Mode WiFi Firmware version 1.

config NOA_TETHERING_OFFLOAD_SUPPORT
	tristate "NOA Tethering Offload Driver"
	depends on NOA_SUPPORT
	default m
	help
	  NOA Tethering Offload driver support.

config NOA_VPN_OFFLOAD_SUPPORT
	tristate "NOA VPN Offload support"
	depends on NOA_TETHERING_OFFLOAD_SUPPORT && XFRM_OFFLOAD
	default n
	help
	  NOA VPN Offload support.

config NOA_SIM_VPN_OFFLOAD_SUPPORT
	tristate "NOA VPN Offload support in NOA Driver Mode Simulator"
	depends on NOA_SIM_SUPPORT && NOA_TETHERING_OFFLOAD_SUPPORT && XFRM_OFFLOAD
	default n
	help
	  NOA VPN Offload support in NOA driver mode simulator.

config NOA_WLAN_PACKET_SNIFFER_SUPPORT
	tristate "NOA WLAN Packet Sniffer support"
	depends on NOA_WLAN_SUPPORT
	default m
	help
	  NOA WLAN Packet Sniffer support.

config NOA_NETWORK_PIPELINE_SERVICE
	tristate "NOA Network Pipeline Service"
	depends on NOA_SIM_SUPPORT
	default m
	help
	  Enable the Network Pipeline Service Architecture on NOA system.

config NOA_NETWORK_PIPELINE_SERVICE_WITH_NESTED_RING
	tristate "NOA Network Pipeline Service with Nested Ring"
	depends on NOA_SIM_SUPPORT
	default m
	help
	  Enable the Nested Ring based pipeline service on NOA system.

config NOA_PPF_SUPPORT
	tristate "NOA Pixel Packet Filter support"
	depends on NOA_SUPPORT
	default m
	help
	  NOA Pixel Packet Filter support.

config NOA_RING_MANAGER_SUPPORT
	tristate "NOA Ring Manager"
	depends on NOA_SUPPORT
	default m
	help
	  Enable the Ring Manager on NOA system.

config NOA_PCIE_SUPPORT
	tristate "NOA PCIe Interface"
	default n
	help
	  Enable the PCIe interface on NOA system.

config NOA_POWER_SAVING
    bool "Enable Noa Power Saving feature"
    default y
    help
      Enable the NOA Power Saving.

config NOA_TEST_HARNESS
	tristate "NOA Test Harness"
	depends on NOA_FULLSOC_SUPPORT
	default n
	help
	  Enable this option to build the test harness, a simple
	  virtual network driver for NOA performance testing.
```
