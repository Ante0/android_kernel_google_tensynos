## google-modules/soc/rdo/Documentation/devicetree/bindings/pmic/google,da9186-gpio.yaml
```yaml
# SPDX-License-Identifier: (GPL-2.0-only OR BSD-2-Clause)
# Copyright 2023 Google LLC
%YAML 1.2
---
$id: http://devicetree.org/schemas/pmic/google,da9186-gpio.yaml#
$schema: http://devicetree.org/meta-schemas/core.yaml#

title: Dialog Semiconductor DA9186 PMIC GPIO driver

maintainers:
  - Ryan Chu <cychu@google.com>

description: |
  This binding describes the Pinctrl and GPIO instance inside the DA9186/7 PMIC.
  Since PMIC GPIO only got GPIO functionality, pinctrl is for switching
  pin config (input / output / bias).
  The pin function / pin mux are fixed to GPIO only.

properties:
  compatible:
    const: google,da9186-gpio

  mba-dest-channel:
    $ref: /schemas/types.yaml#/definitions/uint32-array
    description: The mailbox tx destination channel.
    maxItems: 1

  mboxes:
    description: A mailbox phandle and rx channel specifier.
    maxItems: 1

  gpio-controller: true

  "#gpio-cells":
    const: 2
    description: |
      The first cell is the pin number and the second cell is used to specify
      optional parameters.

  ngpio:
    $ref: /schemas/types.yaml#/definitions/uint32
    description: The number of GPIO pins supported consecutively.
    minimum: 1
    maximum: 19

  gpio-line-names:
    description: Strings describing the names of each gpio line.
    minItems: 1
    maxItems: 19

  gpio-ranges:
    description: |
      This ties the pinctrl pin number to GPIO number.
      The format is: <[pin controller phandle], [GPIO controller offset],
                      [pin controller offset], [number of pins]>
      Also see these documents for generic binding information:
        GPIO : gpio.txt
        Pinctrl: pinctrl-bindings.txt
    maxItems: 1

required:
  - compatible
  - mba-dest-channel
  - mboxes
  - gpio-controller
  - '#gpio-cells'
  - ngpio
  - gpio-ranges

additionalProperties: false

examples:
  - |
    da9186_pinctrl: da9186-gpio {
        compatible = "google,da9186-gpio";
        mba-dest-channel = <10>;
        mboxes = <&mbactrl_ap_cpm 19>;

        gpio-controller;
        #gpio-cells = <2>;
        ngpios = <19>;
        gpio-line-names = "LED 0",
            "LED 1",
            "LED 2",
            "LED 3",
            "LED 4",
            "LED 5",
            "LED 6",
            "LED 7",
            "LED 8",
            "LED 9",
            "LED 10",
            "LED 11",
            "LED 12",
            "LED 13",
            "LED 14",
            "LED 15",
            "LED 16",
            "LED 17",
            "LED 18";
        gpio-ranges = <&da9186_pinctrl 0 0 19>;
    };
```

## google-modules/soc/rdo/Documentation/devicetree/bindings/pmic/google,da9186-regulator.yaml
```yaml
# SPDX-License-Identifier: (GPL-2.0-only OR BSD-2-Clause)
# Copyright 2023 Google LLC
%YAML 1.2
---
$id: http://devicetree.org/schemas/pmic/google,da9186-regulator.yaml#
$schema: http://devicetree.org/meta-schemas/core.yaml#

title: Dialog Semiconductor DA9186 PMIC Regulator

maintainers:
  - Ryan Chu <cychu@google.com>

description: |
  This binding describes the Regulator instance inside the DA9186/7 PMIC.

properties:
  compatible:
    const: google,da9186-regulator

  mba-dest-channel:
    $ref: /schemas/types.yaml#/definitions/uint32-array
    description: The mailbox tx destination channel.
    maxItems: 1

  mboxes:
    description: A mailbox phandle and rx channel specifier.
    maxItems: 1

  regulators:
    type: object
    properties:
      morro_m:
        description: List of regulators provided by DA9186.
        type: object
        patternProperties:
          "^(buck_([1-9]|10)m|ldo_([1-9]|1[0-9]|2[0-9]|3[0-1])m)$":
            type: object
            # As this file is not in the /common/Documentation/devicetree/
            # bindings/, so the regulator.yaml is not yet reachable.
            # $ref: ../regulator/regulator.yaml
            description:
              Properties for single buck/ldo regulator.
            properties:
              google,monitor-only:
                type: boolean
                description: |
                  Mark this regulator to only supports the read ops, not be
                  able to control or write. This avoids the conflict if the
                  regulator is already controlled by the other sources, or the
                  default state of the regulator should not be changed.
                  In default, all regulators are defined with this property
                  unless manual control is needed.
                  If this property is not defined, the driver can have full
                  control of the regulator.
              google,buck-rail:
                type: boolean
                description: |
                  Mark this to distinguish the regulator is BUCK or LDO. BUCK
                  and LDO have different factors while calculating telemetry
                  measurement. This property will be read to decide the factor.
            unevaluatedProperties: false

        additionalProperties: false

      morro_s:
        description: List of regulators provided by DA9187.
        type: object
        patternProperties:
          "^(buck_([1-9]|1[0-3])s|buck_boost|ldo_([1-9]|1[0-9]|2[0-8])s)$":
            type: object
            # As this file is not in the /common/Documentation/devicetree/
            # bindings/, so the regulator.yaml is not yet reachable.
            # $ref: ../regulator/regulator.yaml
            description:
              Properties for single buck/ldo regulator.
            properties:
              google,monitor-only:
                type: boolean
                description: |
                  Mark this regulator to only supports the read ops, not be
                  able to control or write. This avoids the conflict if the
                  regulator is already controlled by the other sources, or the
                  default state of the regulator should not be changed.
                  In default, all regulators are defined with this property
                  unless manual control is needed.
                  If this property is not defined, the driver can have full
                  control of the regulator.
            unevaluatedProperties: false

        additionalProperties: false

    additionalProperties: false

required:
  - compatible
  - mba-dest-channel
  - mboxes
  - regulators

additionalProperties: false

examples:
  - |
    da9186_regulator: da9186-regulator {
        compatible = "google,da9186-regulator";
        mba-dest-channel = <10>;
        mboxes = <&mbactrl_ap_cpm 10>;

        regulators {
            morro_m {
                morro_buck_1m_reg: buck_1m {
                    regulator-name = "buck_1m";
                    regulator-min-microvolt = <450000>;
                    regulator-max-microvolt = <1400000>;
                    regulator-ramp-delay = <25000>;
                    regulator-enable-ramp-delay = <63>;
                    regulator-allowed-modes = <2 8>;
                    google,monitor-only;
                };
                morro_ldo_1m_reg: ldo_1m {
                    regulator-name = "ldo_1m";
                    regulator-min-microvolt = <450000>;
                    regulator-max-microvolt = <1400000>;
                    regulator-ramp-delay = <25000>;
                    regulator-enable-ramp-delay = <200>;
                    google,monitor-only;
                };
            };
            morro_s {
                morro_buck_13s_reg: buck_13s {
                    regulator-name = "buck_13s";
                    regulator-min-microvolt = <450000>;
                    regulator-max-microvolt = <1400000>;
                    regulator-ramp-delay = <25000>;
                    regulator-enable-ramp-delay = <63>;
                    regulator-allowed-modes = <2 8>;
                    schematic-name = "UFS_VCCQ";
                };
                morro_ldo_1s_reg: ldo_1s {
                    regulator-name = "ldo_1s";
                    regulator-min-microvolt = <450000>;
                    regulator-max-microvolt = <1400000>;
                    regulator-ramp-delay = <25000>;
                    regulator-enable-ramp-delay = <200>;
                    schematic-name = "AVDD075_MIPI_DSI";
                };
            };
        };
    };
```

## google-modules/soc/rdo/Documentation/devicetree/bindings/pmic/google,da9186-rtc.yaml
```yaml
# SPDX-License-Identifier: (GPL-2.0-only OR BSD-2-Clause)
# Copyright 2023 Google LLC
%YAML 1.2
---
$id: http://devicetree.org/schemas/pmic/google,da9186-rtc.yaml#
$schema: http://devicetree.org/meta-schemas/core.yaml#

title: Dialog Semiconductor DA9186 PMIC RTC

maintainers:
  - Ryan Chu <cychu@google.com>

description: |
  This binding describes the RTC instance inside the DA9186 PMIC.

properties:
  compatible:
    const: google,da9186-rtc

  mba-dest-channel:
    $ref: /schemas/types.yaml#/definitions/uint32-array
    description: The mailbox tx destination channel.
    maxItems: 1

  mboxes:
    description: A mailbox phandle and rx channel specifier.
    maxItems: 1

required:
  - compatible
  - mba-dest-channel
  - mboxes

additionalProperties: false

examples:
  - |
    da9186-rtc {
        compatible = "google,da91186-rtc";
        mba-dest-channel = <10>;
        mboxes = <&mbactrl_ap_cpm 11>;
    };
```

## google-modules/soc/rdo/Documentation/devicetree/bindings/pmic/google,da9186-vgpio.yaml
```yaml
# SPDX-License-Identifier: (GPL-2.0-only OR BSD-2-Clause)
# Copyright 2023 Google LLC
%YAML 1.2
---
$id: http://devicetree.org/schemas/pmic/google,da9186-vgpio.yaml#
$schema: http://devicetree.org/meta-schemas/core.yaml#

title: Dialog Semiconductor DA9186 PMIC Virtual GPIO driver

maintainers:
  - Ryan Chu <cychu@google.com>

description: |
  This binding describes the virtual GPIO instance inside the DA9186/7 PMIC.
  The virtual GPIO (vGPIO) only have the output capability, and it's normally
  used to control / trigger some internal PMIC features, not containing the HW
  IO wire that output signals.

properties:
  compatible:
    const: google,da9186-vgpio

  mba-dest-channel:
    $ref: /schemas/types.yaml#/definitions/uint32-array
    description: The mailbox tx destination channel.
    maxItems: 1

  mboxes:
    description: A mailbox phandle and rx channel specifier.
    maxItems: 1

  gpio-controller: true

  "#gpio-cells":
    const: 2
    description: |
      The first cell is the pin number and the second cell is used to specify
      optional parameters.

  ngpio:
    $ref: /schemas/types.yaml#/definitions/uint32
    description: The number of GPIO pins supported consecutively.
    minimum: 1
    maximum: 31

  gpio-line-names:
    description: Strings describing the names of each gpio line.
    minItems: 1
    maxItems: 31

required:
  - compatible
  - mba-dest-channel
  - mboxes
  - gpio-controller
  - '#gpio-cells'
  - ngpio

additionalProperties: false

examples:
  - |
    da9186_pinctrl: da9186-vgpio {
        compatible = "google,da9186-vgpio";
        mba-dest-channel = <10>;
        mboxes = <&mbactrl_ap_cpm 20>;

        gpio-controller;
        #gpio-cells = <2>;
        ngpios = <31>;
        gpio-line-names = "LED 0",
            "LED 1",
            "LED 2",
            "LED 3";
    };
```

## google-modules/soc/rdo/Documentation/devicetree/bindings/pmic/google,da9186.yaml
```yaml
# SPDX-License-Identifier: (GPL-2.0-only OR BSD-2-Clause)
# Copyright 2023 Google LLC
%YAML 1.2
---
$id: http://devicetree.org/schemas/pmic/google,da9186.yaml#
$schema: http://devicetree.org/meta-schemas/core.yaml#

title: Dialog Semiconductor DA9186/7 Power Management IC

maintainers:
  - Ryan Chu <cychu@google.com>

description: |
  This describes the DA9186/7 System PMIC pair device tree MFD bindings for the
  SoC platform.

  The DA9186 PMIC consists of:
  Device             Description
  ------             -----------
  da9186-regulator  : LDOs & BUCKs
  da9186-rtc        : Real-Time Clock
  da9186-gpio       : GPIOs

  The DA9187 PMIC consists of:
  Device             Description
  ------             -----------
  da9186-regulator  : LDOs & BUCKs
  da9186-gpio       : GPIOs

  This MFD driver provides the interface to communicate to the DA9186/7 PMICs.

  The following documents are the sub-nodes that uses this MFD driver:
    [1] Regulator: google,da9186-regulator.yaml
    [2] RTC:  google,da9186-rtc.yaml
    [3] GPIO:  google,da9186-gpio.yaml

properties:
  compatible:
    const: google,da9186mfd

required:
  - compatible

unevaluatedProperties: false

examples:
  - |
    da9186mfd: da9186mfd {
        compatible = "google,da9186mfd";
    };
```

## google-modules/soc/rdo/Documentation/devicetree/bindings/powerdashboard/google,powerdashboard.yaml
```yaml
# SPDX-License-Identifier: (GPL-2.0-only OR BSD-2-Clause) Copyright 2025 Google
# LLC
%YAML 1.2 --- $id: http://devicetree.org/schemas/pinctrl/google,pinctrl.yaml#
$schema: http://devicetree.org/meta-schemas/core.yaml#

title: Google PowerDashboard

maintainers: - Konrad Korczynski <kkorczynski@google.com>

description: Defines the powerdashboard configurations.

properties:
  compatible:
    description:
      Defines the platform/version of power controller.
    values:
      - "google,power-dashboard

  mba-dest-channel:
    description:
      CPM mailbox channel

  mboxes:
    description:
      Phandle reference to the CPM mailbox

  sampling-rate-us:
    description:
      CPM read sampling period given in microseconds.

required:
  - compatible
  - mboxes
  - sampling-rate-us

Example:
	powerdashboard: powerdashboard {
		compatible = "google,power-dashboard";
		mba-dest-channel = <MBOX_DEST_CHAN_POWERDASHBOARD>;
		mboxes = <&goog_mba_cpm_iface>;
		sampling-rate-us = <100000>;
	};
```

## google-modules/soc/rdo/Documentation/devicetree/bindings/pwm/pwm-faraday.yaml
```yaml
# SPDX-License-Identifier: (GPL-2.0-only OR BSD-2-Clause)
# Copyright 2023 Google LLC
%YAML 1.2
---
$id: http://devicetree.org/schemas/pwm/pwm-faraday.yaml#
$schema: http://devicetree.org/meta-schemas/core.yaml#

title: Faraday FTPWMTMR010 PWM Controller

maintainers:
  - Rohit Ner <rohitner@google.com>

description:
  Supports AMBA 2.0 APB bus
  Supports up to 8 independent 32-bit timers
  Selects internal or external clock source for each timer
  Supports PWM function to generate each timer
  Programmable duty control and polarity of PWM
  Supports auto-reload mode and one-shot pulse mode
  Dead-zone generator on PWM outputs
  Supports timer based on DMA transfer request

allOf:
  - $ref: pwm.yaml#

properties:
  compatible:
    const: faraday,ftpwmtmr010

  reg:
    maxItems: 1

  clocks:
    description:
      Specifies the reference clock(s) from which
      the output frequency is derived. Must contain an entry
      for each entry in clock-names.
    minItems: 1
    maxItems: 2

  clock-names:
    description:
      Includes the following entries
        - pclk: system interface clock
        - ext_clk: external clock (optional)
    minItems: 1
    maxItems: 2

  interrupts-extended:
    description: One interrupt per channel
    maxItems: 1

  "#pwm-cells":
    description:
      Number of cells in a PWM specifier.
    const: 2

required:
  - compatible
  - reg
  - interrupts-extended
  - clocks
  - clock-names

additionalProperties: false

examples:
  - |
    pwm_ctrl@3bd90000 {
      compatible = "faraday,ftpwmtmr010";
      reg = <0x0 0x3bd90000 0x0 0x50>;
      interrupts-extended = <&gia_lsios_hier 0 8>,
                            <&gia_lsios_hier 0 9>,
                            <&gia_lsios_hier 0 10>,
                            <&gia_lsios_hier 0 11>;
      clocks = <&pclk>, <&ext_clk>;
      clock-names = "pclk", "ext_clk";
      #pwm-cells = <2>;
    };
```
