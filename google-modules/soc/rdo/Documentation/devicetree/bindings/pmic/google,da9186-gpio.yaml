## google-modules/soc/rdo/Documentation/devicetree/bindings/spmi/smartdv,spmi-sdvt.yaml
```yaml
# SPDX-License-Identifier: GPL-2.0-only
%YAML 1.2
---
$id: http://devicetree.org/schemas/spmi/smartdv,spmi-sdvt.yaml#
$schema: http://devicetree.org/meta-schemas/core.yaml#

title: SmartDV IP Solutions SPMI Controller

maintainers:
  - Vamshi Gajjela <vamshigajjela@google.com>

description: |
  Supports 2.0 and 1.0 MIPI SPMI Specification
  Full MIPI SPMI Master functionality
  Supports Command, Data/Address and No Response Frames
  Supports ACK/NACK as per 2.0 specs
  Supports transfer Bus Ownership Command Sequence.
  Supports Connect/Disconnect Sequence.
  Support Master priority arbitration
  Supports extended register read/writes
  Supports wakeup command
  Authentication Command Sequence
  Device Descriptor Block command Sequences

allOf:
  - $ref: spmi.yaml#

properties:

  $nodename:
    pattern: "spmi@[0-9a-f]"

  compatible:
    oneOf:
      - const: smartdv,spmi
  reg:
    maxItems: 1

  clocks:
    description: |
      Core clock to the controller from which scl is derived. Optional if
      controller has a free running clock, but need to provide the
      frequency in Hz using clock-frequency.
    maxItems: 1

  resets:
    description: |
      Controller exclusive reset, an optional property.
    maxItems: 1

  clock-frequency:
    description: |
      Supply clock-frequency in Hz, if it's a free running clock to the
      controller or when clk_get_rate doesn't work.

  interrupts-extended:
    description: |
      One interrupt per channel. If not provided operates in polling mode.
    maxItems: 1

  master-arb-en:
    $ref: /schemas/types.yaml#/definitions/uint32
    description: |
      Master arbitration is disabled by default, pass 1 to enable.

  master-id:
    $ref: /schemas/types.yaml#/definitions/uint32
    description: |
      Master id for the controller on the bus. Default is 0, 1-3 are valid
      values, as only 4 master controllers or allowed on a bus.

  spmi-ver:
    $ref: /schemas/types.yaml#/definitions/uint32
    description: |
      MIPI SPMI Spec version 0/1 to choose for the transfer.
      Default value is 0 indicatng version 1.0

  arb-retry-limit:
    $ref: /schemas/types.yaml#/definitions/uint32
    description: |
      Master arbitration retry limit. 0-255 are allowed values. Number of
      times master will retry a command when master loses arbitration.

  prescalar:
    $ref: /schemas/types.yaml#/definitions/uint32
    description: |
      Divider value to generate SPMI SCL from input core clock.
      Input clock is divided with this value to drive the o_spmi_scl clock.
      Writing to this register divides the system clock by 2, similarly for
      the value "n", it divides the system clock by "n*2".
      0-255 are allowed values.

  read-latancy:
    $ref: /schemas/types.yaml#/definitions/uint32
    description: |
      Read latancy, this value is used to pause the SCL while reading the
      data from the master/slave. 0-255 are allowed values.

  arb-scl-delay:
    $ref: /schemas/types.yaml#/definitions/uint32
    description: |
      Controls the delay between arbitration and SSC delay.
      0-3 are allowed values.

required:
  - compatible
  - reg

patternProperties:
  "@[0-9a-f]$":
    type: object

    description: |
      PMIC properties, which are specific to the used SPMI PMIC device(s).

unevaluatedProperties: false

examples:
  - |
    bus {
      #address-cells = <2>;
      #size-cells = <2>;

      spmi: spmi@fff24000 {
        compatible = "google,sdvt-spmi";
        #address-cells = <2>;
        #size-cells = <0>;
        reg = <0x0 0xfff24000 0x0 0x1000>;

        pmic@0 {
          reg = <0 0>;
          /* pmic properties */
        };
      };
    };
```

## google-modules/soc/rdo/Documentation/devicetree/bindings/thermal/google,devfreq-tj-cdev.yaml
```yaml
# SPDX-License-Identifier: (GPL-2.0-only OR BSD-2-Clause)
# Copyright 2025 Google LLC
%YAML 1.2
---
$id: http://devicetree.org/schemas/thermal/google,devfreq-tj-cdev.yaml#
$schema: http://devicetree.org/meta-schemas/core.yaml#

title: Google devfreq tj cooling device

maintainers:
  - Ram Chandrasekar <rchandrasekar@google.com>

description: |
  Certain Tj monitoring is done in firmware and then the mitigation action
  is passed on to kernel to place the mitigation. The target device that
  will receive this mitigation will use devfreq framework for DVFS. Use this
  driver to receive the mitigation action from firmware and translate it
  to devfreq qos request.

properties:
  compatible:
    const: google,devfreq-tj-cdev

  "thermal-hw-cdev-id":
    maxItems: 1
    description:
      The Cooling device ID as defined in the below header,
      "dt-bindings/soc/google/google-thermal-def.h".

  "thermal-devfreq":
    maxItems: 1
    description:
      A phandle that needs to be used to search for the devfreq handle.
      The QOS request will be placed to this devfreq client.

  required:
    - compatible
    - "thermal-hw-cdev-id"
    - "thermal-devfreq"

additionalProperties: false

examples:
  - |
        thermal_devfreq_cdev {
              compatible = "google,devfreq-tj-cdev";
              thermal-hw-cdev-id = <HW_DT_CDEV_GPU>;
              thermal-devfreq = <&gpu>;
        };
```

## google-modules/soc/rdo/Documentation/devicetree/bindings/thermal/google,ntc-thermal.yaml
```yaml
# SPDX-License-Identifier: (GPL-2.0-only OR BSD-2-Clause)
# Copyright 2024 Google LLC
%YAML 1.2
---
$id: http://devicetree.org/schemas/thermal/google,ntc-thermal.yaml#
$schema: http://devicetree.org/meta-schemas/core.yaml#

title: Google NTC thermistor driver

maintainers:
  - Ram Chandrasekar <rchandrasekar@google.com>

description: |
  PMIC MFD has telemetry block, which has support for NTC thermistors.
  These thermistors are placed in different locations, for thermal driver
  to monitor the skin temperature or a device temperature. This drivers,
  configures this hardware, registers each channel/thermistor as a
  thermal zone with support to configure threshold and receive interrupts.

properties:
  compatible:
    const: google,ntc-thermal

  "#thermal-sensor-cells":
    const: 1
    description:
      Number of cells required to uniquely identify the thermal sensors.
      Since we have multiple thermistor channels/sensors, this is sent to 1.

  "filter-spurious-samples":
    type: boolean
    description:
      When specified, it enables the software filtering of extremely high
      temperature readings. This extremely high temperatures are filtered
      for a predefined amount of time and the last valid reading will be
      returned. After the predefined time, if the high temp persists, it
      will not be filtered. This feature only filters the instantaneous
      temperature readings.

  "enable-hw-lpf":
    type: boolean
    description:
      When specified, it enables the reading of hardware averaged or low
      pass filtered temperature reading. The default behavior is to read
      the instantaneous temperature reading.

  required:
    - compatible
    - "#thermal-sensor-cells"

additionalProperties: false

examples:
  - |
	ntc_thermal: ntc_thermal {
		compatible = "google,ntc-thermal";
		#thermal-sensor-cells = <1>;
                filter-spurious-samples;
                enable-hw-lpf;
	};
```

## google-modules/soc/rdo/Documentation/devicetree/bindings/thermal/google,thermal_cpm_mbox.yaml
```yaml
# SPDX-License-Identifier: (GPL-2.0-only OR BSD-2-Clause)
# Copyright 2024 Google LLC
%YAML 1.2
---
$id: http://devicetree.org/schemas/thermal/google,thermal_cpm_mbox.yaml#
$schema: http://devicetree.org/meta-schemas/core.yaml#

title: Google Thermal cpm mbox driver

maintainers:
  - Ram Chandrasekar <rchandrasekar@google.com>
  - Henry Hsiao <pinhsinh@google.com>
  - Jikai Ma <jikai@google.com>

description: |
    This driver provide mailbox interface for different thermal
	  functionalities. It provide send message and send request to
	  CPM, and it also provide RX callback when CPM send a message
	  to thermal service.

properties:
  compatible:
    const: thermal-cpm-mbox

  mba-dest-channel:
    desscription: The mailbox tx destination channel

  mboxes:
    description: phandle reference to the CPM mailbox

  required:
    - compatible
    - mba-dest-channel
    - mboxes

additionalProperties: false

examples:
  - |
	thermal_cpm_mbox {
		compatible = "thermal-cpm-mbox";
		mba-dest-channel = <MBOX_DEST_CHAN_THERMAL_V2>;
		mboxes = <&goog_mba_cpm_iface>;
	};
```

## google-modules/soc/rdo/Documentation/devicetree/bindings/thermal/google,tmu-stats.yaml
```yaml
# SPDX-License-Identifier: (GPL-2.0-only OR BSD-2-Clause)
# Copyright 2025 Google LLC
%YAML 1.2
---
$id: http://devicetree.org/schemas/thermal/google,tmu-thermal.yaml#
$schema: http://devicetree.org/meta-schemas/core.yaml#

title: Google thermal stats driver

maintainers:
  - Jikai Ma <jikai@google.com>

description: |
  Thermal stats includes temperature residency and daily max/min temperature.
  Stats data of HW thermal zones is maintained locally and exchanged with kernel
  via shared memory. This driver communicates with hardware and registers HW
  thermal zones to the kernel Pixel Metrics driver and provides callback
  functions to retrieve and configure stats data of HW thermal zones.

properties:
  compatible:
    const: google,tmu-stats

  group-name:
    description:
      Group name that this driver uses to register HW thermal zones.

additionalProperties: false

examples:
  - |
    tmu_stats: tmu_stats {
      compatible = "google,tmu-stats";
      group-name = "tmu";
    };
```

## google-modules/soc/rdo/Documentation/devicetree/bindings/thermal/google,tmu-thermal.yaml
```yaml
# SPDX-License-Identifier: (GPL-2.0-only OR BSD-2-Clause)
# Copyright 2025 Google LLC
%YAML 1.2
---
$id: http://devicetree.org/schemas/thermal/google,tmu-thermal.yaml#
$schema: http://devicetree.org/meta-schemas/core.yaml#

title: Google TMU driver

maintainers:
  - Jikai Ma <jikai@google.com>

description: |
  TMU driver manages sensors, governors and cooling devices of hardware thermal
  zones. The relevant thermal zone devices in kernel are only for monitoring and
  configuring purposes. This driver registers hardware thermal zones with support
  of messages between kernel and TMU hardware.

  Configuration properties of a specific TMU HW thermal zone need to be defined
  inside the relevant thermal zone.

properties:
  compatible:
    const: google,tmu-thermal

  "#thermal-sensor-cells":
    const: 1
    description:
      Number of cells required to uniquely identify the thermal sensors.
      Since we have multiple thermistor channels/sensors, this is sent to 1.

  tmu:
    type: object
    description:
      This node describes a set of properties of TMU HW thermal zone configuration.
      This node should be defined inside the relevant thermal zone devicetree definition.

        properties:
          polling-delay-on:
            type: uint32
            description:
              Polling cycle delay of the TMU HW Tj loop in milliseconds.

        properties:
          pi-enable:
            type: boolean
            description:
              Property that turns on and off the PI governor.

        properties:
          k-po:
            type: int32
            description:
              PI parameter K_P in overshoot condition.

        properties:
          k-pu:
            type: int32
            description:
              PI parameter K_P in undershoot condition.

        properties:
          k-i:
            type: int32
            description:
              PI parameter K_I.

        properties:
          early-throttle-enable:
            type: boolean
            description:
              Property that turns on and off the early throttle feature.

        properties:
          early-throttle-k-p:
            type: int32
            description:
              Early throttle parameter K_P.

        properties:
          irq-gradual-gain:
            type: int32
            description:
              Gain of the gradual governor in irq condition.

        properties:
          timer-gradual-gain:
            type: int32
            description:
              Gain of the gradual governor in timer elapsed condition.

        properties:
          hardlimit-via-pid-enable:
            type: boolean
            description:
              Property that turns on and off the hard limit via pid feature.

        properties:
          temp-lut-enable:
            type: boolean
            description:
              Property that turns on and off the temperature look-up table feature.

        properties:
          junction-offset:
            type: int32 array
            description:
              A set of trip point offsets which are applied and released by the
              smooth transition feature. Offsets should be in milli degree celsius,
              and number of the offsets should align with the number of trips in
              the thermal zone.

  required:
    - compatible
    - "#thermal-sensor-cells"

additionalProperties: false

examples:
  - |
    tmu: tmu_thermal {
      compatible = "google,tmu-thermal";
      #thermal-sensor-cells = <1>;
    };

    thermal-zones {
      thermal_0: BIG {
        /* ... */
        tmu {
          polling-delay-on = <25>;

          /* PI control param */
          pi-enable;
          k-po = <60>;
          k-pu = <60>;
          k-i = <50>;

          /* early throttle param */
          early-throttle-enable;
          early-throttle-k-p = <50>;

          /* temp lut param */
          temp-lut-enable;

          /* gradual param */
          irq-gradual-gain = <2>
          timer-gradual-gain = <1>;

          /* Tj control offset - mC */
          junction-offset = <0 (-10000) (-10000) (-10000) 0 0 0 0>; // mC
        };
      };
    };
```
