## google-modules/soc/rdo/Documentation/devicetree/bindings/qos_box/google,qos_box_core.yaml
```yaml
# SPDX-License-Identifier: (GPL-2.0-only OR BSD-2-Clause)
# Copyright 2024 Google LLC
%YAML 1.2
---
$id: http://devicetree.org/schemas/qos_box/google,qos_box_core.yaml#
$schema: http://devicetree.org/meta-schemas/core.yaml#

title: Google QoS box Core

maintainers:
  - Aaron Tian <aarontian@google.com>

description:
  The Google QoS box Core doesn't represent a real physical device, it is a container
  to all QoS box device instances and provides QoS box use-case APIs for other drivers
  to attach/detach its use-case requirements.

properties:
  compatible:
    enum:
      - google,qos-box-core

  "google,num_qos_box":
    $ref: /schemas/types.yaml#/definitions/uint32
    description: number of total QoS box device instances

  "google,num_use_case":
    $ref: /schemas/types.yaml#/definitions/uint32
    description: number of QoS box use cases

  "google,use_case_prio":
    $ref: /schemas/types.yaml#/definitions/uint32-array
    minItems: 2
    description: an array of (use case index, use case priority) pairs to define
      priorities of each use case.

required:
  - compatible
  - "google,num_qos_box"
  - "google,num_use_case"
  - "google,use_case_prio"

additionalProperties: false

examples:
  - |
    qos_core: qos_box_core {
        compatible = "google,qos-box-core";
        google,num_qos_box = <QOS_BOX_IDX_TOTAL>;
        google,num_use_case = <1>;
        google,use_case_prio = <QOS_BOX_CASE_DEFAULT QOS_BOX_PRIORITY_DEFAULT>;
    };
```

## google-modules/soc/rdo/Documentation/devicetree/bindings/soc/google/cdd/google,cdd.yaml
```yaml
# SPDX-License-Identifier: (GPL-2.0-only OR BSD-2-Clause)
# Copyright 2024 Google LLC
%YAML 1.2
---
$id: http://devicetree.org/schemas/soc/google/gdmc/google,cdd.yaml#
$schema: http://devicetree.org/meta-schemas/base.yaml#

title: Google CDD (Crash Debug Dump)

maintainers:
  - Jone Chou <jonechou@google.com>

description:
  This binding describes the Google CDD interface, which allows
  access to the CDD header and log kevents' buffers.

properties:
  compatible:
    const: google,crash-debug-dump

  freq_names:
    type: string
    description: List the frequency domains which we want to trace.

  memory-region:
    maxItems: 2
    description: Introduce two reserved memory regions, cdd_header and log_kevents.

  panic-action:
    type: integer
    description: use to determine kernel panic reset type.

  wdt-handle:
    type: object
    description: phandle to `google,wdt` device node. This points to the Google WDT
                 operations which used by Google CDD to force watchdog reset.

required:
  - compatible
  - freq-names
  - memory-region
  - panic-action
  - wdt-handle

additionalProperties: false

examples:
  - |
    gcdd: gcdd {
        compatible = "google,crash-debug-dump";
        freq-names = "LIT", "MID0", "MID1", "BIG";
        memory-region = <&cdd_header>, <&log_kevents>;
        panic-action = <GO_DEFAULT_ID>;
        wdt-handle = <&wdt1>;
    };
```

## google-modules/soc/rdo/Documentation/devicetree/bindings/soc/google/gdmc/google,gdmc-tracepoint-v2.yaml
```yaml
# SPDX-License-Identifier: (GPL-2.0-only OR BSD-2-Clause)
# Copyright 2022 Google LLC
%YAML 1.2
---
$id: http://devicetree.org/schemas/soc/google/gdmc/google,gdmc-tracepoint-v2.yaml#
$schema: http://devicetree.org/meta-schemas/base.yaml#

title: Google GDMC Tracepoint

maintainers:
  - Daniel Kurtz <djkurtz@google.com>

description:
  This binding describes the Google GDMC tracepoint interface, which allows
  access to the GDMC (Google Debug MicroController) tracepoint buffer.

properties:
  compatible:
    const: google,gdmc-tracepoint-v2

  memory-region:
    maxItems: 1
    description:
      DMA buffer between host and GDMC.  Allocated memory must be mappable by
      the GDMC.

  gdmc-iface:
    type: object
    description: phandle to `google,mba-gdmc-iface` device node.
      This points to the GDMC MBA interface over which GDMC
      tracepoint talks to the GDMC.

required:
  - compatible
  - memory-region
  - gdmc-iface

additionalProperties: false

examples:
  - |
    gdmc_tracepoint_v2: gdmc_tracepoint_v2 {
        compatible = "google,gdmc-tracepoint-v2";
        memory-region = <&gdmc_tracepoint_dma_buff>;
        gdmc-iface = <&goog_mba_gdmc_iface>;
    };
```

## google-modules/soc/rdo/Documentation/devicetree/bindings/soc/google/gdmc/google,mba-gdmc-iface-test.yaml
```yaml
# SPDX-License-Identifier: (GPL-2.0-only OR BSD-2-Clause)
# Copyright 2024 Google LLC
%YAML 1.2
---
$id: http://devicetree.org/schemas/mailbox/google,mba-gdmc-iface-test.yaml#
$schema: http://devicetree.org/meta-schemas/base.yaml#

title: Google MBA (MailBox Array) GDMC Interface Test

maintainers:
  - Lucas Wei <lucaswei@google.com>
  - Subhash Jadavani <sjadavani@google.com>
  - Swati Maroo <maroo@google.com>

description:
  The Google MailBox Array GDMC interface test provides capability to test the GDMC services APIs.
  It exposes two different test scenarios, single threaded ping test using sync and async mode and
  multi-threaded ping test using sync and async mode using the normal priority GDMC channels.

properties:
  compatible:
    enum:
      - google,mba-gdmc-iface-test

  gdmc-iface:
    description:
      Reference to the GDMC node.
    maxItems: 1

required:
  - compatible
  - "gdmc-iface"

additionalProperties: false

examples:
  - |
	goog_mba_gdmc_iface_test: goog_mba_gdmc_iface_test {
		compatible = "google,mba-gdmc-iface-test";
		gdmc-iface = <&goog_mba_gdmc_iface>;
	};
```

## google-modules/soc/rdo/Documentation/devicetree/bindings/soc/google/google,mba-aggr.yaml
```yaml
# SPDX-License-Identifier: (GPL-2.0-only OR BSD-2-Clause)
# Copyright 2022 Google LLC
%YAML 1.2
---
$id: http://devicetree.org/schemas/mailbox/google,mba-aggr.yaml#
$schema: http://devicetree.org/meta-schemas/base.yaml#

title: Google MBA (MailBox Array) Aggregator

maintainers:
  - Lucas Wei <lucaswei@google.com>
  - Subhash Jadavani <sjadavani@google.com>

description:
  goog-mba-aggr module is used to aggregate the request and response mailbox
  channels of certain logical groups and expose interface APIs to upper layers
  which abstracts the details of mailbox channels.

  Clients bind a group of channel in device tree and later call to get `struct
  goog_mba_aggr_service` for further transaction through APIs provided by
  goog-mba-aggr module.

properties:
  compatible:
    enum:
      - google,mba-aggr

  "service-name":
    type: string
    description: Custom name for the aggregator instance.

  "mboxes":
    type: object
    description: Mailbox Channels provided by Google MBA controller driver(compatible
      with "google,mba-ctrl").

  "req-mboxes-idx":
    type: array
    description: a bunch of index in `mboxes` property which are used for request
      purpose(client initiated transaction).

  "resp-mboxes-idx":
    type: array
    description: a bunch of index in `mboxes` property which are used for response
      purpose(remote host initiated transaction).

  "payload-size":
    type: integer
    description: the size of mailbox payload buffer in words (one word is 4-bytes).

required:
  - compatible
  - "service-name"
  - "mboxes"
  - "req-mboxes-idx"
  - "resp-mboxes-idx"
  - "payload-size"

additionalProperties: false

examples:
  - |
    goog_mba_aggr_gdmc: goog_mba_aggr_gdmc {
        compatible = "google,mba-aggr";
        service-name = "gdmc-normal";
        mboxes = <&mba_sswrp_gdmc_client_0 0 &mba_sswrp_gdmc_client_1 0>;
        req-mboxes-idx = <0>;
        resp-mboxes-idx = <1>;
        payload-size = <4>;
    };
```

## google-modules/soc/rdo/Documentation/devicetree/bindings/soc/google/google,mba-cpm-iface.yaml
```yaml
# SPDX-License-Identifier: (GPL-2.0-only OR BSD-2-Clause)
# Copyright 2023-2024 Google LLC
%YAML 1.2
---
$id: http://devicetree.org/schemas/soc/google/google,mba-cpm-iface.yaml#
$schema: http://devicetree.org/meta-schemas/base.yaml#

title: Google MBA (MailBox Array) CPM Interface

maintainers:
  - Lucas Wei <lucaswei@google.com>
  - Subhash Jadavani <sjadavani@google.com>

description:
  The Google MailBox Array CPM interface provides CPM services APIs.
  CPM interface provides bi-direction message transaction to help clients
  and CPM host communication.
  CPM interface would request "req/resp" mailbox channels for CPM message
  transactions. Client modules can register their callback to receive CPM
  initiated requests and respond through CPM interface with given token.


properties:
  compatible:
    enum:
      - google,mba-cpm-iface

  "mboxes":
    type: object
    description: Mailbox Channels provided by Google MBA queue mode controller driver.

  "req-mboxes-idx":
    type: array
    description: a bunch of index in `mboxes` property which are used to send request
      (client initiated transaction) and respond to CPM initiated request.

  "resp-mboxes-idx":
    type: array
    description: a bunch of index in `mboxes` property which are used to send response
      (CPM response to client's request) and CPM initiated request.

  "msg-buf-size":
    type: integer
    description: the size of mailbox message buffer in words (one word is 4-bytes).

required:
  - compatible
  - mboxes
  - req-mboxes-idx
  - resp-mboxes-idx
  - payload-size

additionalProperties: false

examples:
  - |
    goog_mba_cpm_iface: goog_mba_cpm_iface {
      compatible = "google,mba-cpm-iface"
      mboxes = <&mba_sswrp_cpm_req 0
                &mba_sswrp_cpm_req 1
                &mba_sswrp_cpm_req 2
                &mba_sswrp_cpm_req 3
                &mba_sswrp_cpm_req 4
                &mba_sswrp_cpm_req 5
                &mba_sswrp_cpm_req 6
                &mba_sswrp_cpm_req 7
                &mba_sswrp_cpm_resp 0
                &mba_sswrp_cpm_resp 1
                &mba_sswrp_cpm_resp 2
                &mba_sswrp_cpm_resp 3>;
      req-mboxes-idx = <0 1 2 3 4 5 6 7>;
      resp-mboxes-idx = <8 9 10 11>;
      msg-buf-size = <4>;
    };
```

## google-modules/soc/rdo/Documentation/devicetree/bindings/soc/google/google,mba-gdmc-iface.yaml
```yaml
# SPDX-License-Identifier: (GPL-2.0-only OR BSD-2-Clause)
# Copyright 2022 Google LLC
%YAML 1.2
---
$id: http://devicetree.org/schemas/mailbox/google,mba-gdmc-iface.yaml#
$schema: http://devicetree.org/meta-schemas/base.yaml#

title: Google MBA (MailBox Array) GDMC Interface

maintainers:
  - Lucas Wei <lucaswei@google.com>
  - Subhash Jadavani <sjadavani@google.com>

description:
  The Google MailBox Array GDMC interface provides GDMC services APIs.
  On the backend, it would use GDMC normal request and response mailbox channels
  for normal GDMC requests; GDMC critical request and response mailbox channels
  for critical GDMC requests.

properties:
  compatible:
    enum:
      - google,mba-gdmc-iface

  memory-region:
    maxItems: 1
    description:
      DMA buffer between host and GDMC.  Allocated memory must be mappable by
      the GDMC.

  "goog-mba-aggrs":
    type: object
    description: device nodes whose compatible property with `google,mba-aggr`.
      Google MBA GDMC interface use this property to search and get instance from Google
      MBA aggregator to do operation of specific group of channels.

required:
  - compatible
  - memory-region
  - "goog-mba-aggrs"

additionalProperties: false

examples:
  - |
    goog_mba_gdmc_iface: goog_mba_gdmc_iface {
        compatible = "google,mba-gdmc-iface";
        memory-region = <&goog_mba_gdmc_iface_dma_region>;
        goog-mba-aggrs = <&goog_mba_aggr_gdmc &goog_mba_aggr_gdmc_crit>;
    };
```

## google-modules/soc/rdo/Documentation/devicetree/bindings/spmi-mba/spmi-mba-ctrl.yaml
```yaml
# SPDX-License-Identifier: GPL-2.0-only
# Copyright 2023 Google LLC
%YAML 1.2
---
$id: http://devicetree.org/schemas/spmi-mba/spmi-mba.yaml#
$schema: http://devicetree.org/meta-schemas/core.yaml#

title: SPMI Mailbox Controller

maintainers:
  - Jim Wylder <jwylder@google.com>

description:
  Provides SPMI Controller communicating to CPM SPMI
  Driver is a child of the mailbox controller


allOf:
  - $ref: pwm.yaml#

properties:
  compatible:
    const: google,spmi-mba-ctrl

  mba-dest-channel:
    Configured CPM mailbox channel to send commands
    maxItems: 1

  mboxes:
    Configured channel to receive commands
    maxItems: 1

required:
  - compatible
  - mba-dest-channel
  - mboxes:

additionalProperties: false

examples:
  - |
    spmi_mba {
      compatible = "google,spmi-mba-ctrl";

      mba-dest-channel = <0x66>;
      mboxes = <&mbactrl_ap_cpm 20>;
   };
```
