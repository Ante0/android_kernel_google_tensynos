## google-modules/soc/rdo/Documentation/devicetree/bindings/power-controller/power-domain.yaml
```yaml
# SPDX-License-Identifier: (GPL-2.0-only OR BSD-2-Clause)
# Copyright 2024 Google LLC
%YAML 1.2
---
$id: http://devicetree.org/schemas/pinctrl/google,power-domain.yaml#
$schema: http://devicetree.org/meta-schemas/core.yaml#

title: Google Power Domains

maintainers:
  - Jakub Glowacki <jglow@google.com>
  - Mahesh Sivasubramanian <msivasub@google.com>
  - Ben Schwartz <bsschwar@google.com>

description: |
  This binding describes power domains that can be controlled via one of two
  mutually exclusive methods, based on the support of their driver:
  1. MBA Direct Communication: Uses a System Software Wrapper (SSWRP) ID to
     directly control the power domain, and
  2. Mailbox File System (MBFS): Uses a SysPM resource ID and a control node
     name to manage power through a mailbox interface.

properties:
  power-domains:
    description:
      For subdomains within a SSWRP, defines the parent subdomain reference. Not
      required if power domain is the top domain.

  reg:
    description:
      Offset and size of the control register region within the device. For some
      peripherals (e.g., GPU), this can specify a particular sub-block to control

  rpm-always-on:
    description:
      If present, runtime PM suspend is disallowed. This prevents the power-off
      callback from being called while the kernel is active but does not prevent
      power-off during system suspend.

  irq-safe:
    description:
      If present, indicates that the power domain's on/off callbacks are safe
      to be called from an IRQ context.

  always-on:
    description:
      If present, the domain is never powered off, even during system-wide
      suspend. The power_off callback will never be called.

  force-on:
    description:
      If present, forces the power domain's power_on callback to be executed
      during the probe of the power controller.

  use-smc:
    description:
      If present, Secure Monitor Calls (SMC) are used for power transitions
      instead of the standard mailbox. This is for latency-sensitive domains
      where the Kernel is the only voter.

  no-auto-resume:
    description:
      If present, this prevents the power domain from being automatically turned
      on when a device's driver is resumed during the kernel resume flow.

  active-wakeup:
    description:
      Sets the GENPD_FLAG_ACTIVE_WAKEUP, allowing the device to be powered on
      during system suspend to generate wakeup signals.

  google,boot-stay-on:
    description:
      If present, the power domain will stay on during boot. All power off and
      power on requests will be ignored (no-op) until the sync-state callback
      is triggered, which clears this flag. It can cause the device to be
      unnecessarily powered on after sync_state is called, until next request
      resynchronizes HW and SW state of the domain.
    type: boolean

oneOf:
  - description: Properties for MBA direct communication.
    required:
      - sswrp-id
    properties:
      sswrp-id:
        description: The identifier for the SSWRP to be controlled.

      subdomain-id:
        description:
          A unique ID for a subdomain within a parent SSWRP. Not required for
          top-level domains.

      on-at-init:
        description:
          If present, indicates that the power domain is powered on during the
          probe of the power controller.

  - description: Properties for MBFS-based communication.
    required:
      - pm-resource-id
      - mbfs-node-name
    properties:
      pm-resource-id:
        description:
          The unique System Power Management (SysPM) resource identifier for the
          domain.

      mbfs-node-name:
        type: string
        description:
          The name of the MBFS node file used to control the power state of the
          resource.

examples:
  - |
    /* Example 1: A GPU power domain using MBA direct communication */
    sswrp_gpu_pd: sswrp_gpu_pd {
        #power-domain-cells = <0>;
        reg = <0x100 0x4>;
        sswrp-id = <5>; /* GPU SSWRP ID */
        on-at-init;
    };

  - |
    /* Example 2: A DSP power domain using MBFS communication */
    sswrp_aurdsp_pd: sswrp_aurdsp_pd {
        #power-domain-cells = <0>;
        pm-resource-id = <12>;
        mbfs-node-name = "dsp-power";
    };
```

## google-modules/soc/rdo/Documentation/devicetree/bindings/soc/google/debug/google,ehld-coreinstr.yaml
```yaml
# SPDX-License-Identifier: (GPL-2.0-only OR BSD-2-Clause)
# Copyright 2024-2025 Google LLC
%YAML 1.2
---
$id: http://devicetree.org/schemas/soc/google/debug/google,ehld-coreinstr.yaml#
$schema: http://devicetree.org/meta-schemas/base.yaml#

title: Google Coreinstr EHLD Kernel driver

maintainers:
  - Mayank Rungta <mrungta@google.com>

description:
    This driver with the help of GDMC monitors CPU state.
	  If GDMC detects lokcup or hang, it notifies this driver
	  and the driver obtains necessary debugging information.

properties:
  compatible:
    const: google,ehld-coreinstr

  gdmc-iface:
    type: object
    description: phandle to `google,mba-gdmc-iface` device node.
      This points to the GDMC MBA interface over which communication
      with GDMC is established.

  clocks:
    maxItems: 1
    description: A phandle to the Trace SubSystem clock. This driver
      enables this clock before accessing CPU PMU registers.

  clock-names:
    const: tss_clk

  interval:
    description:
      The HR timer interval in milliseconds. Driver uses HR timer to update CPU state.
      This interval is also used to setup periodic timer in GDMC to poll CPU state.

  warn-count:
    description:
      The number of consecutive failed polls before a warning is issued.
      This is used to setup GDMC.

  '#address-cells':
    const: 1

  '#size-cells':
    const: 1

patternProperties:
  "^sgi_base$":
    type: object
    description: Holds the physical addresses for SGI registers for each core.
    properties:
      reg:
        description: Physical address ranges for SGI registers for each core.

  "^coreinstret_base$":
    type: object
    description: Holds the base address for the coreinstr_ret register.
    properties:
      reg:
        maxItems: 1
        description: The physical address range for the coreinstr_ret registers.

  "^coreinstr_base$":
    type: object
    description: Holds the physical address for coreinstr registers.
    properties:
      reg:
        maxItems: 1
        description: The physical address range for the coreinstr registers.

  "^pmu_base$":
    type: object
    description: Holds the physical addresses for the PMU registers for each core.
    properties:
      reg:
        description: Physical address ranges for the PMU registers for each core.

required:
  - compatible
  - gdmc-iface
  - clocks
  - clock-names
  - sgi_base
  - coreinstret_base
  - coreinstr_base
  - pmu_base

additionalProperties: false

examples:
  - |

    ehld_coreinstr: ehld-coreinstr {
      compatible = "google,ehld-coreinstr";
      gdmc-iface = <&goog_mba_gdmc_iface>;

      clocks = <&cpu_sswrp_tss_clk>;
      clock-names = "tss_clk";

      interval = <1000>;
      warn-count = <4>;
      #address-cells = <1>;
      #size-cells = <1>;
      sgi_base {
        reg = <0x5910000 0x40000>,
          <0x5950000 0x40000>,
          <0x5990000 0x40000>,
          <0x59D0000 0x40000>,
          <0x5A10000 0x40000>,
          <0x5A50000 0x40000>,
          <0x5A90000 0x40000>,
          <0x5AD0000 0x40000>;
      };
      coreinstret_base {
        reg = <0x200c07c0 0x20>;
      };
      coreinstr_base {
        reg = <0x200c0504 0x24>;
      };
      pmu_base {
        reg = <0x228A0000 0x1000>,
          <0x22920000 0x1000>,
          <0x229A0000 0x1000>,
          <0x22A20000 0x1000>,
          <0x22AA0000 0x1000>,
          <0x22B20000 0x1000>,
          <0x22BA0000 0x1000>,
          <0x22C20000 0x1000>;
      };
    };
```

## google-modules/soc/rdo/Documentation/devicetree/bindings/soc/google/debug/google,tower-ci.yaml
```yaml
# SPDX-License-Identifier: (GPL-2.0-only OR BSD-2-Clause)
# Copyright 2025 Google LLC
%YAML 1.2
---
$id: http://devicetree.org/schemas/soc/google/debug/google,tower-ci.yaml#
$schema: http://devicetree.org/meta-schemas/core.yaml#

title: Google Tower-CI Interconnect Driver

maintainers:
  - Mayank Rungta <mrungta@google.com>

description: |
  The Tower-CI is a configurable interconnect composed of various functional nodes.
  This binding describes the top-level controller and the individual child nodes
  (e.g., ASNI, MCN) that reside within its address space.

  The top-level "global" node is the main controller, defining the total memory
  region for the interconnect. The child "node" devices are defined within it,
  with their 'reg' property specifying their offset within the global region.

properties:
  compatible:
    oneOf:
      - description: The top-level global controller node.
        const: google,tower-ci-global

      - description: A functional child node within the interconnect.
        const: google,tower-ci-node

  reg:
    maxItems: 1

# Properties for the global controller node
select:
  properties:
    compatible:
      const: google,tower-ci-global
  then:
    properties:
      reg:
        description:
          Specifies the base physical address and size of the entire Tower-CI
          interconnect memory region.

      ranges:
        description:
          Defines the address space translation between this parent node and its
          children. The format is a triplet of (child-bus-address,
          parent-bus-address, size). For a direct 1-to-1 mapping, this
          property translates a child's address by adding it to this node's
          base address to produce the final physical address.

      '#address-cells':
        const: 1
        description:
          Specifies that the address field in the 'reg' property of child
          nodes consists of a single <u32> cell (the offset).

      '#size-cells':
        const: 1
        description:
          Specifies that the size field in the 'reg' property of child
          nodes consists of a single <u32> cell.

    required:
      - compatible
      - reg
      - ranges
      - '#address-cells'
      - '#size-cells'

# Properties for the child nodes
definitions:
  tower-ci-node:
    type: object
    properties:
      compatible:
        const: google,tower-ci-node

      reg:
        maxItems: 1
        description:
          The offset and size of this node's register space within the
          parent controller's address range.

      interrupts:
        minItems: 1
        description: An array of interrupt specifiers for the node.

      interrupt-names:
        minItems: 1
        description: A list of string names for each interrupt.

      interrupt-is-secure:
        type: boolean
        description:
          A boolean array indicating if the corresponding interrupt is secure.
          The number of entries must match the number of interrupts.

      interrupt-is-error:
        type: boolean
        description:
          A boolean array indicating if the corresponding interrupt is an
          error-type interrupt. The number of entries must match the number
          of interrupts.

    required:
      - compatible
      - reg

    dependencies:
      interrupt-names: [interrupts]
      interrupt-is-secure: [interrupts]
      interrupt-is-error: [interrupts]

examples:
  - |
    tower_global: tower-ci@10000000 {
        compatible = "google,tower-ci-global";
        reg = <0x0 0x10000000 0x0 0x10000000>;
        #address-cells = <1>;
        #size-cells = <1>;
        ranges = <0x0 0x0 0x10000000 0x10000000>;

        asni0: asni@40000 {
            compatible = "google,tower-ci-node";
            reg = <0x40000 0x30000>;
        };

        mcn0: mcn@1d0000 {
            compatible = "google,tower-ci-node";
            reg = <0x1d0000 0x130000>;
            interrupts = <GIC_SPI 400 IRQ_TYPE_LEVEL_HIGH>,
                         <GIC_SPI 401 IRQ_TYPE_LEVEL_HIGH>,
                         <GIC_SPI 402 IRQ_TYPE_LEVEL_HIGH>,
                         <GIC_SPI 403 IRQ_TYPE_LEVEL_HIGH>;
            interrupt-names = "MCN0: Non-secure error",
                              "MCN0: Secure error",
                              "MCN0: Non-secure fault",
                              "MCN0: Secure fault";
            interrupt-is-secure = <0>, <1>, <0>, <1>;
            interrupt-is-error = <1>, <1>, <0>, <0>;
        };
    };
...
```

## google-modules/soc/rdo/Documentation/devicetree/bindings/soc/google/fwmt/google,fwmt.yaml
```yaml
# SPDX-License-Identifier: (GPL-2.0-only OR BSD-2-Clause)
# Copyright 2026 Google LLC
%YAML 1.2
---
$id: http://devicetree.org/schemas/soc/google/fwmt/google,fwmt.yaml#
$schema: http://devicetree.org/meta-schemas/base.yaml#

title: FWMT (Firmware Metrics)

maintainers:
  - Filip Konieczny <filipkonieczny@google.com>

description:
  This driver offers its interface through character devices, and it enables
  retrieval of metrics collected by the firmware.

properties:
  compatible:
    const: google,fwmt-gdmc

  gdmc-iface:
    description:
      A phandle to the mailbox controller used for communication with the GDMC.

  mboxes:
    description:
      A phandle to the mailbox controller used for communication with the CPM.

  memory-region:
    description:
      A phandle to a reserved memory region used for DMA buffers to exchange
      data with the firmware.

  buffer-offset:
    description:
      Offset of the DMA buffer within the reserved memory region.

  buffer-size:
    description:
      Size of the DMA buffer within the reserved memory region.

required:
  - compatible
  - gdmc-iface
  - mboxes
  - memory-region
  - buffer-offset
  - buffer-size

additionalProperties: false

examples:
  - |
    fwmt: fwmt {
      compatible = "google,fwmt-gdmc";
      gdmc-iface = <&goog_mba_gdmc_iface>;
      mboxes = <&goog_mba_cpm_iface>;
      memory-region = <&gdmc_metrics_dma_buffer>;
      buffer-offset = <0x0>;
      buffer-size = <0x2000>;
    };
```
