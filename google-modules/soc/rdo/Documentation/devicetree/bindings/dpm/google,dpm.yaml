## google-modules/soc/rdo/Documentation/devicetree/bindings/soc/google/google,chip-info.yaml
```yaml
# SPDX-License-Identifier: (GPL-2.0-only OR BSD-2-Clause)
# Copyright 2024-2025 Google LLC
%YAML 1.2
---
$id: http://devicetree.org/schemas/soc/google/google,chip-info.yaml#
$schema: http://devicetree.org/meta-schemas/base.yaml#

title: Google Chip Info Driver

maintainers:
  - Lucas Wei <lucaswei@google.com>
  - Eddy Li <ehyli@google.com>
  - Subhash Jadavani <sjadavani@google.com>

description:
  The Google Chip Info driver helps to read OTP fused values and create sysfs
  to export platform information.

properties:
  compatible:
    enum:
      - google,chip-info

  reg:
    maxItems: 4
    description: register ranges for OTP shadow registers.

  reg-names:
    maxItems: 4
    description: names for register ranges.

  "google,syscon-phandle":
    type: object
    description: device node of syscon phandle to access global OTP registers.

  "google,reg-index":
    $ref: /schemas/types.yaml#/definitions/uint32
    description: index of the reg range in the parent node to be used for this feature.

  "feature-name":
    type: string
    description: feature name for a feature to be a child node of chip info
      driver. This name will be showed at the first line of every sysfs.

  "translator":
    type: string
    description: The name of translator to be applied on this feature.
      Once feature use translator, it will applied to every OTP entries to do
      the translation and append the result in the entry tail.

  "serial-codes":
    type: bool
    description: indicate this node is serial code feature.
      The serial codes will show in the end of the sysfs file of device-table
      feature.

  "device-table":
    type: bool
    description: indicate this node is device table feature.
      The sysfs file of device table will have serial code following in the bottom
      of file. This design is for data alignment to earlier version of chip info
      and don't break the parsing rules for sysfs.

  "lcs-state":
    type: bool
    description: indicate this node is LCS state feature.
      The LCS state value is used to identify device stage. Only features with
      property of `visible-in-prod` can bypass this security enforcement.

  "visible-in-prod":
    type: bool
    description: if a feature has this property, it can bypass security enforcement
      of lcs-state check. Otherwise, userspace will get error message.

  "private":
    type: bool
    description: indicate this node is private feature used for main chip-info
      driver. This will stop main driver to create sysfs to export values to
      userspace.

required:
  - compatible
  - feature-name

additionalProperties: false

examples:
  - |
    goog_chip_info: goog_chip_info@ebd2000 {
      compatible = "google,chip-info";
      reg = <0xebd2000 0x1000>;
      reg-names = "cpm";

      device_table: device_table {
        compatible = "google,lga_a0_ptde";
        google,reg-index = <0>;
        feature-name = "Device table";
        device-table;
        visible-in-prod;
      };
    };
```

## google-modules/soc/rdo/Documentation/devicetree/bindings/soc/google/google,gdmc-dhub.yaml
```yaml
# SPDX-License-Identifier: (GPL-2.0-only OR BSD-2-Clause)
# Copyright 2024-2025 Google LLC
%YAML 1.2
---
$id: http://devicetree.org/schemas/soc/google/google,gdmc-dhub.yaml#
$schema: http://devicetree.org/meta-schemas/base.yaml#

title: Google Debug and UART Hub driver

maintainers:
  - Mayank Rungta <mrungta@google.com>
  - Daniel Kurtz <djkurtz@google.com>

description: |
  DHUB multiplexes UART data for multiple subsystems into a
  single packetized data stream between device and host.
  The driver allows configuring this UART channels through its sysfs.

properties:
  compatible:
    oneOf:
      - const: google,gdmc-dhub-gen1
        description: For the first generation of the DHUB UART channels.
      - const: google,gdmc-dhub-gen2
        description: For the second generation of the DHUB UART channels.

  gdmc-iface:
    description:
      A phandle to the `google,mba-gdmc-iface` device node. This establishes
      the communication channel with the GDMC.

required:
  - compatible
  - gdmc-iface

additionalProperties: false

examples:
  - |
    gdmc_dhub: gdmc_dhub {
        compatible = "google,gdmc-dhub-gen1";
        gdmc-iface = <&goog_mba_gdmc_iface>;
    };
```

## google-modules/soc/rdo/Documentation/devicetree/bindings/soc/google/vdu/google,vdu.yaml
```yaml
# SPDX-License-Identifier: (GPL-2.0-only OR BSD-2-Clause)
# Copyright 2024 Google LLC
%YAML 1.2
---
$id: http://devicetree.org/schemas/soc/google/vdu/google,vdu.yaml#
$schema: http://devicetree.org/meta-schemas/base.yaml#

title: Google VDU (Volatile Debug Unlock)

maintainers:
  - Kanstantsin Yarmash <kyarmash@google.com>

description:
  This driver offers its interface through sysfs files and a character device,
  and it enables interaction with the VDU hardware for authentication and
  status queries. It facilitates device information retrieval, authentication
  flow support, and status checks, and it is used to establish and manage VDU
  sessions.

properties:
  compatible:
    const: google,volatile-debug-unlock

  memory-region:
    description:
      A phandle to a reserved memory region used for DMA buffers to exchange
      data with the GDMC firmware.

  gdmc-iface:
    description:
      A phandle to the mailbox controller used for communication with the GDMC.

  consent-granted:
    type: boolean
    description:
      A boolean property indicating that user consent for the VDU unlock
      has been granted. The absence of this property implies consent is not
      granted. The driver will reject directive processing if this property
      is not present.

  joint-directive-mba:
    type: boolean
    description:
      A boolean property indicating that the GDMC mailbox accepts VDU
      directive to be sent jointly in a single, combined buffer.
      If this property is not present, the driver will send the grant
      and delegate as two separate mailbox requests.

  vdu-directive-max-size:
    type: integer
    description:
      Specifies the maximum allowed size in bytes for the VDU directive buffers
      (grant and delegate combined). This is a security measure to prevent
      overly large allocations.

  default-debug-vector:
    type: string
    description:
      A hex string representing the default VDU debug vector.

  default-policy-type:
    type: array
    description:
      A list of default VDU policy types.
required:
  - compatible
  - memory-region
  - gdmc-iface

additionalProperties: false

examples:
  - |
    gvdu: gvdu {
      compatible = "google,volatile-debug-unlock";
      gdmc-iface = <&goog_mba_gdmc_iface>;
      memory-region = <&gvdu_dma_region>;
      vdu-directive-max-size = <0x00002790>;
      consent-granted;
    };
```

## google-modules/soc/rdo/Documentation/devicetree/bindings/thermal/google,thermal-pressure-tj.yaml
```yaml
# SPDX-License-Identifier: (GPL-2.0-only OR BSD-2-Clause)
# Copyright 2025 Google LLC
%YAML 1.2
---
$id: http://devicetree.org/schemas/thermal/google,thermal-pressure-tj.yaml#
$schema: http://devicetree.org/meta-schemas/core.yaml#

title: Google tj thermal pressure driver


maintainers:
  - Sayanna Chandula <sayanna@google.com>

description: |
  Thermal pressure driver reads tj thermal throttling info from shared memory and
  applies thermal pressure to scheduler using exported API from cpufreq. Thermal
  pressure indicates the frequency capping applied by tj loops to control
  junction temperature. Such frequency capping would result in change in
  CPU capacity. Applying thermal pressure lets the scheduler be aware of
  change in CPU capacity.

properties:
  compatible:
    const: google,thermal-pressure-tj

  "active-polling-delay-ms":
    $ref: /schemas/types.yaml#/definitions/uint32
    maxItems: 1
    description: |
      Polling delay in milli seconds during active polling.
      Active polling refers to faster polling interval at which we want to
      apply thermal pressure during active tj thermal throttling. Active polling
      triggers when one of the CPU thermal zones is switched_on.

  "passive-polling-delay-ms":
    $ref: /schemas/types.yaml#/definitions/uint32
    maxItems: 1
    description:
      Polling delay in milli seconds during passing polling.
      Passive polling refers to slower polling interval at which we want to
      monitor thermal pressure when there is no active tj throttling. This is enabled
      when all of the CPU thermal zones are in switched_off state.

  "cluster_config":
    type: object
    description:
      List of configs defining CPU clusters.

    patternProperties:
      "thermal-pressure-[A-Za-z0-9]+":
        type: object

        properties:
          "first-cpu":
            maxItems: 1
            description:
              phandle for first CPU in a CPU cluster.

          "cdev-id":
            $ref: /schemas/types.yaml#/definitions/uint32
            maxItems: 1
            description:
              Cooling device id attached to a CPU cluster as defined in below header.
              "dt-bindings/soc/google/google-thermal-def.h".

  required:
    - compatible
    - "active-polling-delay-ms"
    - "passive-polling-delay-ms"
    - "cluster_config"
    - "first-cpu"
    - "cdev-id"

additionalProperties: false

examples:
  - |
        thermal_pressure: thermal_pressure {
          compatible = "google,thermal-pressure-tj";
          group-name = "tmu";

          active-polling-delay-ms = <100>;
          passive-polling-delay-ms = <2500>;

          cluster_config {
            thermal-pressure-big {
              first-cpu = <&hunterelp_0>;
              cdev-id = <HW_DT_CDEV_BIG>;
            };
            thermal-pressure-big-mid {
              first-cpu = <&hunter_3>;
              cdev-id = <HW_DT_CDEV_BIG_MID>;
            };
            thermal-pressure-mid {
              first-cpu = <&hunter_0>;
              cdev-id = <HW_DT_CDEV_MID>;
            };
            thermal-pressure-little {
              first-cpu = <&hayes_0>;
              cdev-id = <HW_DT_CDEV_LIT>;
            };
          };
        };
```

## google-modules/soc/rdo/Documentation/devicetree/bindings/thermal/google,thermal-uclamp.yaml
```yaml
# SPDX-License-Identifier: (GPL-2.0-only OR BSD-2-Clause)
# Copyright 2025 Google LLC
%YAML 1.2
---
$id: http://devicetree.org/schemas/thermal/google,thermal-uclamp.yaml#
$schema: http://devicetree.org/meta-schemas/core.yaml#

title: Google thermal uclamp cooling device

maintainers:
  - Ram Chandrasekar <rchandrasekar@google.com>

description: |
  This driver creates cooling devices for CPU clusters. These cooling devices
  apply frequency capping via the uclamp_max mechanism. The mapping between a
  CPU cluster (represented by one of its CPU's device tree nodes) and a
  hardware cooling device ID (used for power table lookups) is provided in
  the device tree.

properties:
  compatible:
    const: google,thermal-uclamp

  google,cluster-cdev-map:
    description:
      A list of pairs, mapping a phandle of a CPU cluster's representative
      CPU node to a hardware cooling device ID. Each pair consists of a
      phandle and one cell for the cooling device ID. The cooling device ID
      is defined in "dt-bindings/soc/google/google-thermal-def.h".
    $ref: /schemas/types.yaml#/definitions/phandle-array

required:
  - compatible
  - google,cluster-cdev-map

additionalProperties: false

examples:
  - |
    #include <dt-bindings/soc/google/google-thermal-def.h>

    thermal_uclamp {
        compatible = "google,thermal-uclamp";
        google,cluster-cdev-map =
            <&cpu0 HW_DT_CDEV_LIT>,
            <&cpu4 HW_DT_CDEV_MID>,
            <&cpu6 HW_DT_CDEV_BIG_MID>,
            <&cpu7 HW_DT_CDEV_BIG>;
    };
```

## google-modules/soc/rdo/Documentation/devicetree/bindings/tty/serial/modem-uart/google,modem-uart.yaml
```yaml
# SPDX-License-Identifier: (GPL-2.0-only OR BSD-2-Clause)
# Copyright 2026 Google LLC
%YAML 1.2
---
$id: http://devicetree.org/schemas/tty/serial/modem-uart/google,modem-uart.yaml#
$schema: http://devicetree.org/meta-schemas/base.yaml#

title: Google Modem Uart

maintainers:
  - Kanstantsin Yarmash <kyarmash@google.com>

description:
  Device tree binding for the Modem UART driver, which manages the saving and
  retrieval of modem UART logs from a DRAM carveout via the GDMC.

properties:
  compatible:
    const: google,modem-uart

  gdmc-iface:
    description:
      A phandle to the mailbox controller used for communication with the GDMC.

  memory-region:
    description:
      A phandle to a reserved memory region used for DMA buffers to exchange
      data with the GDMC firmware.

  buffer-offset:
    description:
      Offset of the DMA buffer within the reserved memory region.

  buffer-size:
    description:
      Size of the DMA buffer within the reserved memory region.

required:
  - compatible
  - gdmc-iface
  - memory-region
  - buffer-offset
  - buffer-size

additionalProperties: false

examples:
  - |
    modem_uart: modem_uart {
      compatible = "google,modem-uart";
      gdmc-iface = <&goog_mba_gdmc_iface>;
      memory-region = <&gdmc_metrics_dma_buffer>;
      buffer-offset = <0x2000>;
      buffer-size = <0x2000>;
    };
```

## google-modules/soc/rdo/Kconfig
```kconfig
# SPDX-License-Identifier: GPL-2.0-only

menuconfig ARCH_GOOGLE
	bool "Google SoC platform"
	depends on ARM64
	help
	  Say Y here to get to see options for platform support for
	  Google SoC drivers. This option alone does not add any
	  kernel code. If you say N, all options in this submenu will
	  be skipped and disabled.

if ARCH_GOOGLE

config SOC_RDO
	bool "SOC is RDO"
	help
	  Select Y if the SOC is Redondo.
	  SOC is short for System on Chip
	  RDO is short for Redondo.
	  RDO kernel modules depend on this configuration.

config SOC_LGA
	bool "SOC is LGA"
	help
	  Select Y if the SOC is Laguna.
	  SOC is short for System on Chip
	  LGA is short for Laguna.
	  LGA kernel modules depend on this configuration.

config SOC_MBU
	bool "SOC is MBU"
	help
	  Select Y if the SOC is Malibu.
	  SOC is short for System on Chip
	  MBU is short for Malibu.
	  MBU kernel modules depend on this configuration.

endif # ARCH_GOOGLE
```

## google-modules/soc/rdo/aoss-ssr-notifier/Kconfig
```kconfig
# SPDX-License-Identifier: GPL-2.0-only

config AOSS_SSR_NOTIFIER
	tristate "AOSS SSR notifier"
	depends on AOC_MBU || AOC_LGA
	help
	  Enable support for AOSS SSR notifier.
```

## google-modules/soc/rdo/drivers/i2c/busses/Kconfig
```kconfig
# SPDX-License-Identifier: GPL-2.0-only

config I2C_DW_GOOGLE_CORE
	tristate "DW Google I2C core"
	select REGMAP

config I2C_DW_GOOGLE_QUIRKS
	tristate "DW Google I2C Platform Quirks"
	depends on ARCH_GOOGLE
	depends on I2C
	select I2C_DW_GOOGLE_CORE
	help
	  Enable the upstream I2C designware platform driver

config I2C_DW_GOOGLE_TEST
	tristate "Test driver for i2C controller"
	help
	  Enable I2C test driver which provides debugfs based API
	  to generate I2C traffic.
	  Select Y if you have such device.
	  If unsure select "N".
```
