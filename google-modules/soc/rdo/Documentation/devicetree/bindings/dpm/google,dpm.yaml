## google-modules/soc/rdo/Documentation/devicetree/bindings/dpm/google,dpm.yaml
```yaml
# SPDX-License-Identifier: (GPL-2.0-only OR BSD-2-Clause)
# Copyright 2023 Google LLC
%YAML 1.2
---
$id: http://devicetree.org/schemas/dpm/google,dpm.yaml#
$schema: http://devicetree.org/meta-schemas/core.yaml#

title: Debug Policy Module (DPM) config sources

maintainers:
  - Szymon Katra <skatra@google.com>

description:
  The dpm node defines the configuration for the device's debug state and
  runtime behavior. By default, this node contains only static metadata, such
  as version and variant information. Extended debugging properties are
  dynamically injected via Device Tree Overlays (DTO) provided by the
  bootloader.

properties:
  version:
    description: Debug Policy version, used for informational purposes.

  variant:
    description: Used to determine Android build type user/eng/userdebug
    - enum:
      - user
      - eng
      - userdebug

required:
  - version
  - variant

additionalProperties: false

examples:
  - |
  dpm {
    version = <201>;
    variant = "user";
  };
...
```

## google-modules/soc/rdo/Documentation/devicetree/bindings/fwtp/google,fwtp_cpm.yaml
```yaml
# SPDX-License-Identifier: (GPL-2.0-only OR BSD-2-Clause)
# Copyright 2025 Google LLC
%YAML 1.2
---
$id: http://devicetree.org/schemas/fwtp/google,fwtp_cpm.yaml#
$schema: http://devicetree.org/meta-schemas/core.yaml#

title: Google CPM FWTP driver

maintainers:
  - Erik Staats <estaats@google.com>

description: |
  The Google CPM FWTP driver reads tracepoints from CPM.

properties:
  compatible:
    const: google,fwtp-cpm

  mboxes:
    description: A phandle for the mailbox to use for IPC wth CPM.
    maxItems: 1

  mba-dest-channel:
    description: The mailbox channel to use to send IPC messages to CPM.
    maxItems: 1

  memory-region:
    description: DMA buffer to use for IPC with CPM.

  tracepoint-list:
    description: List of sub-devices for which to publish tracepoints.

required:
  - compatible
  - mboxes
  - mba-dest-channel
  - memory-region
  - tracepoint-list

additionalProperties: false

examples:
  - |
    fwtp_cpm: fwtp_cpm {
      compatible = "google,fwtp-cpm";
      mboxes = <&goog_mba_cpm_iface>;
      mba-dest-channel = <MBOX_DEST_CHAN_CPM_FWTP>;
      memory-region = <&cpm_tracepoint_ipc_dma>;
      tracepoint-list = "cpm", "cap";
    };
```

## google-modules/soc/rdo/Documentation/devicetree/bindings/gpu/img-gpu.yaml
```yaml
# SPDX-License-Identifier: (GPL-2.0-only OR BSD-2-Clause) Copyright 2025 Google
# LLC
%YAML 1.2
---
$id: http://devicetree.org/schemas/gpu/img-gpu.yaml#
$schema: http://devicetree.org/meta-schemas/core.yaml#

title: IMG GPU

maintainers:
  - Sean Callanan <spyffe@google.com>

description: |
  A IMG PowerVR GPU with custom DVFS configuration.

properties:
  compatible:
    description:
      Defines the platform/version of the GPU
    anyOf:
      - items:
        - enum:
           - img,gpu
           - google,lga-gpu

  reg:
    description: AP-visible registers

  reg-names:
    description: readable names for AP-visible registers

  interrupts:
    description: rx interrupt, handled by MISR work queue

  power-domains:
    items:
      - description: GPU power domain
      - description: core logic power domain

  memory-region:
    items:
      - description: FW reserved memory region

  iommus:
    items:
      - description: SMMU 0
      - description: SMMU 1

  iommu-idmapped:
    description: identity-mapped (bypass) MMU
    type: boolean

  dvfs-helper-domain-name:
    description: Helper that provides OPPs
    $ref: /schemas/types.yaml#/definitions/string

  init-frequency-hz:
    description: initial frequency (determined by HW)

  config:
    type: object
    properties:
      power:
        type: object
        properties:
          enable-firmware-managed-spu-power:
            description: 1 sets bEnableRDPowIsland
          enable-active-power-management:
            description: 1 sets bEnableActivePM
          active-power-management-latency-ms:
            description: idle time before disabling core logic
          sswrp-autosuspend-latency-ms:
            description: idle time before disabling the whole SSWRP
        additionalProperties: false
      dvfs:
        type: object
        properties:
          pdvfs-com-host:
            description: 1 means PDVFS triggers an AP IRQ to set GPU frequency
        additionalProperties: false

additionalProperties: false

examples:
  - |
    gpu: gpu0@34800000 {
        compatible = "google,lga-gpu", "img,gpu";
        reg = <0x0 0x34f00000 0x0 0x100000>,
              <0x0 0x34813000 0x0 0xc>,
              <0x0 0x34e08000 0x0 0x1000>,
              <0x0 0x34900200 0x0 0x200>,
              <0x0 0x34901200 0x0 0x200>,
              <0x0 0x34902200 0x0 0x200>,
              <0x0 0x34e40000 0x0 0x48>,
              <0x0 0x34ea0000 0x0 0x4000>;
        reg-names = "rgx",
                "pfsm",
                "req_pbha_lut",
                "ra_lut_0",
                "ra_lut_1",
                "ra_lut_2",
                "mba_glue",
                "mba_client";
        interrupts = <GIC_SPI 130 IRQ_TYPE_LEVEL_HIGH 0>;
        power-domains = <&sswrp_gpu_pd>, <&gpu_core_logic_pd>;
        clocks = <&gpu_pf_state>;
        clock-names = "gpu_pf_state";
        iommus = <&gpu_smmu 0x0>,
             <&gpu_smmu 0x1>;
        iommu-idmapped;
        dvfs-helper-domain-name = "gpu";
        init-frequency-hz = <300000000>;
        cooling-min-state = <0>;
        cooling-max-state = <15>;
        #cooling-cells = <2>;
        memory-region = <&gpu_fw_reserved>;
        pt_id = "gpu_p0";
        iif-device = <&iif>;
        config {
            power {
                enable-firmware-managed-spu-power = <1>;
                enable-active-power-management = <1>;
                active-power-management-latency-ms = <1>;
                sswrp-autosuspend-latency-ms = <18>;
            };
        };
    };
```

## google-modules/soc/rdo/Documentation/devicetree/bindings/i2c/snps,designware-i2c.yaml
```yaml
# SPDX-License-Identifier: GPL-2.0-only OR BSD-2-Clause
%YAML 1.2
---
$id: http://devicetree.org/schemas/i2c/snps,designware-i2c.yaml#
$schema: http://devicetree.org/meta-schemas/core.yaml#

title: Synopsys DesignWare APB I2C Controller

maintainers:
  - Jarkko Nikula <jarkko.nikula@linux.intel.com>

allOf:
  - $ref: /schemas/i2c/i2c-controller.yaml#
  - if:
      properties:
        compatible:
          not:
            contains:
              const: mscc,ocelot-i2c
    then:
      properties:
        reg:
          maxItems: 1

properties:
  compatible:
    oneOf:
      - description: Generic Synopsys DesignWare I2C controller
        const: snps,designware-i2c
      - description: Microsemi Ocelot SoCs I2C controller
        items:
          - const: mscc,ocelot-i2c
          - const: snps,designware-i2c
      - description: Baikal-T1 SoC System I2C controller
        const: baikal,bt1-sys-i2c

  reg:
    minItems: 1
    items:
      - description: DW APB I2C controller memory mapped registers
      - description: |
          ICPU_CFG:TWI_DELAY registers to setup the SDA hold time.
          This registers are specific to the Ocelot I2C-controller.

  interrupts:
    maxItems: 1

  clocks:
    minItems: 1
    items:
      - description: I2C controller reference clock source
      - description: APB interface clock source

  clock-names:
    minItems: 1
    items:
      - const: ref
      - const: pclk

  resets:
    maxItems: 1

  clock-frequency:
    description: Desired I2C bus clock frequency in Hz
    enum: [100000, 400000, 1000000, 3400000]
    default: 400000

  i2c-sda-hold-time-ns:
    description: |
      The property should contain the SDA hold time in nanoseconds. This option
      is only supported in hardware blocks version 1.11a or newer or on
      Microsemi SoCs.

  i2c-scl-falling-time-ns:
    description: |
      The property should contain the SCL falling time in nanoseconds.
      This value is used to compute the tLOW period.
    default: 300

  i2c-sda-falling-time-ns:
    description: |
      The property should contain the SDA falling time in nanoseconds.
      This value is used to compute the tHIGH period.
    default: 300

  dmas:
    items:
      - description: TX DMA Channel
      - description: RX DMA Channel

  dma-names:
    items:
      - const: tx
      - const: rx

  hybrid-busy-wait-mode:
    type: boolean
    description:
      True if desired operation (transfer execution) mode is hybrid, false if
      interrupt mode should always be used. If not present, false/ir mode is
      automatically assumed

  hybrid-threshold:
    type: u32
    maxItems: 1
    description:
      If hybrid-busy-wait-mode is true, then this threshold is used to switch
      between busy-waiting and interrupt modes; busy-waiting is used for values
      below the threshold, otherwise interrupt mode is used.
      Unit is Bytes. It is recommended to omit this property, so the default
      value is used, unless one is sure of their choice and wants to customise
      the functionality.

  io-vreg-supply:
    $ref: /schemas/regulator/regulator.yaml#
    description: |
      Phandle to an optional regulator that supplies power for the I2C bus's
      external high keeper or pull-ups. This regulator is typically used to
      ensure proper voltage levels on the I2C bus lines.

unevaluatedProperties: false

required:
  - compatible
  - reg
  - interrupts

examples:
  - |
    i2c@f0000 {
      compatible = "snps,designware-i2c";
      reg = <0xf0000 0x1000>;
      interrupts = <11>;
      clock-frequency = <400000>;

      hybrid-busy-wait-mode;
      hybrid-threshold = <30>;
    };
  - |
    i2c@1120000 {
      compatible = "snps,designware-i2c";
      reg = <0x1120000 0x1000>;
      interrupts = <12 1>;
      clock-frequency = <400000>;
      i2c-sda-hold-time-ns = <300>;
      i2c-sda-falling-time-ns = <300>;
      i2c-scl-falling-time-ns = <300>;
    };
  - |
    i2c@2000 {
      compatible = "snps,designware-i2c";
      reg = <0x2000 0x100>;
      #address-cells = <1>;
      #size-cells = <0>;
      clock-frequency = <400000>;
      clocks = <&i2cclk>;
      interrupts = <0>;

      hybrid-busy-wait-mode;

      eeprom@64 {
        compatible = "atmel,24c02";
        reg = <0x64>;
      };
    };
  - |
    i2c@100400 {
      compatible = "mscc,ocelot-i2c", "snps,designware-i2c";
      reg = <0x100400 0x100>, <0x198 0x8>;
      pinctrl-0 = <&i2c_pins>;
      pinctrl-names = "default";
      interrupts = <8>;
      clocks = <&ahb_clk>;
    };
...
```

## google-modules/soc/rdo/Documentation/devicetree/bindings/i3c-thi/google,dw-i3c-xfer-ap-host.yaml
```yaml
# SPDX-License-Identifier: GPL-2.0-only OR BSD-2-Clause
%YAML 1.2
---
$id: http://devicetree.org/schemas/i3c-thi/google,dw-i3c-xfer-ap-host.yaml#
$schema: http://devicetree.org/meta-schemas/core.yaml#

title: Synopsys DesignWare I3C master AP transfer host AP block

maintainers:
  - Bill Chang <billdir@google.com>
  - Ivan Zaitsev <zaitsev@google.com>

properties:
  compatible:
    const: google,dw-i3c-xfer-ap-host

  reg:
    maxItems: 1

  interrupts:
    maxItems: 1

  cmdfifodepth:
    maxItems: 1
    description: I3C IP command fifo depth.

  datafifodepth:
    maxItems: 1
    description: I3C IP data fifo depth.

required:
  - compatible
  - reg
  - interrupts
  - cmdfifodepth
  - datafifodepth

unevaluatedProperties: false

examples:
  - |
    xfer_host_ap: i3c-xfer-host@0 {
        compatible = "google,dw-i3c-xfer-ap-host";
        reg = <0x02000 0x1000>;
        interrupts = <0>;
        cmdfifodepth = <8>;
        datafifodepth = <32>;
    };
```

## google-modules/soc/rdo/Documentation/devicetree/bindings/i3c-thi/snps,dw-i3c-master.yaml
```yaml
# SPDX-License-Identifier: GPL-2.0-only OR BSD-2-Clause
%YAML 1.2
---
$id: http://devicetree.org/schemas/i3c-thi/snps,dw-i3c-master-thi.yaml#
$schema: http://devicetree.org/meta-schemas/core.yaml#

title: Synopsys DesignWare I3C master transfer host isolated block

maintainers:
  - Bill Chang <billdir@google.com>
  - Ivan Zaitsev <zaitsev@google.com>

allOf:
  - $ref: i3c.yaml#

properties:
  compatible:
    const: snps,dw-i3c-master-thi

  clocks:
    maxItems: 1

  xfer-host-pdev:
    maxItems: 1
    description: Phandle of Isolated Transaction related kernel module

  external-power-control:
    type: boolean
    description: Enable external power control instead of auto runtime PM

required:
  - compatible
  - clocks
  - xfer-host-pdev

unevaluatedProperties: false

examples:
  - |
    i3c-master@2000 {
        compatible = "snps,dw-i3c-master-thi";
        #address-cells = <3>;
        #size-cells = <0>;
        clocks = <&i3cclk>;
        xfer-host-pdev = <&xfer_host>;

        eeprom@57{
            compatible = "atmel,24c01";
            reg = <0x57 0x0 0x10>;
            pagesize = <0x8>;
        };
    };
```
