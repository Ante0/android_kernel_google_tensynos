## google-modules/soc/rdo/Documentation/devicetree/bindings/i3c/snps,dw-i3c-master.yaml
```yaml
# SPDX-License-Identifier: GPL-2.0
%YAML 1.2
---
$id: http://devicetree.org/schemas/i3c/snps,dw-i3c-master.yaml#
$schema: http://devicetree.org/meta-schemas/core.yaml#

title: Synopsys DesignWare I3C master block

maintainers:
  - Alexandre Belloni <alexandre.belloni@bootlin.com>

allOf:
  - $ref: i3c.yaml#

properties:
  compatible:
    const: snps,dw-i3c-master-1.00a

  reg:
    maxItems: 1

  clocks:
    maxItems: 1

  interrupts:
    maxItems: 1

  ibi-capable:
    type: boolean
    description: Mark if the device supports In-Band Interrupt

  hybrid-busy-wait-mode:
    type: boolean
    description:
      True if desired operation (transfer execution) mode is hybrid, false if
      interrupt mode should always be used. If not present, false/ir mode is
      automatically assumed

  i2c-hybrid-threshold:
    type: u32
    maxItems: 1
    description:
      If hybrid-busy-wait-mode is true, then this threshold is used to switch
      between busy-waiting and interrupt modes; busy-waiting is used for values
      below the threshold, otherwise interrupt mode is used.
      Unit is Bytes. It is recommended to omit this property, so the default
      value is used, unless one is sure of their choice and wants to customise
      the functionality.

  i3c-hybrid-threshold:
    type: u32
    maxItems: 1
    description:
      If hybrid-busy-wait-mode is true, then this threshold is used to switch
      between busy-waiting and interrupt modes; busy-waiting is used for values
      below the threshold, otherwise interrupt mode is used
      Unit is Bytes. It is recommended to omit this property, so the default
      value is used, unless one is sure of their choice and wants to customise
      the functionality.

  i3c-threaded-threshold:
    type: u32
    maxItems: 1
    description:
      Threshold in bytes to switch interrupt handling mode for non-DMA transfers.
      If the transfer length (total bytes) is greater than or equal to this threshold,
      the interrupt handling is woken up as a threaded bottom half handler;
      otherwise, it is handled entirely in the top half handler.
      Unit is Bytes. Default is 512 bytes.

  external-power-control:
    type: boolean
    description: Enable external power control instead of auto runtime PM

  pec-enable:
    type: boolean
    description:
      Enable Packet Error Check (CRC-8) on SDR private and CCC transfers, as
      well as on IBI transfers. It is not supported in HDR modes. It is used in
      both write and read transfers.

  hdr-ddr-capable:
    type: boolean
    description:
      Enables High Data Rate-Double Data Rate transfers for controllers and
      devices that support HDR-DDR. Note that HDR-DDR is only used for transfers
      above RX/TX_START_THLD, otherwise DDR-HDR overhead is not worth it. In
      case a transfer is too small, the controller will wait until the threshold
      amount of data is available to initiate the transfer.

  dma-align:
    type: u8
    description:
      Number of bytes which DMA addresses and buffers need to be aligned at. If
      not provided, the default value of 16 is used.

  dma-threshold-size:
    type: u32
    description:
      Number of bytes the transaction/message needs to be LARGER than (strict >)
      in order to use DMA instead of data FIFO CPU transmission. If not
      provided, the default value of the data FIFO is used.

  aoc-ssr-capable:
    type: boolean
    description:
      Set if I3C controller has to subscribe to AOC/AOSS SSR notifications and
      disable itself during SSR.

  i2c-speed-daa:
    type: boolean
    description:
      Set if fallback needed to safe I2C low frequency while executing OD stage of DAA command.

required:
  - compatible
  - reg
  - clocks
  - interrupts

unevaluatedProperties: false

examples:
  - |
    i3c-master@2000 {
        compatible = "snps,dw-i3c-master-1.00a";
        #address-cells = <3>;
        #size-cells = <0>;
        reg = <0x02000 0x1000>;
        interrupts = <0>;
        clocks = <&i3cclk>;

        hybrid-busy-wait-mode;
        i2c-hybrid-threshold = <30>;
        i3c-hybrid-threshold = <30>;
        i3c-threaded-threshold = <512>;

        pec-enable;
        hdr-ddr-capable;

        dma-align = <16>;
        dma-threshold-size = <128>;

        eeprom@57{
            compatible = "atmel,24c01";
            reg = <0x57 0x0 0x10>;
            pagesize = <0x8>;
        };
    };
...
```

## google-modules/soc/rdo/Documentation/devicetree/bindings/iis/google,iis.yaml
```yaml
# SPDX-License-Identifier: (GPL-2.0-only OR BSD-2-Clause)
# Copyright 2026 Google LLC
%YAML 1.2
---
$id: http://devicetree.org/schemas/iis/google,iis.yaml#
$schema: http://devicetree.org/meta-schemas/core.yaml#

title: Google IIS PDMA Driver

maintainers:
  - Chris Hockuba <khockuba@google.com>

description:
  The IIS PDMA driver is used for communication with the Trusty TA.

properties:
  compatible:
    const: google,iis

  google,ta-iis-id:
    $ref: /schemas/types.yaml#/definitions/uint32
    description:
      The application ID for the Trusty TA. Refer to documentation or
      device specific headers for correct value.

  power-domains:
    maxItems: 1

required:
  - compatible
  - google,ta-iis-id

additionalProperties: false

examples:
  - |
    iis_pdma: iis-pdma {
      compatible = "google,iis";
      google,ta-iis-id = <1>;
    };

...
```

## google-modules/soc/rdo/Documentation/devicetree/bindings/mailbox/google,mba-ctrl.yaml
```yaml
# SPDX-License-Identifier: (GPL-2.0-only OR BSD-2-Clause)
# Copyright 2022 Google LLC
%YAML 1.2
---
$id: http://devicetree.org/schemas/mailbox/google,mba-ctrl.yaml#
$schema: http://devicetree.org/meta-schemas/base.yaml#

title: Google MailBox Array Controller

maintainers:
  - Lucas Wei <lucaswei@google.com>
  - Subhash Jadavani <sjadavani@google.com>

description:
  The Google MailBox Array Controller initializes each channel with coupled
  mbox_controller. Clients add these nodes into property, mboxes, and overwrite
  status property to make channel binding to client and able to be used.

properties:
  compatible:
    enum:
      - google,mba-ctrl

  interrupts:
    description: set interrupts for message ack and host response notification.

  reg:
    description: region of client function registers.
    maxItems: 1

  "#mbox-cells":
    const: 1
    description: number of argument when writing the list of property, mboxes.
      This value must be constant value of one which is used to index mbox_chan
      from mbox_controller.

  "google,syscon-phandle":
    type: object
    description: device node of syscon phandle to access global mailbox registers.
      The second cell should hold the client ID in the NUM_MSG_REG_<client-ID>
      register block of the IDENTIFICATION registers space.

  "google,syscon-client-phandle":
    type: object
    description: Phandle to a syscon device that manages a shared client MMIO region.
      This allows multiple mailbox controller instances to safely share the
      same underlying hardware registers. If this property is not provided,
      the driver will manage its own memory mapping of the region defined
      in the 'reg' property.

  "mba-ip-version":
    type: array
    description: [optional] array of 2 elements, where the first element of the array is
      the major version and the second element is the minor version of the MBA IP.
      If the property is not present, the MBA IP VERSION will be read from the MBA IP register.

  "payload-size":
    type: integer
    description: the size of mailbox payload buffer in words (one word is 4-bytes).
      For non-queue mode interrupt-only transactions, specifying this property to zero
      allows the mailbox controller to bypass the copy of client's data to MBA hardware.

  "queue-mode":
    type: boolean
    description: configure the message address space in queue mode. Size of each slot
      is set to payload-size. (This is exclusive to other modes)

  "doorbell-mode":
    type: boolean
    description: configure the mailbox controller to run doorbell mode. When mailbox controller
      running in doorbell mode, client can ring the mailbox channels to corresponding doorbell bits
      and register channel callbacks to wait for notifications. (This is exclusive to other modes)

  "doorbell-irq-delegation":
    type: boolean
    description: configure to enable IRQ delegation feature under doorbell mode. When mailbox
      controller running in doorbell mode with IRQ delegation enabled, mailbox controller will put
      shadow IRQ status to client's callback function argument for bit clearing. Client can clear
      that shadow IRQ status to handle IRQ status bits in group in oneshot callback invocation.

required:
  - compatible
  - reg
  - interrupts
  - "#mbox-cells"
  - "google,syscon-phandle"

additionalProperties: false

examples:
  - |
    mba_sswrp_aoc_client_0: mba_sswrp_aoc_client_0@b490000 {
        compatible = "google,mba-ctrl";
        reg = <0x0 0xb490000 0x0 0x30>;
        interrupts = <GIC_SPI 0 IRQ_TYPE_LEVEL_HIGH>;
        #mbox-cells = <1>;
        google,syscon-phandle = <&aoc_mba_syscon 0>;
        mba-ip-version = < 1 0 >
        payload-size = <4>;
        queue-mode;
        status = "disabled";
    };
```
