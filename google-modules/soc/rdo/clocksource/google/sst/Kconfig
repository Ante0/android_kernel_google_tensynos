## google-modules/soc/rdo/gadget/perf_test/Kconfig
```kconfig
# SPDX-License-Identifier: GPL-2.0

config GOOGLE_PERF_GADGET
	tristate "Google perf Gadget"
	depends on ARCH_GOOGLE
	depends on USB_SUPPORT && USB_GADGET
	help
	  Google's gadget driver for USB perf testing
```
