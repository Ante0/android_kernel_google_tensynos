## google-modules/soc/rdo/clocksource/google/sst/Kconfig
```kconfig
# SPDX-License-Identifier: GPL-2.0-only

config GOOGLE_SST_PLATFORM
	tristate "Google SST PLATFORM driver"
	depends on ARCH_GOOGLE
	help
	  Enable support the sst platform
	  in RDO.
	  Select Y if you have such device.
	  If unsure select "N".
```

## google-modules/soc/rdo/cpm-cli/Kconfig
```kconfig
# SPDX-License-Identifier: GPL-2.0-only

config GOOGLE_CPM_CLI
	tristate "Google CPM command line driver"
	depends on ARCH_GOOGLE
	depends on GOOGLE_MBA_CPM_INTERFACE
	help
	  Enable support for Google CPM cli driver.
	  The driver would create a debugfs interface to send command
	  from AP to CPM.
	  If unsure select "N".
```

## google-modules/soc/rdo/cpmlog/Kconfig
```kconfig
# SPDX-License-Identifier: GPL-2.0-only

config GOOGLE_CPM_LOG
	tristate "Google CPM log driver"
	depends on ARCH_GOOGLE
	depends on GOOGLE_MBA_CPM_INTERFACE
	help
	  Enable support for Google CPM log driver.
	  The driver would create a debugfs interface to dump log.
	  The driver would get log from CPM and print it out to kernel
	  log.
	  If unsure select "N".
```

## google-modules/soc/rdo/cpu-lpm-stats/Kconfig
```kconfig
# SPDX-License-Identifier: GPL-2.0-only

config GOOGLE_CPU_LPM_STATS
	tristate "Google collect LPM stats"
	help
	  Enable support the collection of LPM stats for CPUs.
	  The driver will read the latency related data for other
	  driver usage or for userspace debugging.
	  Select Y if you have such device.
	  If unsure select "N".
```

## google-modules/soc/rdo/cpufreq/Kconfig
```kconfig
# SPDX-License-Identifier: GPL-2.0-only

config GOOGLE_CPU_FREQ
	tristate "Google CPU freq driver"
	depends on ARCH_GOOGLE
	depends on CPU_FREQ
	depends on GOOGLE_DVFS_HELPER
	select PM_OPP
	help
	  Enable support for Google CPU freq driver
```

## google-modules/soc/rdo/cs-ets/Kconfig
```kconfig
# SPDX-License-Identifier: GPL-2.0-only

config GOOGLE_ETS
	tristate "Enable support for Coresight ETS device"
	depends on CORESIGHT
	help
	  Enable support for Coresight ETS device
	  Select Y if you have such device.
	  If unsure select "N".
```

## google-modules/soc/rdo/cstate-ctrl/Kconfig
```kconfig
# SPDX-License-Identifier: GPL-2.0-only

config GOOGLE_CSTATE_CTRL
      tristate "Google driver to disable CPU cluster states via debugfs"
      depends on DEBUG_FS
      help
        This driver allows runtime enabling/disabling of CPU cluster states via
        a debugfs node. Writing to the node disables a CPU cluster's C-state,
        keeping its corresponding power domain active by casting a genpd vote.
```

## google-modules/soc/rdo/devfreq/dsufreq/Kconfig
```kconfig
# SPDX-License-Identifier: GPL-2.0-only

config GOOGLE_DSU_FREQ
	tristate "Google DSU devfreq driver"
	depends on ARCH_GOOGLE
	depends on CPU_FREQ
	select PM_OPP
	help
	  Enable support for Google DSU devfreq driver.
	  The driver would create a node to let user set devfreq
	  from userspace.
```

## google-modules/soc/rdo/drivers/clk/google/Kconfig
```kconfig
# SPDX-License-Identifier: GPL-2.0-only

config GOOGLE_CPM_CLK
	tristate "Google CPM clock driver"
	depends on ARCH_GOOGLE
	depends on GOOGLE_MBA_CPM_INTERFACE
	help
	  This driver allows clients to configure Google SoC LPCM clocks via
	  CPM using the common clock framework. This covers clocks that are not
	  supported by PFSM and PSM.
	  If unsure select "N".
```

## google-modules/soc/rdo/drivers/devfreq/Kconfig
```kconfig
# SPDX-License-Identifier: GPL-2.0-only

config GOOGLE_DEVFREQ
	tristate "Google devfreq driver"
	depends on PM_DEVFREQ
	depends on GOOGLE_DVFS_HELPER
	depends on GOOGLE_MBA_CPM_INTERFACE
	select PM_OPP
	help
	  Enable support for Google devfreq driver.
	  The devfreq driver exposes the device frequency controls.

config GOOGLE_CCF_DEVFREQ
	tristate "Google CCF-based devfreq driver"
	depends on GOOGLE_DVFS_HELPER
	depends on PM_DEVFREQ
	select PM_OPP
	help
	  Enable support for Google CCF-based devfreq driver.
	  The devfreq driver exposes the device frequency controls for the
	  clock consumer IPs of kernel-controlled clocks.
```

## google-modules/soc/rdo/drivers/dma/Kconfig
```kconfig
# SPDX-License-Identifier: GPL-2.0-only

config PL330_DMA_GOOGLE
	tristate "DMA API Driver for PL330 in Google SoCs"
	select DMA_ENGINE
	depends on ARCH_GOOGLE
	depends on ARM_AMBA
	help
	  Select if your platform is a Google SoC
	  and has one or more PL330 DMACs,
	  and you need GOOGLE_GPDMA config.
	  If unsure select "N".

config GOOGLE_GPDMA
	tristate "Google General Purpose DMA Driver"
	depends on ARCH_GOOGLE
	depends on DMA_OF
	depends on PL330_DMA_GOOGLE
	help
	  Driver to configure Google specific wrapper components around a DMA controller
	  (currently supporting only PL330) which houses a REQ-ACK matrix present in
	  Google SOCs to route Peripheral request/acknowledge signals to DMA inputs when
	  the number of peripherals present in the SOC are more then the interfaces
	  supported by the DMA Controller and also program other Quality Of Service
	  related components.
	  If unsure select "N".
```

## google-modules/soc/rdo/drivers/irqchip/Kconfig
```kconfig
# SPDX-License-Identifier: GPL-2.0-only

config GOOGLE_IRQ_CPM
	tristate "Google CPM Mailbox IRQ driver"
	depends on ARCH_GOOGLE
	depends on GOOGLE_MBA_CPM_INTERFACE
	select GENERIC_IRQ_CHIP
	help
	  Enable support for IRQs from CPM.
	  Creates an irqchip to handle mailbox messages from CPM.
	  If unsure select "N".

config GIA_LIB
	tristate "Generic Interrupt Aggregator Library"
	help
	  GIA (Generic Interrupt Aggregator) is an interrupt controller, of
	  type N:M (where M <= N & M <= 32). Basically, GIA is a software
	  view of different variety of interrupt controllers, like 32:1
	  aggregator, 32:32, 1:1 or even N:1 (N > 32). GIA Library provides
	  support for all such variations. To support any new interrupt
	  aggregator, plug-in IP specific details (pulse detection vs level,
	  offsets of various registers, different features associated with
	  the interrupt controller IP etc) and pass this on to the GIA lib.
	  The lib abstracts out everything, like registering with interrupt
	  framework, implementing handler and register routines.

	  Say 'y' if your interrupt controller IP fits under the GIA umbrella
	  and the driver for the IP wants to leverage GIA abstraction.

config GOOGLE_GIA_IRQ
	tristate "Google interrupt controller"
	depends on ARCH_GOOGLE
	select GENERIC_IRQ_CHIP
	select GIA_LIB
	help
	  Google's interrupt controller is a GIA instance. Enable this to
	  support GIA instances placed across SoC. GIA helps to get N:1
	  aggregation, multi-casting, feedthrough (N:N), edge-to-level
	  conversion etc.

config GOOGLE_IRQ_EXTENDED_SYSFS
	tristate "Google IRQ descriptor telemetry"
	help
	  IRQ framework uses sysfs framework to display bunch of interesting
	  info for each IRQ descriptors. Enable this feature to add a few more
	  files per IRQ to show its SW state and HW register status. This is
	  required until the custom added files are not part of upstream kernel.
	  A separate kernel module adds them on the fly. This should be default
	  enabled as it doesn`t cost anything runtime, and adds debug value
	  during file read time.

config GOOGLE_GIA_TEST
	tristate "Test driver for interrupts"
	depends on ARCH_GOOGLE
	help
	  Enable this to verify GIA nodes. This test driver allows you
	  to fire real interrupt handlers by triggering the line on the
	  GIA device, and to test GIA devices by registering an interrupt
	  handler at runtime on an unused line. Interaction is through
	  DebugFS files under gia_test dir. Output will be written to the
	  same file you trigger an interrupt with.

	  This is for verification. If you are unsure, say 'n'.
```

## google-modules/soc/rdo/drivers/mailbox/Kconfig
```kconfig
# SPDX-License-Identifier: GPL-2.0-only

config GOOGLE_MBA_CTRL
	tristate "Google MBA controller driver"
	depends on ARCH_GOOGLE
	depends on MAILBOX
	help
	  Enable support for the Google MailBox Array (MBA) driver.
	  Google MBA Controller driver allow the mailbox client to communicate
	  with remote host via Google MBA Controller IP.
	  Select Y if you have such device.
	  If unsure select "N".

config GOOGLE_MBA_CTRL_TEST
	tristate "Google MBA controller testing module"
	depends on GOOGLE_MBA_CTRL
	help
	  Enable this module to create test client to test the function of Google
	  MBA controller.
	  Select Y if you have such device.
	  If unsure select "N".
```

## google-modules/soc/rdo/drivers/perf/Kconfig
```kconfig
# SPDX-License-Identifier: GPL-2.0-only

config GOOGLE_GEM
	tristate "Google GEM driver"
	depends on ARCH_GOOGLE
	depends on GOOGLE_MBA_GDMC_INTERFACE
	help
	  Enable support for Google GEM driver.
	  It is a module to access Google GEM IPs functions, and expose
	  interfaces to user-space programs for profiling bus throughput and
	  performance.
	  Select Y if you have such device.
	  If unsure select "N".

config GOOGLE_GEM_TEST
	tristate "Kunit test for Google GEM driver"
	depends on ARCH_GOOGLE
	depends on KUNIT
	help
	  This builds the Google GEM driver KUnit tests.

	  For more information on KUnit and unit tests in general, please refer
	  to the KUnit documentation in Documentation/dev-tools/kunit

	  Select Y if you have such device.
	  If unsure select "N".
```

## google-modules/soc/rdo/drivers/power/Kconfig
```kconfig
# SPDX-License-Identifier: GPL-2.0-only

config GOOGLE_GENPD_TEST_CONSUMER
	tristate "Genpd test consumer driver"
	help
	  This driver consumes a power domain defined in device
	  tree.
	  It is useful for testing power-related functionalities.
	  As this is for verification purpose, select "N" if unsure.
```

## google-modules/soc/rdo/drivers/rst/google/Kconfig
```kconfig
# SPDX-License-Identifier: GPL-2.0

config GOOGLE_CPM_RST
	tristate "Google CPM reset driver"
	depends on ARCH_GOOGLE
	depends on GOOGLE_MBA_CPM_INTERFACE
	select RESET_CONTROLLER
	help
	  This driver allows clients to configure Google SoC LPCM resets via
	  CPM using the Linux reset controller APIs.
	  Select Y if you have such device.
	  If unsure select "N".

config GOOGLE_CPM_RST_TEST
	tristate "Unit test for Google CPM reset driver"
	depends on ARCH_GOOGLE
	depends on KUNIT
	help
	  Add unit test for rst-cpm driver.
	  Use kunit testing tools.
	  Select Y if you have such device.
	  If unsure select "N".
```

## google-modules/soc/rdo/drivers/soc/google/cdd-cpu/Kconfig
```kconfig
# SPDX-License-Identifier: GPL-2.0-only

config GOOGLE_CDD_CPU_IDLE_INFO
	tristate "Google CDD record cpu idle info"
	default n
	help
	  This is a test module that collects cpu idle information. In this
	  module a notifier is register to collect cpu_pm events. The
	  collection is triggered when a low power cpu_pm event occurs.
	  Specifically, CPU_PM_ENTER and CPU_CLUSTER_PM_ENTER events are logged
	  as CDD_FLAG_IN, while all other event kinds are logged as
	  CDD_FLAG_OUT.
```

## google-modules/soc/rdo/drivers/soc/google/cdd/Kconfig
```kconfig
# SPDX-License-Identifier: GPL-2.0-only

config GOOGLE_CRASH_DEBUG_DUMP
	tristate "Google Crash Debug Dump"
	depends on ARCH_GOOGLE
	depends on ARM64
	default n
	help
	  Crash Debug Dump supports SoC debugging easily. This feature
	  supports to trace other module events such frequceny change and IPC.
	  This supports to save GPR and PC when panic or exception and
	  to enter ramdump mode when panic is occurred and other exception.
	  This supports to reserve memory for h/w debug feature such as
	  scan2dram, cachedump.

config GOOGLE_CDD_NR_CPUS
	int "NR CPUS for kevent"
	range 1 16
	default 8
	depends on GOOGLE_CRASH_DEBUG_DUMP
	help
	  This sets the number of cores for the kevents logging data structure declaration.

config GOOGLE_CDD_FREQ_DOMAIN_NUM
	int "Number of freq logging domain types"
	depends on GOOGLE_CRASH_DEBUG_DUMP
	range 4 32
	default 32
	help
	  This option decides number of frequency logging domain types.

config GOOGLE_CDD_LOG_ITEM_SIZE
	int "Size of logging item"
	depends on GOOGLE_CRASH_DEBUG_DUMP
	range 256 1024
	default 1024
	help
	  This option decides size of logging item.
```

## google-modules/soc/rdo/drivers/soc/google/fwtp/Kconfig
```kconfig
# SPDX-License-Identifier: GPL-2.0

config FWTP_CPM
	tristate "CPM firmware tracepoint module"
	help
	  Enable support for reading and publishing CPM firmware
          tracepoints.
	  Select Y if you have such device.
	  If unsure select "N".

config FWTP_GOOGLE_GDMC
	tristate "Google GDMC firmware tracepoint module"
	depends on GOOGLE_MBA_GDMC_INTERFACE
	depends on FWTP
	help
	  Enable support for reading and publishing Google GDMC firmware
	  tracepoints.
	  Select Y if you have such device.
	  If unsure select "N".

config FWTP
	tristate "Google firmware tracepoint module"
	help
	  Enable support for reading and publishing Google firmware tracepoints.
	  Select Y if you have Google firmware.
	  If unsure select "N".
```

## google-modules/soc/rdo/drivers/spmi/Kconfig
```kconfig
# SPDX-License-Identifier: GPL-2.0-only

config GOOGLE_SPMI_MBA
	tristate "Google SPMI over mailbox driver"
	depends on ARCH_GOOGLE
	help
	  This enables the SPMI controller for accessing the SPMI bus over
	  the MBA interface.

config GOOGLE_REGMAP_SPMI
	tristate "Google SPMI regmap inteface"
	depends on ARCH_GOOGLE
	help
	  This enables the SPMI regmap interface

config SPMI_SMARTDV
	tristate "SmartDV SPMI Controller"
	select IRQ_DOMAIN_HIERARCHY
	depends on HAS_IOMEM
	depends on SPMI
	help
	  If you say yes to this option, support will be included for the
	  SmartDV IP Solutions SPMI controller driver.

	  This is required for communicating with devices that have the
	  SPMI interface.
```

## google-modules/soc/rdo/drivers/tty/serial/8250/Kconfig
```kconfig
# SPDX-License-Identifier: GPL-2.0

config SERIAL_8250_DW_GOOGLE_QUIRKS
	tristate "Support for Synopsys DesignWare 8250 quirks"
	depends on ARCH_GOOGLE
	depends on SERIAL_8250
	select SERIAL_8250_DWLIB
	help
	  Selecting this option will enable handling of the extra features
	  present in the Synopsys DesignWare APB UART.
```

## google-modules/soc/rdo/edac/Kconfig
```kconfig
# SPDX-License-Identifier: GPL-2.0-only

config GOOGLE_EDAC
	tristate "Google EDAC driver"
	depends on ARCH_GOOGLE
	help
	  Enable support for Google EDAC(Error Dectection And Correction).
	  This driver exposes to userspace see if cache error happened.
	  Select Y if you have such device.
	  If unsure select "N".
```

## google-modules/soc/rdo/experimental/Kconfig
```kconfig
# SPDX-License-Identifier: GPL-2.0-only

#
# RDO experimental driver
#
menuconfig RDO_EXPERIMENTAL
	bool "RDO experimental"
	depends on ARCH_GOOGLE
	help
	  Say Y here to get to see options for rdo expermental drivers.
	  This option alone does not add any kernel code.

	  If you say N, all options in this submenu will be skipped and disabled.

if RDO_EXPERIMENTAL

config RDO_CPUIDLE_WFI_ONLY
	tristate "RDO_CPUIDLE_WFI_ONLY"
	depends on CPU_IDLE
	help
	  This driver is to test a cpuidle driver with wfi.

config RDO_EXPERIMENTAL_MBA
	tristate "Old and experimental MBA driver."
	help
	  Old and experimental MBA driver.

config RDO_EXPERIMENTAL_PMIC
	tristate "PMIC mock driver."
	help
	  PMIC mock driver for support of reboot.

config RDO_EXPERIMENTAL_APT
	tristate "APT driver"
	help
	  Apt driver.

config RDO_EXPERIMENTAL_MANUAL_LPCM
	tristate "LPCM driver with manual sequence"
	help
	  LPCM driver with manual defined setup operations in device tree.
	  This is a hack for emulation platforms that does not yet have CPM
	  to enable IPs.
	  If unsure select "N".

endif # RDO_EXPERIMENTAL
```

## google-modules/soc/rdo/gadget/dta/Kconfig
```kconfig
# SPDX-License-Identifier: GPL-2.0

config GOOGLE_DTA_GADGET
	tristate "Google DTA Gadget"
	depends on ARCH_GOOGLE
	depends on USB_SUPPORT && USB_GADGET
	help
	  Google's gadget driver to enable USB debug tracing.
```
