## google-modules/soc/rdo/drivers/ufs/Kconfig
```kconfig
# SPDX-License-Identifier: GPL-2.0-only

config UFS_DW_GOOGLE
	tristate "Google UFS Driver"
	depends on ARCH_GOOGLE
	depends on SCSI_UFSHCD_PLATFORM
	help
	  This adds Google UFS variant driver based on DWC
	  required for UFS in RDO
	  Select "Y" if you have such device.
	  If unsure select "N".

config UFS_PIXEL_FEATURES
	bool "Enable Pixel specific features"
	help
	  This option enables Pixel specific features in addition to the
	  platform driver.

config UFS_PIXEL_CRYPTO
	bool "Enable Pixel UFS encryption"
	depends on SCSI_UFS_CRYPTO
	help
	  This option enables Pixel support for Android encryption services.

config UFS_PIXEL_UIC_ERR_DEBUG
	bool "Enable UIC error debug"
	help
	  This option enables UIC error debug feature for the early phase
	  of the new platform bringup. Once any UIC error occurs, the UFS
	  driver will trigger a kernel panic.
	  Select "Y" only if you are working on the new platform bringup,
	  otherwise it should be disabled.

config UFS_PIXEL_READ_BOOST
	bool "Enable the Read Boost feature"
	depends on UFS_PIXEL_FEATURES
	help
	  This option enables support for the Read Boost feature.
```

## google-modules/soc/rdo/ebu/Kconfig
```kconfig
# SPDX-License-Identifier: GPL-2.0-only

config GOOGLE_EBU
	tristate "Google EBU Driver"
	depends on ARCH_GOOGLE
	depends on GOOGLE_LCM
	help
	  Driver for the Google EBU IP
	  If unsure select "N".
```

## google-modules/soc/rdo/pci/Kconfig
```kconfig
# SPDX-License-Identifier: GPL-2.0-only

config PCIE_DW_GOOGLE_V2
	tristate "Google PCIe root complex driver support v2"
	depends on PCI
	depends on PCIE_GOOGLE_PHY
	select PCIE_DW_HOST
	select PCI_HOST_COMMON
	select PCI_PWRCTL if HAVE_PWRCTL
	help
	  Enable support for the v2 PCIe controller
	  root complex driver.
	  Select Y if you have such device.
	  If unsure select "N".

config PCIE_DW_GOOGLE
	tristate "Google PCIe root complex driver support"
	depends on ARCH_GOOGLE
	depends on PCI
	depends on GOOGLE_CPM_CLK
	depends on GOOGLE_IRM
	select PCIE_DW_HOST
	help
	  Enable support for the PCIe controller
	  root complex driver.
	  Select Y if you have such device.
	  If unsure select "N".

config PCIE_GOOGLE_PHY
	tristate "Google PCIe phy driver"
	depends on ARCH_GOOGLE
	help
	  Enable support for the PCIe phy driver for
	  google platforms.
	  Select Y if you have such a device.
	  If unsure select "N".
```

## google-modules/soc/rdo/power-controller/Kconfig
```kconfig
# SPDX-License-Identifier: GPL-2.0-only

config GOOGLE_POWER_CONTROLLER
	tristate "Google power controller driver"
	depends on GOOGLE_MBA_CPM_INTERFACE
	select PM_GENERIC_DOMAINS
	help
	  This driver allows client to power on/off Google SoC
	  power domains via generic power domain framework.
	  For GPU, it directly update LPCM registers. For other
	  sswrps, it sends a MBA mailbox to CPM to request toggle
	  the power domains.

config GOOGLE_SYSPM
	tristate "Power request rerouting to SysPM"
	depends on GOOGLE_POWER_CONTROLLER
	help
	  Enable power domain request rerouting to interface
	  provided by SysPM framework. If unsure do not enable.
```

## google-modules/soc/rdo/usb/Kconfig
```kconfig
# SPDX-License-Identifier: GPL-2.0-only

config USB_DWC3_GOOGLE
	tristate "Google DWC3 USB"
	depends on ARCH_GOOGLE
	depends on USB_DWC3 && GOOGLE_IRM
	help
	  Google's Glue driver for the Synopsys DWC3 USB controller.
	  If unsure select "N".

config USB_DWC3_GOOGLE_AUX
	tristate "Google DWC3 Aux USB Driver"
	depends on ARCH_GOOGLE
	depends on USB_DWC3 && GOOGLE_IRM
	help
	  Google's Glue driver for the Synopsys DWC3 host only auxilary
	  USB controller. This driver is used to provide a second USB
	  controller on a system.
	  If unsure select "N".
```

## google-modules/touch/common/Documentation/devicetree/bindings/touch/platform-device-touch.yaml
```yaml
# SPDX-License-Identifier: (GPL-2.0-only OR BSD-2-Clause)
%YAML 1.2
---
$schema: http://devicetree.org/meta-schemas/core.yaml#

title: Google Touch Interface Driver for Pixel

maintainers:
  - Super Liu <supercjliu@google.com>

description:
  This binding describes the capatilities for this interface.

properties:
  goog,dev-id:
    type: integer
    description: The device ID for this interface.

  goog,panel_map:
    type: phandle
    description: A map of panel IDs to device tree nodes.

  goog,firmware_names:
    type: string-array
    description: An array of firmware file names.

  goog,config_names:
    type: string-array
    description: An array of configuration file names.

  goog,test_limits_names:
    type: string-array
    description: An array of test limits file names.

  goog,offload-device-name:
    type: string
    description: The name of the touch offload device.

  goog,touch_offload_ids:
    type: array
    description: An array of touch offload IDs.

  goog,touch_offload_id:
    type: array
    description: The touch offload ID.

  goog,channel-num:
    type: array
    description: The number of channels for the heatmap. The first element is the width, the second is the height.

  goog,offload-caps-data-types:
    type: integer
    description: The supported data types for touch offload.

  goog,offload-caps-scan-types:
    type: integer
    description: The supported scan types for touch offload.

  goog,offload-caps-context-channel-types:
    type: integer
    description: The supported context channel types for touch offload.

  goog,offload-caps-cancel-reporting-disabled:
    type: boolean
    description: Disable cancel reporting for touch offload.

  goog,offload-caps-coord-filter:
    type: boolean
    description: Enable coordinate filtering for touch offload.

  goog,offload-caps-rotation-reporting-disabled:
    type: boolean
    description: Disable rotation reporting for touch offload.

  goog,offload-enabled:
    type: boolean
    description: Enable touch offload.

  goog,default-grip-disabled:
    type: boolean
    description: Disable grip rejection by default.

  goog,default-palm-disabled:
    type: boolean
    description: Disable palm rejection by default.

  goog,default-coord-filter-disabled:
    type: boolean
    description: Disable coordinate filtering by default.

  goog,report-rate:
    type: integer
    description: The report rate in Hz.

  goog,v4l2-enabled:
    type: boolean
    description: Enable V4L2 for heatmap.

  goog,usb-psy-name:
    type: string
    description: The name of the USB power supply.

  goog,tbn-protection-enabled:
    type: boolean
    description: Enable touch bus negotiator protection.

  goog,tbn-enabled:
    type: boolean
    description: Enable touch bus negotiator.

  goog,timestamp-correction-enabled:
    type: boolean
    description: Enable timestamp correction.

  goog,default-report-rate:
    type: integer
    description: The default report rate in Hz.

  goog,ignore-force-active:
    type: boolean
    description: Ignore force active state.

  goog,coord-filter-enabled:
    type: boolean
    description: Enable coordinate filtering.

  goog,manual-heatmap-from-irq:
    type: boolean
    description: Get heatmap data manually from IRQ.

  goog,lptw-suppress-coords-enabled:
    type: boolean
    description: Enable LPTW suppress coordinates.

  goog,display-resolution:
    type: array
    description: The display resolution. The first element is the width, the second is the height.

  goog,lptw-tracking-area:
    type: array
    description: The LPTW tracking area. The four elements are min_x, max_x, min_y, max_y.

  goog,late-sense-on-enabled:
    type: boolean
    description: Enable late sense on.

  goog,panel-notifier-enabled:
    type: boolean
    description: Enable panel notifier.

  goog,reset-after-selftest:
    type: boolean
    description: Reset after selftest.

  goog,init-mf-mode:
    type: integer
    description: The initial MF mode.

  goog,panel-map-from-tic:
    type: boolean
    description: Get panel map from TIC.

  goog,vrr-enabled:
    type: boolean
    description: Enable VRR.

  goog,vrr-display-rate:
    type: array
    description: The VRR display rate table.

  goog,vrr-touch-rate:
    type: array
    description: The VRR touch rate table.

  goog,vrr-up-delay:
    type: integer
    description: The VRR up delay in ms.

  goog,vrr-down-delay:
    type: integer
    description: The VRR down delay in ms.

  goog,touch-sim-enabled:
    type: boolean
    description: Enable touch simulation.

  goog,vrr-enabled:
    type: boolean
    description: Enable VRR and will be obsolete after V2.

  goog,vrr-display-rate:
    type: array
    description: The VRR display rate table and will be obsolete after V2.

  goog,vrr-touch-rate:
    type: array
    description: The VRR touch rate table and will be obsolete after V2.

  goog,vrr-up-delay:
    type: integer
    description: The VRR up delay in ms and will be obsolete after V2.

  goog,vrr-down-delay:
    type: integer
    description: The VRR down delay in ms and will be obsolete after V2.

  goog,touch-sim-enabled:
    type: boolean
    description: Enable touch simulation.

additionalProperties: false

examples:

&PLATFORM-INTERFACE-ROOT: {
	status = "okay";
	#address-cells = <1>;
	#size-cells = <0>;

	&PLATFORM-INTERFACE-CLIENT: touchscreen@0 {
		status = "ok";
		#address-cells = <1>;
		#size-cells = <1>;

		goog,dev-id = <1>;
		goog,offload-device-name = "fts_ext"; /* append after "touch_offload_" */
		goog,tbn-enabled;
		goog,offload-enabled;
		goog,v4l2-enabled;
		goog,touch_offload_id = /bits/ 8 <'f''1''0''1'>; /* outer: 1; inner 0 */
		goog,display-resolution = /bits/ 16 <1079 2091>;
		goog,channel-num = /bits/ 16 <16 31>;
		goog,offload-caps-data-types = /bits/ 16 <0x1f>;
		goog,offload-caps-scan-types = /bits/ 16 <0xc0>;
		goog,default-grip-disabled;
		goog,default-palm-disabled;
	};
};
```

## google-modules/touch/common/usi/Kconfig
```kconfig
config GOOG_USI_STYLUS
	tristate "Google USI Stylus Subsystem"
	help
	  Say Y here if you want to enable the Google USI Stylus Subsystem.

	  If unsure, Say N.
```

## google-modules/uwb/slsi/u100/Documentation/devicetree/bindings/uwb/samsung,u100.yaml
```yaml
# SPDX-License-Identifier: (GPL-2.0-only OR BSD-2-Clause)
# Copyright 2025 Google LLC
%YAML 1.2
---

$schema: http://devicetree.org/meta-schemas/core.yaml#

title: Google SLSI U100 UWB Driver

description: UWB driver for SLI U100
maintainers:
  - Victor Liu <victorliu@google.com>

properties:
  compatible:
    type: string
    description: Compatible string for the device.
    const: "slsi,u100"

  reg:
    description: CS address of SPI device

  pinctrl-names:
    type: array
    description: Names of pinctrl states.
    items:
      type: string
      default: ["default", "func"]

  pinctrl-0:
    type: array
    description: Pinctrl configuration for "default" state.

  pinctrl-1:
    type: array
    description: Pinctrl configuration for "func" state.

  u100-rst-gpios:
    description: GPIO descriptor for the reset line.

  u100-en-gpios:
    description: GPIO descriptor for the enable line.

  u100-sync-gpios:
    description: GPIO descriptor for the sync gpio line.

  u100-power-switch-gpios:
    description: GPIO descriptor for the power switch gpio line.

  ignore-boot-error:
    description: Flag to ignore boot error.

required:
  - compatible
  - reg
  - u100-reset-gpios
  - u100-en-gpios
  - u100-sync-gpios

examples:
  - |
    u100@0 {
      compatible = "samsung,u100";
      reg = <0>;
      pinctrl-0 = <&uwb2aoc_int_1v2>, <&ap2uwb_rst_l_1v2>,
        <&aoc2uwb_en_1v2>, <&ap2uwb_vsys_disable_l_1v2_default>;
      pinctrl-1 = <&uwb2aoc_int_1v2>, <&ap2uwb_rst_l_1v2_sleep>,
        <&aoc2uwb_en_1v2_sleep>, <&ap2uwb_vsys_disable_l_1v2_default_sleep>;
      pinctrl-names = "default", "sleep";
      interrupt-parent = <&aoc_pinctrl>;
      interrupts = <XAOC_GPIO4 0 0>;
      u100-rst-gpios = <AP2UWB_RST_L_1V2(GPIO_ACTIVE_LOW)>;
      u100-en-gpios = <&aoc_pinctrl XAOC_GPIO3 (GPIO_ACTIVE_HIGH | GPIO_PULL_DOWN)>;
      u100-sync-gpios = <AOC2UWB_WAKEUP_SYNC_1V2(GPIO_ACTIVE_HIGH)>;
      status = "okay";
    };
```

## google-modules/video/cnm/Kconfig
```kconfig
# SPDX-License-Identifier: GPL-2.0-only
#
# Codec3P configuration
#
comment "Codec3P video codec"

config CODEC3P
	tristate "Codec3P video codec"
	default n
	help
	Driver for Codec3P video codec

config CODEC3P_SLC
	bool "Codec3P SLC support"
	default y
	depends on GOOGLE_RA
	depends on SLC_PARTITION_MANAGER
	help
	  Enable SLC for Codec3P. This config
	  require GOOGLE_RA and SLC_PARTITION_MANAGER.
	  Select Y if you have such device.
	  If unsure select "N".

config CODEC3P_VCORE_APG
	bool "Codec3P VCORE power gating support"
	default n
	help
	  Enable VCORE auto power gating handling
	  for Codec3P. Select "y" if your device
	  supports VCORE APG and "n" if not.

config CODEC3P_VPU_RESET
	bool "Codec3P VPU reset line support"
	default n
	help
	  Enable VPU reset line usage for CODEC3P.
	  Select "y" if your device supports VPU
	  reset and "n" if not.

config VPU_ANY_HEAP_ALLOC
	bool "VPU enable allocation from any heap"
	default y
	help
	  Allow userspace to select any heap (system,
	  system-uncached, vframe-secure) for VPU
	  buffer alloc. Select "n" to force allocation
	  from system-uncached during bringup.

config VPU_DEVFREQ
	bool "VPU devfreq enablement"
	default y
	help
	  Enable frequency voting for VPU. Select "n" if
	  devfreq dependency not met during bringup.

config VPU_ICC
	bool "VPU icc enablement"
	default y
	help
	  Enable bandwidth voting for VPU. Select "n" if
	  icc dependency not met during bringup.

config VPU_POWER_DOMAIN
	bool "VPU power domain enablement"
	default y
	help
	  Enable power domain for VPU. Select "n" if
	  power domain dependency not met during bringup.

config VPU_SECURITY
	bool "VPU security enablement"
	default y
	help
	  Enable secure FW for VPU. Select "n" if
	  trusty dependency not met during bringup.
```

## google-modules/wlan/qcom/wcn6740/cnss2/cnss2/defconfig
```kconfig
CONFIG_CNSS2=m
CONFIG_CNSS2_DEBUG=y
CONFIG_CNSS2_QMI=y
CONFIG_WCN_GOOGLE=y
CONFIG_QCOM_RAMDUMP=y
CONFIG_QCOM_MEMORY_DUMP_V2=y
```

## google-modules/wlan/qcom/wcn6740/cnss2/cnss_utils/Kconfig
```kconfig
# SPDX-License-Identifier: GPL-2.0-only

config CNSS_OUT_OF_TREE
	bool "Enable Out of Tree Usage"
	help
	  If enabled, CNSS platform driver modules would be able to access
	  functions from the other modules in the platform driver.

config WCN_GOOGLE
    bool "CNSS2 for Google platform"
    help
      This option is to enable CNSS2 for google platform.

config CNSS_UTILS
	tristate "CNSS utilities support"
	help
	  Add CNSS utilities support for the WLAN driver module.
	  This feature enables wlan driver to use CNSS utilities APIs to set
	  and get wlan related information.

config CNSS_QMI_SVC
	tristate "CNSS QMI SVC support"
	help
	  Add CNSS QMI SVC support for the WLAN driver module.
	  This feature enable wlan driver to use CNSS QMI service APIs to set
	  and get wlan related information.

config CNSS_PLAT_IPC_QMI_SVC
	tristate "CNSS Platform QMI IPC Support"
	help
	  Add CNSS platform kernel and user space components IPC using QMI.
```
