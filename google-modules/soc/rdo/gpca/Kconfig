## google-modules/soc/rdo/gpca/Kconfig
```kconfig
# SPDX-License-Identifier: GPL-2.0-only

config GOOGLE_GPCA
	tristate "Google GPCA driver"
	depends on ARCH_GOOGLE
	select CRYPTO_AEAD
	select CRYPTO_AKCIPHER
	select ASN1
	select ASN1_ENCODER
	help
	  Enable support for Google GPCA.
	  GPCA is the General Purpose Crypto Accelerator which handles
	  Cryptography and Key Management Operations.
	  GPCA is built as a loadable module.

config GOOGLE_GPCA_CRYPTO_TEST
	tristate "Test for Google GPCA crypto driver" if !KUNIT_ALL_TESTS
	depends on GOOGLE_GPCA && KUNIT
	default KUNIT_ALL_TESTS
	help
	  Enable GPCA Key Management Unit test.
	  This test is built as a loadable module.
	  The test suite can be run by inserting the module.
	  It is a KUnit test and needs CONFIG_KUNIT to be enabled and set
	  kunit.enable = 1 in bootargs kernel command line parameter.

config GOOGLE_GPCA_KEY_TEST
	tristate "Test for Google GPCA Key driver" if !KUNIT_ALL_TESTS
	depends on GOOGLE_GPCA && KUNIT
	default KUNIT_ALL_TESTS
	help
	  Enable GPCA Key Management Unit test.
	  This test is built as a loadable module.
	  The test suite can be run by inserting the module.
	  It is a KUnit test and needs CONFIG_KUNIT to be enabled and set
	  kunit.enable = 1 in bootargs kernel command line parameter.
```

## google-modules/soc/rdo/hardlockup-debug/Kconfig
```kconfig
# SPDX-License-Identifier: GPL-2.0-only

config HARDLOCKUP_DEBUG_LGA
	tristate "Hardlockup Debugging"
	depends on ARM64
```

## google-modules/soc/rdo/interconnect/Kconfig
```kconfig
# SPDX-License-Identifier: GPL-2.0-only

config GOOGLE_IRM
	tristate "Google IRM driver"
	depends on ARCH_GOOGLE
	depends on INTERCONNECT
	help
	  Enable support for Google IRM.
	  IRM is Interconnect Resource Manager which can be used for
	  configuring bandwidth/latency limits by each subsystem drivers.
	  If unsure select "N".

config GOOGLE_ICC_HELPER_MOCK_CLIENT
	tristate "Google ICC Helper Mock Client driver"
	depends on GOOGLE_IRM
	help
	  Enable support for Google ICC Helper Mock Client driver.
	  ICC Helper Mock Client driver provides debugfs knobs to enable
	  calling Google ICC helper APIs from user-space by writing the
	  debugfs knobs.
	  If unsure select "N".
```

## google-modules/soc/rdo/ip-idle-notifier/Kconfig
```kconfig
# SPDX-License-Identifier: GPL-2.0-only

config GOOGLE_IP_IDLE_NOTIFIER
	tristate "Google IP idle notifier driver"
	depends on ARCH_GOOGLE
	depends on GOOGLE_MBA_CPM_INTERFACE
	help
	  Enable support for Google IP idle notifier driver.
	  The driver would collect the states of IP (busy/idle)
	  and write them to the shared-memory of CPM.
	  If unsure select "N".
```

## google-modules/soc/rdo/lpcm/Kconfig
```kconfig
# SPDX-License-Identifier: GPL-2.0

config GOOGLE_GPU_PF_STATE
	tristate "Google GPU PF STATE driver"
	depends on ARCH_GOOGLE
	depends on GOOGLE_DVFS_HELPER
	help
	  This is Google GPU PF STATE driver. This driver
	  allows clients to change power frequency of GPU by
	  providing a common clock framework interface.
	  If unsure select "N".

config GOOGLE_PF_STATE_CPM
	tristate "PF State CPM driver"
	depends on ARCH_GOOGLE
	depends on GOOGLE_DVFS_HELPER
	help
	  This driver allows clients to change power frequency
	  of some SSWRPs by providing a common clock framework interface.
	  Given a frequency, it sends a MBA message to CPM to ask CPM
	  to set the corresponding power frequency state (pf state) of LPCM.
```

## google-modules/soc/rdo/mem-qos/Kconfig
```kconfig
# SPDX-License-Identifier: GPL-2.0-only

config GOOGLE_MEM_QOS
	tristate "Google QoS Box driver"
	depends on ARCH_GOOGLE
	help
	  Enable support for Google QoS Box.
	  This driver implements register programming sequence to support
	  QoS related configurations for each IP block which contains QoS Box.
	  If unsure select "N".

config GOOGLE_MEM_QOS_MOCK_CLIENT
	tristate "Google Mem QoS Mock Client driver"
	depends on GOOGLE_MEM_QOS
	help
	  Enable support for Google Mem QoS Mock Client driver.
	  Mem QoS Mock Client driver provides debugfs knobs to enable
	  calling Google Mem QoS APIs from user-space by writing the
	  debugfs knobs.
	  If unsure select "N".
```

## google-modules/soc/rdo/odpm/Kconfig
```kconfig
# SPDX-License-Identifier: GPL-2.0-only

config GOOGLE_ODPM
	tristate "Google ODPM driver"
	depends on ARCH_GOOGLE
	depends on IIO
	depends on GOOGLE_MBA_CPM_INTERFACE
	help
	  Enable support for Google ODPM.
	  It is a software power monitor tool.
	  Select Y if you have such device.
	  If unsure select "N".
```

## google-modules/soc/rdo/phy/Kconfig
```kconfig
# SPDX-License-Identifier: GPL-2.0-only

config GOOGLE_USB_PHY
	tristate "Google USB PHY"
	depends on ARCH_GOOGLE
	help
	  Google's USB PHY driver.
	  If unsure select "N".

config GOOGLE_EUSB2_REPEATER
	tristate "Google eUSB2 repeater"
	help
	  Google's eUSB repeater driver.
	  If unsure select "N".
```

## google-modules/soc/rdo/powerdashboard/Kconfig
```kconfig
# SPDX-License-Identifier: GPL-2.0-only

config GOOGLE_POWERDASHBOARD
	tristate "Google power dashboard"
	depends on ARCH_GOOGLE
	depends on GOOGLE_MBA_CPM_INTERFACE
	help
	  Enable support the powerdashboard driver
	  in RDO.
	  The driver will read the power related data for other
	  driver usage or for userspace debugging.
	  Select Y if you have such device.
	  If unsure select "N".
```

## google-modules/soc/rdo/pwm/Kconfig
```kconfig
# SPDX-License-Identifier: GPL-2.0-only

config FARADAY_PWM
	tristate "Faraday PWM Controller Driver Support"
	depends on ARCH_GOOGLE
	depends on PWM
	help
	  Enable support for the PWM controller
	  on Google devices.
	  Select Y if you have such device.
	  If unsure select "N".
```

## google-modules/soc/rdo/soc/google/Kconfig
```kconfig
# SPDX-License-Identifier: GPL-2.0-only

config GOOGLE_SLC
	tristate "Google system level cache driver"
	depends on ARCH_GOOGLE
	depends on SLC_PARTITION_MANAGER
	depends on GOOGLE_MBA_CPM_INTERFACE
	help
	  Enable support for the Google system level cache driver
	  The driver is used to provide an interface for clients to
	  request an allocation in the cache. Clients can also disable
	  the partition or request changes in partition parameters as needed
```

## google-modules/soc/rdo/thermal/Kconfig
```kconfig
# SPDX-License-Identifier: GPL-2.0

config GOOGLE_THERMAL
	tristate "Google thermal drvier"
	depends on ARCH_GOOGLE
	depends on THERMAL
	depends on GOOGLE_MBA_CPM_INTERFACE
	help
	  Enable support the thermal driver
	  in RDO.
	  Select Y if you have such device.
```

## google-modules/soc/rdo/trace/Kconfig
```kconfig
# SPDX-License-Identifier: GPL-2.0-only

config GOOGLE_TRACE_SOURCE
	tristate "Google trace source device"
	depends on CORESIGHT
	help
	  Enable support the google trace source
	  in RDO.
	  Select Y if you have such device.
	  If unsure select "N".
```

## google-modules/soc/rdo/watchdog/Kconfig
```kconfig
# SPDX-License-Identifier: GPL-2.0-only

if WATCHDOG

config GOOGLE_WDT
	tristate "Google WDT driver"
	depends on ARCH_GOOGLE
	depends on WATCHDOG_CORE
	help
	  Enable support the watchdog device
	  in RDO.
	  Select Y if you have such device.
	  If unsure select "N".

config GOOGLE_WDT_TEST
	tristate "Kunit test for Google WDT driver"
	depends on ARCH_GOOGLE
	depends on KUNIT
	help
	  Unit test for watchdog device
	  in RDO.
	  Select Y if you have such device.
	  If unsure select "N".

endif
```

## google-modules/touch/focaltech/ft3658/Kconfig
```kconfig
#
# Focaltech Touchscreen driver configuration
#

config TOUCHSCREEN_FTS
    tristate "Focaltech Touchscreen"
    default n
    help
      Say Y here if you have Focaltech touch panel.
      If unsure, say N.

config TOUCHSCREEN_FTS_DIRECTORY
    string "Focaltech ts directory name"
    default "focaltech_touch"
    depends on TOUCHSCREEN_FTS

config TOUCHSCREEN_PANEL_BRIDGE
    bool "Focaltech panel bridge"
    depends on TOUCHSCREEN_FTS
    help
      Focaltech panel bridge
```

## google-modules/touch/goodix/defconfig
```kconfig
CONFIG_GTI_PM=y
CONFIG_TOUCHSCREEN_GOODIX_BRL=m
CONFIG_TOUCHSCREEN_GOODIX_BRL_SPI=y
```

## google-modules/touch/synaptics/syna_c10/defconfig
```kconfig
CONFIG_TOUCHSCREEN_SYNA_TCM2=m
CONFIG_TOUCHSCREEN_SYNA_TCM2_REFLASH=y
CONFIG_TOUCHSCREEN_SYNA_TCM2_SYSFS=y
CONFIG_TOUCHSCREEN_SYNA_TCM2_TESTING=y
```

## google-modules/uwb/qorvo/qm35/qm35s/Kconfig
```kconfig
# SPDX-License-Identifier: GPL-2.0-or-later

config QM35_SPI
	tristate "qm35 spi"
	help
	  qm35 spi

config QM35_SPI_DEBUG_FW
	bool "qm35 spi debug fw"
	depends on QM35_SPI
	help
	  qm35 spi debug fw
```

## google-modules/video/gchips/Kconfig
```kconfig
# SPDX-License-Identifier: GPL-2.0-only
#
# BigWave configuration
#
comment "BigWave video codec"

config BIGWAVE
	tristate "BigWave video codec"
	depends on EXYNOS_BTS
	default n
	select PM
	help
	Driver for BigWave video codec

config BIGWAVE_ENABLE_SLC
	bool "BigWave enable SLC"
	depends on BIGWAVE
	help
	Enable SLC for BigWave video codec
```

## google-modules/wlan/wlan_ptracker/Kconfig
```kconfig
# SPDX-License-Identifier: GPL-2.0-only
#
# WiFi Performance Tracker Driver
#

config WLAN_PTRACKER
	tristate "WiFi performance tracker driver"
	help
		Module for wlan performance tracker.

config DYNAMIC_TWT_SETUP
	bool "dynamic twt setup"
	depends on WLAN_PTRACKER
	help
		dynamic twt setup
```
