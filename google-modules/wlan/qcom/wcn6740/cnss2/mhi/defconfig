## google-modules/wlan/qcom/wcn6740/cnss2/qmi/Kconfig
```kconfig
# SPDX-License-Identifier: GPL-2.0-only
#

config QCOM_QMI_HELPERS
	tristate "config QCOM_QMI_HELPERS"
	help
	  QCOM_QMI_HELPERS Support
```

## google-modules/wlan/qcom/wcn6740/wlan/qcacld-3.0/configs/default_defconfig
```kconfig
CONFIG_QCA_CLD_WLAN=m
CONFIG_QCA_WIFI_QCA6490=y
CONFIG_QCA6490_HEADERS_DEF=y
CONFIG_BUS_AUTO_SUSPEND=y
CONFIG_CNSS_OUT_OF_TREE=y
CONFIG_WCN_GOOGLE=y
CONFIG_WLAN_HOST_ARCH_ARM=y
CONFIG_WLAN_CTRL_NAME="wlan"
CONFIG_CHIP_VERSION=2

CONFIG_HANDLE_RX_REROUTE_ERR=y
CONFIG_DIRECT_BUF_RX_ENABLE=y
CONFIG_DBR_HOLD_LARGE_MEM=y
CONFIG_WMI_DBR_SUPPORT=y
CONFIG_WLAN_CFR_ENABLE=y
CONFIG_WLAN_ENH_CFR_ENABLE=y
CONFIG_LITHIUM=y
CONFIG_WLAN_FEATURE_11AX=y
CONFIG_WLAN_FEATURE_DFS_OFFLOAD=y
CONFIG_SCALE_INCLUDES=y
CONFIG_HASTINGS_BT_WAR=y
CONFIG_WDI3_IPA_OVER_GSI=y
CONFIG_PCIE_GEN_SWITCH=y
CONFIG_WLAN_TWT_SAP_STA_COUNT=y
CONFIG_WLAN_TWT_SAP_PDEV_COUNT=y
CONFIG_DEVICE_FORCE_WAKE_ENABLE=y
CONFIG_HIF_REG_WINDOW_SUPPORT=y
CONFIG_WINDOW_REG_PLD_LOCK_ENABLE=y
CONFIG_DUMP_REO_QUEUE_INFO_IN_DDR=y
CONFIG_WLAN_FEATURE_LRO_CTX_IN_CB=y
CONFIG_DCS=y
CONFIG_WLAN_SYNC_TSF_PLUS=y
CONFIG_WLAN_SYNC_TSF_TIMER=y
CONFIG_TX_MULTI_TCL=y
CONFIG_OFDM_SCRAMBLER_SEED=y
CONFIG_FIX_TXDMA_LIMITATION=y
CONFIG_FEATURE_AST=y
CONFIG_PEER_PROTECTED_ACCESS=y
CONFIG_SERIALIZE_QUEUE_SETUP=y
CONFIG_DP_RX_PKT_NO_PEER_DELIVER=y
CONFIG_DP_RX_DROP_RAW_FRM=y
CONFIG_FEATURE_ALIGN_STATS_FROM_DP=y
CONFIG_DP_RX_SPECIAL_FRAME_NEED=y
CONFIG_FEATURE_STATS_EXT_V2=y
CONFIG_WLAN_FEATURE_DP_RX_THREADS=y
CONFIG_WLAN_FEATURE_RX_SOFTIRQ_TIME_LIMIT=y
CONFIG_FEATURE_NO_DBS_INTRABAND_MCC_SUPPORT=y
CONFIG_HAL_DISABLE_NON_BA_2K_JUMP_ERROR=y
CONFIG_ENABLE_HAL_SOC_STATS=y
CONFIG_ENABLE_HAL_REG_WR_HISTORY=y
CONFIG_MON_ENABLE_DROP_FOR_MAC=y
CONFIG_PCI_LINK_STATUS_SANITY=y
CONFIG_DDP_MON_RSSI_IN_DBM=y
CONFIG_SYSTEM_PM_CHECK=y
CONFIG_DISABLE_EAPOL_INTRABSS_FWD=y
CONFIG_CNSS2_MODULE=y
CONFIG_CNSS_GENL_MODULE=y
CONFIG_CNSS_UTILS_MODULE=y
CONFIG_WCNSS_MEM_PRE_ALLOC_MODULE=y
CONFIG_ROME_IF="pci"
CONFIG_WLAN_OPEN_SOURCE=y
CONFIG_BUILD_TAG=y
CONFIG_WLAN_FEATURE_MBSSID=y
CONFIG_WLAN_FEATURE_P2P_P2P_STA=y
#Flag to enable Legacy Fast Roaming3(LFR3)
CONFIG_QCACLD_WLAN_LFR3=y
CONFIG_WIFI_MONITOR_SUPPORT=y
CONFIG_QCA_MONITOR_PKT_SUPPORT=y
CONFIG_MONITOR_MODULARIZED_ENABLE=n
CONFIG_QCOM_TDLS=y
CONFIG_WLAN_SYSFS=y
CONFIG_THERMAL_STATS_SUPPORT=y
CONFIG_WLAN_SYSFS_STA_INFO=y
CONFIG_WLAN_SYSFS_CHANNEL=y
CONFIG_WLAN_SYSFS_FW_MODE_CFG=y
CONFIG_WLAN_SYSFS_MEM_STATS=y
CONFIG_WLAN_REASSOC=y
CONFIG_WLAN_SYSFS_CONNECT_INFO=y
CONFIG_WLAN_SCAN_DISABLE=y
CONFIG_WLAN_SYSFS_DCM=y
CONFIG_WLAN_WOW_ITO=y
CONFIG_WLAN_WOWL_ADD_PTRN=y
CONFIG_WLAN_WOWL_DEL_PTRN=y
CONFIG_WLAN_SYSFS_TX_STBC=y
CONFIG_WLAN_SYSFS_WLAN_DBG=y
CONFIG_WLAN_TXRX_FW_ST_RST=y
CONFIG_WLAN_GTX_BW_MASK=y
CONFIG_WLAN_SYSFS_SCAN_CFG=y
CONFIG_WLAN_SYSFS_MONITOR_MODE_CHANNEL=y
CONFIG_WLAN_SYSFS_RADAR=y
CONFIG_WLAN_SYSFS_RTS_CTS=y
CONFIG_WLAN_SYSFS_HE_BSS_COLOR=y
CONFIG_WLAN_TXRX_FW_STATS=y
CONFIG_WLAN_TXRX_STATS=y
CONFIG_WLAN_SYSFS_DP_TRACE=y
CONFIG_WLAN_SYSFS_STATS=y
CONFIG_WLAN_SYSFS_TDLS_PEERS=y
CONFIG_WLAN_SYSFS_TEMPERATURE=y
CONFIG_WLAN_THERMAL_CFG=y
CONFIG_WLAN_DL_MODES=y
CONFIG_WLAN_DUMP_IN_PROGRESS=y
CONFIG_WLAN_BMISS=y
CONFIG_WLAN_FREQ_LIST=y
CONFIG_DP_PKT_ADD_TIMESTAMP=y
CONFIG_WLAN_POWER_DEBUG=y
#Enable Beacon Reception Stats
CONFIG_FEATURE_BECN_STATS=y
CONFIG_WLAN_FEATURE_MEDIUM_ASSESS=y
#Disable the Export Symbol config
CONFIG_WLAN_DISABLE_EXPORT_SYMBOL=y
CONFIG_QCACLD_FEATURE_GREEN_AP=y
#Flag to enable Android Packet Filtering
CONFIG_QCACLD_FEATURE_APF=y
#Flag to enable SARv1 -> SARv2 conversion
CONFIG_WLAN_FEATURE_SARV1_TO_SARV2=y
#Flag to enable get firmware state
CONFIG_QCACLD_FEATURE_FW_STATE=y
#Flag to enable set coex configuration
CONFIG_QCACLD_FEATURE_COEX_CONFIG=n
#Flag to enable Fast Transition (11r) feature
CONFIG_QCOM_VOWIFI_11R=y
#Flag to enable disable ACTION OUI feature
CONFIG_WLAN_FEATURE_ACTION_OUI=y
#Flag to enable Adaptive 11r feature
CONFIG_ADAPTIVE_11R=y
#Flag to enable sae single pmk feature
CONFIG_SAE_SINGLE_PMK=y
#Flag to enable/disable multi client low latency feature support
CONFIG_MULTI_CLIENT_LL_SUPPORT=y
#Flag to enable mscs feature
CONFIG_FEATURE_MSCS=y
#Flag to enable FILS Feature (11ai)
CONFIG_WLAN_FEATURE_FILS=y
#Flag to enable Protected Management Frames (11w) feature
CONFIG_WLAN_FEATURE_11W=y
#Flag to enable LTE CoEx feature
CONFIG_QCOM_LTE_COEX=y
CONFIG_WLAN_FEATURE_LPSS=y
#Flag to enable NAN
CONFIG_QCACLD_FEATURE_NAN=y
CONFIG_FEATURE_EPPING=y
#Flag to enable offload packets feature
CONFIG_WLAN_OFFLOAD_PACKETS=y
#enable TSF get feature
CONFIG_WLAN_SYNC_TSF=y
#Flag to enable SAE
CONFIG_WLAN_FEATURE_SAE=y
#Flag to enable DISA
CONFIG_WLAN_FEATURE_DISA=y
#Flag to enable FIPS
CONFIG_WLAN_FEATURE_FIPS=y
# Flag to enable NAPI
CONFIG_WLAN_NAPI=y
CONFIG_WLAN_NAPI_DEBUG=n
# Flag to enable FW based TX Flow control
CONFIG_WLAN_TX_FLOW_CONTROL_V2=y
CONFIG_POWER_MANAGEMENT_OFFLOAD=y
# Flag to enable LFR Subnet Detection
CONFIG_LFR_SUBNET_DETECTION=y
# Flag to enable MCC to SCC switch feature
CONFIG_MCC_TO_SCC_SWITCH=y
CONFIG_LL_DP_SUPPORT=y
#CE4 completion on HTT HTC packet instead of misc list free
CONFIG_ENABLE_CE4_COMP_DISABLE_HTT_HTC_MISC_LIST=y
#Whether have QMI support
CONFIG_QMI_SUPPORT=y
# Enable fw stats version 2
CONFIG_AR900B=y
CONFIG_RX_DEFRAG_DO_NOT_REINJECT=y
CONFIG_MARK_ICMP_REQ_TO_FW=y
CONFIG_IPA_SET_RESET_TX_DB_PA=y
# Enable VERBOSE debug INI mechanism
CONFIG_VERBOSE_DEBUG=y
CONFIG_RX_DESC_SANITY_WAR=y
# Enable Shadow V2 for all lithium platform
CONFIG_SHADOW_V2=y
CONFIG_FEATURE_HAL_DELAYED_REG_WRITE=y
CONFIG_QCA_WIFI_QCA8074=y
CONFIG_QCA_WIFI_QCA8074_VP=y
CONFIG_DP_INTR_POLL_BASED=y
CONFIG_TX_PER_PDEV_DESC_POOL=y
CONFIG_DP_TRACE=y
CONFIG_FEATURE_TSO=y
CONFIG_FEATURE_FORCE_WAKE=y
CONFIG_DP_LFR=y
CONFIG_DUP_RX_DESC_WAR=y
CONFIG_HTT_PADDR64=y
CONFIG_RX_OL=y
CONFIG_TX_TID_OVERRIDE=y
CONFIG_DP_TXRX_SOC_ATTACH=y
CONFIG_WLAN_CLD_PM_QOS=y
CONFIG_WLAN_CLD_DEV_PM_QOS=y
CONFIG_DISABLE_DP_STATS=n
CONFIG_MAX_ALLOC_PAGE_SIZE=y
CONFIG_REO_DESC_DEFER_FREE=y
CONFIG_RXDMA_ERR_PKT_DROP=y
CONFIG_DELIVERY_TO_STACK_STATUS_CHECK=y
#CONFIG_WLAN_TRACE_HIDE_MAC_ADDRESS=n
CONFIG_WLAN_TRACE_HIDE_MAC_ADDRESS_DISABLE=y
CONFIG_DP_MEM_PRE_ALLOC=y
CONFIG_FEATURE_GPIO_CFG=y
CONFIG_FEATURE_TSO_STATS=y
CONFIG_TSO_DEBUG_LOG_ENABLE=y
CONFIG_FEATURE_PKTLOG=y
CONFIG_WLAN_DEBUG_CRASH_INJECT=y
#Disable pktlog feature for lithium based target
CONFIG_FEATURE_PKTLOG=n
#Enable WLAN/Power debugfs feature only if debug_fs is enabled
# Flag to enable debugfs.
CONFIG_WLAN_DEBUGFS=y
# Flag to enable streamfs.
CONFIG_WLAN_MWS_INFO_DEBUGFS=y
CONFIG_WLAN_FEATURE_MIB_STATS=y
#Whether to build debug version
CONFIG_WLAN_DEBUG_VERSION=y
#Enable this flag to build driver in diag version
CONFIG_WLAN_DIAG_VERSION=y
CONFIG_PANIC_ON_BUG=y
CONFIG_WLAN_WARN_ON_ASSERT=y
# Compile all log levels by default
CONFIG_WLAN_LOG_FATAL=y
CONFIG_WLAN_LOG_ERROR=y
CONFIG_WLAN_LOG_WARN=y
CONFIG_WLAN_LOG_INFO=y
CONFIG_WLAN_LOG_DEBUG=y
CONFIG_WLAN_LOG_ENTER=y
CONFIG_WLAN_LOG_EXIT=y
#Enable OL debug and wmi unified functions
CONFIG_ATH_PERF_PWR_OFFLOAD=y
#Disable packet log
CONFIG_REMOVE_PKT_LOG=n
#Enable 11AC TX
CONFIG_ATH_11AC_TXCOMPACT=y
#Enable PCI specific APIS (dma, etc)
CONFIG_HIF_PCI=y
# enable/disable feature flags based upon mobile router profile
CONFIG_QCOM_ESE=y
CONFIG_WLAN_OPEN_P2P_INTERFACE=y
CONFIG_WLAN_ENABLE_SOCIAL_CHANNELS_5G_ONLY=y
#Enable power management suspend/resume functionality to PCI
CONFIG_ATH_BUS_PM=y
#Enable FLOWMAC module support
CONFIG_ATH_SUPPORT_FLOWMAC_MODULE=n
#Enable spectral support
CONFIG_ATH_SUPPORT_SPECTRAL=n
#Customize DSCP_to-UP map based on RFC8325
CONFIG_WLAN_CUSTOM_DSCP_UP_MAP=y
CONFIG_PKTLOG_LEGACY=n
CONFIG_WAPI_BIG_ENDIAN=y
#Enable WDI Event support
CONFIG_WDI_EVENT_ENABLE=y
#Enable the type_specific_data in the ath_pktlog_arg
CONFIG_PKTLOG_HAS_SPECIFIC_DATA=y
#Endianness selection
CONFIG_LITTLE_ENDIAN=y
#Enable TX reclaim support
CONFIG_TX_CREDIT_RECLAIM_SUPPORT=n
#Enable FTM support
CONFIG_QCA_WIFI_FTM=y
CONFIG_NL80211_TESTMODE=y
CONFIG_LINUX_QCMBR=y
#Enable Checksum Offload
CONFIG_CHECKSUM_OFFLOAD=y
#Enable GTK offload
CONFIG_GTK_OFFLOAD=y
#Set this to 1 to catch erroneous Target accesses during debug.
CONFIG_ATH_PCIE_ACCESS_DEBUG=n
#Enable IPA offload for MDM platforms
CONFIG_IPA_OFFLOAD=n
#Enable Signed firmware support for split binary format
CONFIG_QCA_SIGNED_SPLIT_BINARY_SUPPORT=n
#Enable single firmware binary format
CONFIG_QCA_SINGLE_BINARY_SUPPORT=n
#Enable collecting target RAM dump after kernel panic
CONFIG_TARGET_RAMDUMP_AFTER_KERNEL_PANIC=y
#Flag to enable/disable secure firmware feature
CONFIG_FEATURE_SECURE_FIRMWARE=n
#Flag to enable Stats Ext implementation
CONFIG_FEATURE_STATS_EXT=y
#Flag to allocate memory dynamically for different buffers
CONFIG_WLAN_LOGGING_BUFFERS_DYNAMICALLY=n
CONFIG_WLAN_DFS_STATIC_MEM_ALLOC=y
#Flag to enable HTC credit history feature
CONFIG_FEATURE_HTC_CREDIT_HISTORY=y
#Flag to enable MTRACE feature
CONFIG_TRACE_RECORD_FEATURE=y
#Flag to enable p2p debug feature
CONFIG_WLAN_FEATURE_P2P_DEBUG=y
#Flag to enable roam debug log
CONFIG_FEATURE_ROAM_DEBUG=y
#Flag to enable DFS Master feature
CONFIG_WLAN_DFS_MASTER_ENABLE=y
#Flag to enable WEXT support for STA/AP/P2P interfaces
CONFIG_WLAN_WEXT_SUPPORT_ENABLE=y
#Flag to enable/disable MTRACE feature
CONFIG_ENABLE_MTRACE_LOG=y
#Flag to enable nud tracking feature
CONFIG_WLAN_NUD_TRACKING=y
#Flag to enable/Disable Function call trace
CONFIG_FUNC_CALL_MAP=n
#Flag to enable wbuff feature
CONFIG_WLAN_WBUFF=y
#Flag to enable set and get disable channel list feature
CONFIG_DISABLE_CHANNEL_LIST=y
#Flag to enable beacon receive feature
CONFIG_WLAN_BCN_RECV_FEATURE=y
#Flag to enable LTE COEX feature
CONFIG_LTE_COEX=y
#Flag to enable/disable TARGET 11d scan
CONFIG_TARGET_11D_SCAN=y
#Flag to enable/disable Avoid acs freq feature
CONFIG_SAP_AVOID_ACS_FREQ_LIST=y
#Flag to enable HOST OPCLASS feature
CONFIG_HOST_OPCLASS=y
#Flag to enable Dynamic Voltage WDCVS (Config Voltage Mode)
CONFIG_WLAN_DYNAMIC_CVM=y
#Flag to enable SAR Safety Feature
CONFIG_SAR_SAFETY_FEATURE=y
CONFIG_CONNECTION_ROAMING_CFG=y
CONFIG_WIFI_POS_CONVERGED=y
CONFIG_WLAN_TWT_CONVERGED=y
CONFIG_CP_STATS=y
CONFIG_FEATURE_INTEROP_ISSUES_AP=y
CONFIG_FEATURE_WLAN_WAPI=y
CONFIG_AGEIE_ON_SCAN_RESULTS=y
#Flag to enable FW log parsing support feature
CONFIG_FEATURE_FW_LOG_PARSING=y
CONFIG_PTT_SOCK_SVC_ENABLE=y
CONFIG_SOFTAP_CHANNEL_RANGE=y
CONFIG_FEATURE_WLAN_SCAN_PNO=y
CONFIG_WLAN_FEATURE_PACKET_FILTERING=y
CONFIG_WLAN_NS_OFFLOAD=y
CONFIG_FEATURE_WLAN_RA_FILTERING=y
CONFIG_FEATURE_WLAN_LPHB=y
CONFIG_QCA_SUPPORT_TX_THROTTLE=y
CONFIG_WMI_INTERFACE_EVENT_LOGGING=y
CONFIG_WLAN_FEATURE_LINK_LAYER_STATS=y
CONFIG_FEATURE_CLUB_LL_STATS_AND_GET_STATION=y
CONFIG_FEATURE_WLAN_EXTSCAN=n
CONFIG_WMI_BCN_OFFLOAD=y
CONFIG_160MHZ_SUPPORT=y
# CONFIG_MCL=y
CONFIG_REG_CLIENT=y
CONFIG_WLAN_PMO_ENABLE=y
CONFIG_CONVERGED_P2P_ENABLE=y
CONFIG_WLAN_POLICY_MGR_ENABLE=y
CONFIG_FEATURE_BLACKLIST_MGR=y
CONFIG_FOURTH_CONNECTION=y
CONFIG_SUPPORT_11AX=y
CONFIG_HDD_INIT_WITH_RTNL_LOCK=y
CONFIG_WLAN_CONV_SPECTRAL_ENABLE=y
CONFIG_WLAN_SPECTRAL_ENABLE=y
CONFIG_WMI_CMD_STRINGS=y
CONFIG_FEATURE_MONITOR_MODE_SUPPORT=y
CONFIG_WLAN_ALLOCATE_GLOBAL_BUFFERS_DYNAMICALLY=n
CONFIG_WLAN_FEATURE_TWT=y
CONFIG_FW_THERMAL_THROTTLE=y
CONFIG_WLAN_FEATURE_BIG_DATA_STATS=y
CONFIG_WLAN_FEATURE_IGMP_OFFLOAD=y
CONFIG_WLAN_FEATURE_GET_USABLE_CHAN_LIST=y
CONFIG_FEATURE_RADAR_HISTORY=y
CONFIG_WLAN_FEATURE_BMI=n
#Flags to enable/disable vendor commands
CONFIG_FEATURE_RSSI_MONITOR=y
CONFIG_FEATURE_BSS_TRANSITION=y
CONFIG_FEATURE_STATION_INFO=y
CONFIG_FEATURE_TX_POWER=y
CONFIG_FEATURE_OTA_TEST=y
CONFIG_FEATURE_ACTIVE_TOS=y
CONFIG_FEATURE_SAR_LIMITS=y
CONFIG_FEATURE_CONCURRENCY_MATRIX=y
CONFIG_FEATURE_SAP_COND_CHAN_SWITCH=y
CONFIG_FEATURE_P2P_LISTEN_OFFLOAD=y
CONFIG_QCACLD_FEATURE_MPTA_HELPER=n
CONFIG_QCACLD_RX_DESC_MULTI_PAGE_ALLOC=y
#Flags to enable/disable WMI APIs
CONFIG_WMI_ROAM_SUPPORT=y
CONFIG_WMI_CONCURRENCY_SUPPORT=y
CONFIG_WMI_STA_SUPPORT=y
CONFIG_DP_TRACE=y
CONFIG_DSC_DEBUG=y
CONFIG_DESC_TIMESTAMP_DEBUG_INFO=y
CONFIG_FEATURE_UNIT_TEST_SUSPEND=y
CONFIG_LEAK_DETECTION=y
CONFIG_MAX_LOGS_PER_SEC=500
CONFIG_SCHED_HISTORY_SIZE=256
CONFIG_TALLOC_DEBUG=y
CONFIG_UNIT_TEST=y
CONFIG_REGISTER_OP_DEBUG=y
CONFIG_ENABLE_QDF_PTR_HASH_DEBUG=y
CONFIG_HAL_DEBUG=y
CONFIG_ATH_DIAG_EXT_DIRECT=y
CONFIG_HIF_DEBUG=y
CONFIG_DSC_TEST=y
CONFIG_QDF_TEST=y
CONFIG_FEATURE_WLM_STATS=y
CONFIG_HIF_CE_DEBUG_DATA_BUF=y
CONFIG_WLAN_RECORD_RX_PADDR=y
CONFIG_HIF_CPU_PERF_AFFINE_MASK=y
CONFIG_WLAN_FEATURE_DP_RX_RING_HISTORY=y
CONFIG_WLAN_FEATURE_DP_TX_DESC_HISTORY=y
CONFIG_REO_QDESC_HISTORY=y
CONFIG_DP_TX_HW_DESC_HISTORY=y
CONFIG_QDF_NBUF_HISTORY_SIZE=8192
CONFIG_DP_RX_REFILL_CPU_PERF_AFFINE_MASK=y
CONFIG_DP_HW_TX_DELAY_STATS_ENABLE=y
CONFIG_WLAN_FEATURE_DP_EVENT_HISTORY=y
CONFIG_ALLOW_PKT_DROPPING=y
CONFIG_DYNAMIC_RX_AGGREGATION=y
CONFIG_RX_DESC_DEBUG_CHECK=y
CONFIG_WLAN_SUPPORT_DATA_STALL=y
CONFIG_WLAN_DP_PER_RING_TYPE_CONFIG=y
CONFIG_WLAN_CE_INTERRUPT_THRESHOLD_CONFIG=y
#Enable WMI TX/RX over QMI
CONFIG_WMI_SEND_RECV_QMI=y
CONFIG_WLAN_DP_PENDING_MEM_FLUSH=y
CONFIG_WLAN_SKIP_BAR_UPDATE=y
CONFIG_TX_MULTIQ_PER_AC=y
CONFIG_WLAN_TRACEPOINTS=y
#Flag to enable hdd memory dump feature
CONFIG_FEATURE_MEMDUMP_ENABLE=y
CONFIG_WLAN_LOGGING_SOCK_SVC=y
CONFIG_CONNECTIVITY_PKTLOG=y
CONFIG_PKTLOG_HAS_SPECIFIC_DATA=y
CONFIG_DESC_DUP_DETECT_DEBUG=y
CONFIG_FEATURE_BUS_BANDWIDTH_MGR=y
CONFIG_PLD_PCIE_CNSS_FLAG=y
CONFIG_PLD_PCIE_INIT_FLAG=y
#Enable STATE MACHINE HISTORY
CONFIG_SM_ENG_HIST=n
#Enable OEM DATA feature
CONFIG_FEATURE_OEM_DATA=y
#Enable FW Offload
CONFIG_WLAN_FW_OFFLOAD=y
#Enable eLNA bypass feature
CONFIG_WLAN_FEATURE_ELNA=y
#Enable mDNS feature
CONFIG_WLAN_FEATURE_MDNS_OFFLOAD=y
#Enable ICMP feature
CONFIG_WLAN_FEATURE_ICMP_OFFLOAD=y
#Enable DP Bus Vote
CONFIG_WLAN_FEATURE_DP_BUS_BANDWIDTH=y
#Enable 6 GHz Band
CONFIG_BAND_6GHZ=y
CONFIG_RX_FISA=y
CONFIG_MORE_TX_DESC=y
CONFIG_HANDLE_BC_EAP_TX_FRM=y
CONFIG_6G_SCAN_CHAN_SORT_ALGO=y
CONFIG_SAP_DHCP_FW_IND=y
#Enable support to get ANI level
CONFIG_ANI_LEVEL_REQUEST=y
#Enable RX RING buffers debug
CONFIG_DEBUG_RX_RING_BUFFER=y
#Enable Hash debug
CONFIG_RX_HASH_DEBUG=y
#Enable VDEV OPS wakelock feature
CONFIG_FEATURE_VDEV_OPS_WAKELOCK=y
#Enable Hang Event
CONFIG_WLAN_HANG_EVENT=y
CONFIG_WLAN_THERMAL_MULTI_CLIENT_SUPPORT=y
CONFIG_WLAN_DEBUG_LINK_VOTE=y
CONFIG_QCACLD_WLAN_CONNECTIVITY_LOGGING=y
CONFIG_WLAN_FEATURE_CAL_FAILURE_TRIGGER=y
CONFIG_FEATURE_WLAN_CH_AVOID_EXT=y
CONFIG_DP_TX_TRACKING=y
CONFIG_CRYPTO_COMPONENT=y

#feature config
CONFIG_CFG80211_LINK_STA_PARAMS_PRESENT=y
CONFIG_WLAN_FEATURE_MARK_FIRST_WAKEUP_PACKET=y
```

## google-modules/wlan/qcom/wcn7760/cnss2/cnss2/sun_consolidate_defconfig
```kconfig
CONFIG_CNSS2=m
CONFIG_CNSS_OUT_OF_TREE=y
CONFIG_CNSS2_QMI=y
CONFIG_CNSS_QMI_SVC=m
CONFIG_BUS_AUTO_SUSPEND=y
CONFIG_CNSS2_SSR_DRIVER_DUMP=y
CONFIG_CNSS2_SMMU_DB_SUPPORT=y
CONFIG_CNSS_PLAT_IPC_QMI_SVC=m
CONFIG_WCNSS_MEM_PRE_ALLOC=m
CONFIG_CNSS2_DEBUG=y
CONFIG_CNSS2_FMD_FEATURE_ENABLE=y
CONFIG_MHI_BUF_LEN=32768
CONFIG_WCN_GOOGLE=y
CONFIG_QCOM_RAMDUMP=y
CONFIG_QCOM_MEMORY_DUMP_V2=y
CONFIG_GOOG_USE_PWRCTRL=y
```

## google-modules/wlan/qcom/wcn7760/cnss2/mhi/host/defconfig
```kconfig
CONFIG_MHI_BUS=m
CONFIG_MHI_OUT_OF_TREE=y
CONFIG_MHI_BUS_DEBUG=y
CONFIG_MHI_BUS_MISC=y
CONFIG_WCN_GOOGLE=y
```

## google-modules/wlan/qcom/wcn7760/cnss2/qmi_helpers/Kconfig
```kconfig
# SPDX-License-Identifier: GPL-2.0-only
#

config QCOM_QMI_HELPERS
	tristate "config QCOM_QMI_HELPERS"
	help
	  QCOM_QMI_HELPERS Support

config MHI_OUT_OF_TREE
	bool "Support MHI for Google platform"
	help
	  Support MHI for Google platform
```

## google-modules/wlan/qcom/wcn7760/cnss2/qrtr/defconfig
```kconfig
CONFIG_QRTR=m
CONFIG_QRTR_MHI=m
CONFIG_QRTR_WAKEUP_MS=0
CONFIG_QRTR_NODE_ID=1
CONFIG_MHI_OUT_OF_TREE=y
```
