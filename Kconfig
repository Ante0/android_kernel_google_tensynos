## google-modules/bms/Documentation/devicetree/bindings/bms/google_wlc.yaml
```yaml
# SPDX-License-Identifier: GPL-2.0
# Copyright 2023 Google LLC
%YAML 1.2
---

$schema: http://devicetree.org/meta-schemas/core.yaml#

title: Google Wireless Charger Driver

maintainers:
  - Alice Sheng <alicesheng@google.com>
  - Yihsiang Peng <yihsiangpeng@google.com>
  - YiKai Peng <kenpeng@google.com>

description: |
  Wireless charging support of BPP/EPP/MPP protocol and integration with Google BMS system.

properties:
  compatible:
      enum:
      - renesas,ra9582
      - cps,cps4041
  reg:
    description: i2c address of the charger.

  irq-gpio:
    description: Interrupt GPIO.
    $ref: "types.yaml#/definitions/phandle"

  ap5v-gpio:
    description: GPIO to enable 5V supply to the WLC chip.
    $ref: "types.yaml#/definitions/phandle"

  vdden-gpio:
    description: GPIO to enable vdd switch internally in WLC chip.
    $ref: "types.yaml#/definitions/phandle"

  mode-gpio:
    description: GPIO to change the WLC mode. For example, BPP EPP MPP
    $ref: "types.yaml#/definitions/phandle"

  inhibit-gpio:
    description: GPIO to disable the WLC chip.
    $ref: "types.yaml#/definitions/phandle"

  wcin_inlim_en-gpio:
    description: GPIO to enable input current limiting based on load.
    $ref: "types.yaml#/definitions/phandle"

  google,high_soc_thresholds:
    description: Battery percentage thresholds at which to start input current limiting based on load.
    $ref: /schemas/types.yaml#/definitions/uint32

  capdiv-regulator:
    description: Regulator which controls a 2:1 divider placed on the output of WLC chip. It should
      be set up such that "Fast" corresponds to dividing mode and "Normal" corresponds to bypass
      mode.
    $ref: "types.yaml#/definitions/phandle"

  google,fg-power-supply:
    description: Power supply which corresponds to the fuel gauge. Will be used to read the battery
      percentage.
    $ref: "types.yaml#/definitions/phandle"

  google,bpp_fods:
    description: FOD array to write to FOD registers during BPP mode.
    $ref: /schemas/types.yaml#/definitions/uint8-array

  google,wlc_tx_id:
    description: Support reading tx_id of pixel stands
    type: boolean

  google,hda-tz-wlc:
    description: This will enable 1 value for hda thermal zone upon any wireless charger going online,
      to inform thermal to set temp target
    type: boolean

  google,project_id:
    description: The project id defined in FW is used to identify whether it is correct
    $ref: /schemas/types.yaml#/definitions/uint8

  google,wlc_eoc_cloak:
    description: enable cloak mode when Rx is online but not charging
    $ref: boolean

  bpp_mdis_pwr:
    description: thermal table use for BPP charger
    $ref: /schemas/types.yaml#/definitions/uint32-array

  epp_mdis_pwr:
    description: thermal table use for EPP charger
    $ref: /schemas/types.yaml#/definitions/uint32-array

  mpp_mdis_pwr:
    description: thermal table use for MPP charger
    $ref: /schemas/types.yaml#/definitions/uint32-array

  google,has-mpp25-wlc-dc:
    description: Support charge pump with 25W MPP
    type: boolean

  google,has-mpp15-wlc-dc:
    description: Support charge pump with 15W MPP
    type: boolean

  mpp_eds_soc:
    description: soc table of eds icl use for MPP charger
    $ref: /schemas/types.yaml#/definitions/uint32-array

  mpp_eds_icl:
    description: icl table used to define the limits of icl during eds in accordance with the soc table above
    $ref: /schemas/types.yaml#/definitions/uint32-array

  google,wlc_mod_depth_max:
    description: max depth for dynamic modulation
    $ref: /schemas/types.yaml#/definitions/uint8

  google,wlc_mod_soc:
    description: soc level reached for activating dynamic modulation
    $ref: /schemas/types.yaml#/definitions/uint32

  google,support-mpp25:
    description: enable mpp25 flow
    $ref: /schemas/types.yaml#/definitions/uint32

  google,dploss-volts:
    description: dploss voltage table for deltap loss in mpp25

  google,wlc_qispec:
    description: supported qi version and mode
    $ref: /schemas/types.yaml#/definitions/uint32

  google,iop_vout_mfg:
    description: The mfg-id of specific Tx that need to set different Vout
    $ref: /schemas/types.yaml#/definitions/uint16-array

  google,iop_vout_mv:
    description: The Vout configure value for the Tx list in google,iop_vout_mfg
    $ref: /schemas/types.yaml#/definitions/uint32-array

  google,wlc_iop_bpp_vout_tolerance_mv:
    description: The Vout tolerance threshold for check if need to decrease ICL for low-gain BPP chargers
    $ref: /schemas/types.yaml#/definitions/uint32

  google,charger-switch-skip-cloak:
    description: whether to skip cloak mode when switching chargers
    type: boolean

  google,wlc-dc-xce-thresh:
    description: the XCE threshold for WLC_DC
    $ref: /schemas/types.yaml#/definitions/uint32

  google,wlc-chg-configs:
    description: phandle list of chg configs
    $ref: /schemas/types.yaml#/definitions/phandle-array

  child-node:
    description: Child node which represents a charger config
    properties:
      target-power-mode:
        description: MPP power mode that should be used for this charger
        $ref: /schemas/types.yaml#/definitions/uint32
        required: true
      charger-type:
        description: type of charger it is
        $ref: /schemas/types.yaml#/definitions/uint32
        required: true
      mod-mode:
        description: modulation mode that should be set for this charger
        $ref: /schemas/types.yaml#/definitions/uint32
        required: true
      mod-change-timing:
        description: configures when the modulation mode should be changed when using this charger
        $ref: /schemas/types.yaml#/definitions/uint32
        required: true
      initial-current-ua:
        description: initial current for this charger in uA
        $ref: /schemas/types.yaml#/definitions/uint32
        required: true
      icl-step-size-ua:
        description: ICL step size for this charger in uA
        $ref: /schemas/types.yaml#/definitions/uint32
        required: true
      icl-rounding:
        description: Configure the ICL rounding method for this charger
        $ref: /schemas/types.yaml#/definitions/uint32
        required: true
      initial-voltage-uv:
        description: Configure the initial voltage for this charger
        $ref: /schemas/types.yaml#/definitions/uint32
        required: true
      max-voltage-uv:
        description: Configure the max voltage the charger supports
        $ref: /schemas/types.yaml#/definitions/uint32
        required: true
      mpp-mdis-name:
        description: name of the property containing the mdis table for this charger
        $def: /schemas/types.yaml#/definitions/string
      use-auto-vout:
        description: Configure whether the auto vout setting of wlc should be set when using this charger
        type: boolean
      mpp25-only:
        description: Configure whether the charger should be only allowed for MPP25
        type: boolean
      exit-by-ept:
        description: Configure whether the charger should be exited by sending EPT
        type: boolean
patternProperties:
  "^mpp-mdis-[a-zA-Z0-9-]*":
    description: thermal table used for a specific MPP charger by name
    $ref: /schemas/types.yaml#/definitions/uint32-array

required:
  - compatible
  - irq-gpio
  - mode-gpio
  - inhibit-gpio

dependencies:
  google,eoc_mw_thresholds: [ 'google,eoc_soc_thresholds' ]
```

## google-modules/bms/Documentation/devicetree/bindings/bms/max77779_charger.yaml
```yaml
# SPDX-License-Identifier: GPL-2.0
# Copyright 2024 Google LLC
%YAML 1.2
---

$schema: http://devicetree.org/meta-schemas/core.yaml#

title: max77779 charger driver

maintainers:
  - Daniel Okazaki <dtokazaki@google.com>
  - Prasanna Prapancham <prapancham@google.com>
  - Jack Wu <wjack@google.com>
  - Ken Yang <yangken@google.com>
  - Baltazar Ortiz <baltazarortiz@google.com>

description: |
  max77779 charger driver.

properties:
  # A dictionary of DT properties for this binding schema
  compatible:
    enum:
      - maxim,max77779chrg-i2c

  reg:
    description: address of the charger.

  max77779,psy-name:
    description: max77779 charger power supply name
    $ref: /schemas/types.yaml#/definitions/string

  google,max77779-thm2-monitor:
    description: Enable thm2 monitoring
    type: boolean

  max77779,usb-mon:
    description: When not set, disables thm2 monitoring.
    When set, leaves thm2 register as is.
    type: boolean

  max77779,chg-term-voltage:
    description: Charge termination voltage.
    $ref: /schemas/types.yaml#/definitions/uint32

  max77779,chg-term-volt-debounce:
    description: Charge termination voltage debounce voltage.
    $ref: /schemas/types.yaml#/definitions/uint32

  max77779,wcin-inlim-period:
    description: Number of milliseconds between ilim tracking polling.
    $ref: /schemas/types.yaml#/definitions/uint32

  max77779,wcin-inlim-headroom:
    description: Headroom above actual current allowed.
    $ref: /schemas/types.yaml#/definitions/uint32

  max77779,wcin_inlim_step:
    description: Maximum step size per timestep.
    $ref: /schemas/types.yaml#/definitions/uint32

  max77779_gpio:
    description: GPIO controller config.

  max77779,wlcin-psy-name:
    description: Name of max77779 wlcin power supply
    $ref: /schemas/types.yaml#/definitions/string

  max77779,disable-internal-irq-handler:
    description: Only run the top level charger interrupt handler and route to
    registered IRQ handlers. Skip the internal IRQ handler.
    type: boolean

  max77779,pmic:
    description: max77779 PMIC device phandle.
    $ref: /schemas/types.yaml#/definitions/phandle

  max77779,wlc-inlim-cv:
    description: Enable qualifying CV with tier and battery voltage for wireless charging

  max77779,fv-cv-margin:
    description: Margin to use to qualify CV when wlc-inlim-cv is enabled

  max77779,fv-cv-debounce:
    description: debounce voltage used to keep CV when wlc-inlim-cv is enabled

  max77779,fv-cv-dcr:
    description:  DCR compensation factor used to qualify CV when wlc-inlim-cv is enabled

  max77779,wlc-inlim-cv:
    description: Enable qualifying CV with tier and battery voltage for wireless charging

  max77779,fv-cv-margin:
    description: Margin to use to qualify CV when wlc-inlim-cv is enabled

  max77779,fv-cv-debounce:
    description: debounce voltage used to keep CV when wlc-inlim-cv is enabled

  max77779,fv-cv-dcr:
    description:  DCR compensation factor used to qualify CV when wlc-inlim-cv is enabled

  max77779,wlcin-is-child:
    description: Existence of this node indicates that CPM inits wlcin-mains and max77779 charger
      driver registers as a child power supply. Default behavior: max77779 charger registers
      wlcin-mains power supply
    type: boolean

required:
  - compatible
  - reg

dependencies:
  max77779,chg-term-volt-debounce: [ 'max77779,chg-term-voltage' ]
```

## google-modules/bms/Documentation/devicetree/bindings/bms/max77779_usecase.yaml
```yaml
# SPDX-License-Identifier: (GPL-2.0-only OR BSD-2-Clause)
# Copyright 2025 Google LLC
%YAML 1.2
---

$schema: http://devicetree.org/meta-schemas/core.yaml#

title: max77779 usecase state machine driver

maintainers:
  - Daniel Okazaki <dtokazaki@google.com>
  - Prasanna Prapancham <prapancham@google.com>
  - Jack Wu <wjack@google.com>

description: |
  max77779 usecase state machine driver. Control version control for configuring different state
  machines based on DTS config

properties:
  # A dictionary of DT properties for this binding schema
  compatible:
    enum:
      - max77779,usecase

  max77779,usecase-version:
    description: Usecase state machine version based on the max77779 charger. Default: 0

required:
  - compatible
```

## google-modules/bms/Documentation/devicetree/bindings/bms/max77779_usecase_v1.yaml
```yaml
# SPDX-License-Identifier: (GPL-2.0-only OR BSD-2-Clause)
# Copyright 2024 Google LLC
%YAML 1.2
---

$schema: http://devicetree.org/meta-schemas/core.yaml#

title: max77779 usecase V1 state machine driver

maintainers:
  - Daniel Okazaki <dtokazaki@google.com>
  - Prasanna Prapancham <prapancham@google.com>
  - Jack Wu <wjack@google.com>

description: |
  max77779 usecase v1 state machine driver.

properties:
  # A dictionary of DT properties for this binding schema
  max77779,dcin-is-dock:
    description: DC input is a dock.
    type: boolean

  max77779,bst-on:
    description: external boost enable gpio.

  max77779,extbst-ctl:
    description: external boost control gpio.

  max77779,extbst-mode:
    description: External boost mode gpio.

  max77779,extbst-supply:
    description: External Boost regulator control

  max77779,wlc-en:
    description: WLC enable gpio.

  max77779,wlc-spoof:
    description: WLC spoof gpio. Used during thermal throttling.

  max77779,wlc-spoof-vbyp:
    description: WLC spoof vbypass gpio.

  max77779,rx-to-rx-otg-en:
    description: wlc_rx to wlc_rx + otg supported.
    type: boolean

  max77779,ext-otg-only:
    description: external boost OTG only.
    type: boolean

  max77779,chrg-byp-en:
    description: Charger bypass mode enable.
    type: boolean

  max77779,rtx-ready:
    description: RTX usecase ready gpio.

  max77779,rtx-available:
    description: RTX usecase available gpio.

  max77779,wlc-dc-otg-en:
    description: Enable WLC_DC + OTG usecase. Default disabled. Default behavior to drop out of
    wlc_dc and switch to wlc_rx_otg.

required:
  - compatible
```

## google-modules/bms/Documentation/devicetree/bindings/bms/max77779_usecase_v2.yaml
```yaml
# SPDX-License-Identifier: (GPL-2.0-only OR BSD-2-Clause)
# Copyright 2024 Google LLC
%YAML 1.2
---

$schema: http://devicetree.org/meta-schemas/core.yaml#

title: max77779 usecase V2 state machine driver

maintainers:
  - Daniel Okazaki <dtokazaki@google.com>
  - Prasanna Prapancham <prapancham@google.com>
  - Jack Wu <wjack@google.com>

description: |
  max77779 usecase v2 state machine driver.

properties:
  # A dictionary of DT properties for this binding schema
  max77779,bst-on:
    description: external boost enable gpio.

  max77779,extbst-ctl:
    description: external boost control gpio.

  max77779,extbst-mode:
    description: External boost mode gpio.

  max77779,extbst-supply:
    description: External Boost regulator control
required:
  - compatible
```

## google-modules/bms/defconfig
```kconfig
CONFIG_CHARGER_MAX77729=m
CONFIG_CHARGER_MAX77759=m
CONFIG_CHARGER_MAX77779=m
CONFIG_CHARGER_MAX77779_I2C=y
CONFIG_CHARGER_P9221=m
CONFIG_CHARGER_RT9471=m
CONFIG_FG_MAX77779=m
CONFIG_FG_MAX77779_I2C=y
CONFIG_FWUPDATE_MAX77779=m
CONFIG_GOOGLE_BATTERY=m
CONFIG_GOOGLE_BEE=m
CONFIG_GOOGLE_BMS=y
CONFIG_GOOGLE_CCD=m
CONFIG_GOOGLE_CHARGER=m
CONFIG_GOOGLE_CPM=m
CONFIG_GOOGLE_DOCK=m
CONFIG_GOOGLE_DUAL_BATT_GAUGE=m
CONFIG_GOOGLE_WLC=m
CONFIG_HL7132=m
CONFIG_LN8411=m
CONFIG_MAX20339=m
CONFIG_MAX77779_I2CM=m
CONFIG_MAX77779_I2CM_I2C=y
CONFIG_MAX77779_PMIC=m
CONFIG_MAX77779_PMIC_I2C=y
CONFIG_MAX77779_PMIC_IRQ=m
CONFIG_MAX77779_PMIC_PINCTRL=m
CONFIG_MAX77779_PMIC_SGPIO=m
CONFIG_MAX77779_SP=m
CONFIG_MAX77779_SP_I2C=y
CONFIG_MAX77779_USECASE=m
CONFIG_MAXQ_MAX77759=m
CONFIG_MAX_M5=y
CONFIG_PCA9468=m
CONFIG_PMIC_MAX77729=m
CONFIG_REGULATOR_LN8282=m
CONFIG_UIC_MAX77729=m
CONFIG_USB_OVERHEAT_MITIGATION=m
CONFIG_VIMON_MAX77779=m
CONFIG_VIMON_MAX77779_I2C=y
```
