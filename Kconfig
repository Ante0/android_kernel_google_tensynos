## google-modules/bms/pe26100/Documentation/devicetree/bindings/pe26100/pe26100_buck_charger.yaml
```yaml
# SPDX-License-Identifier: (GPL-2.0-only OR BSD-2-Clause)
# Copyright 2025 Google LLC
%YAML 1.2
---

$schema: http://devicetree.org/meta-schemas/core.yaml#

title: pe26100 Buck charger driver

maintainers:
  - Daniel Okazaki <dtokazaki@google.com>

description: |
  pe26100 buck driver. MFD child of pe26100_driver

properties:
  # A dictionary of DT properties for this binding schema
  compatible:
    enum:
      - pe26100-buck-charger

required:
  - compatible
```

## google-modules/bms/pe26100/Documentation/devicetree/bindings/pe26100/pe26100_cp_charger.yaml
```yaml
# SPDX-License-Identifier: (GPL-2.0-only OR BSD-2-Clause)
# Copyright 2025 Google LLC
%YAML 1.2
---

$schema: http://devicetree.org/meta-schemas/core.yaml#

title: pe26100 charge pump charger driver

maintainers:
  - Prasanna Prapancham <dtokazaki@google.com>

description: |
  pe26100 charge pump driver. MFD child of pe26100_driver

properties:
  # A dictionary of DT properties for this binding schema
  compatible:
    enum:
      - pe26100-cp-charger

  debug_level:
    description: adjust debug logging level

  no_logbuffer:
    description: disable/enable the logbuffer

  iin_max_offset:
    description: cc_max offset

  iin_cc_comp_offset_low:
    description: IIN CC compensation for reduction

  iin_cc_comp_offset_high:
    description: IIN CC compensation for increase

  apply_offsets:
    description: apply cc_max

  pps_index:
    description: set PPS index

  ftm_mode:
    description: Forces FTM mode

required:
  - compatible
```

## google-modules/bms/pe26100/Documentation/devicetree/bindings/pe26100/pe26100_driver.yaml
```yaml
# SPDX-License-Identifier: (GPL-2.0-only OR BSD-2-Clause)
# Copyright 2025 Google LLC
%YAML 1.2
---

$schema: http://devicetree.org/meta-schemas/core.yaml#

title: pe26100 MFD charger driver

maintainers:
  - Daniel Okazaki <dtokazaki@google.com>
  - Prasanna Prapancham <prapancham@google.com>

description: |
  pe26100 driver.

properties:
  # A dictionary of DT properties for this binding schema
  compatible:
    enum:
      - pe26100

  reg:
    description: address of the charger.

  pe26100,preprod:
    description: indicates a preprod IC, use a different register config then prod devices

required:
  - compatible
  - reg
  - pe26100_buck_charger
  - pe26100_charge_pump
  - pe26100_usecase
```

## google-modules/bms/pe26100/Kconfig
```kconfig
config PE26100
	tristate "PE26100 MFD Charger Driver"
	select PE26100_BUCK_CHARGER
	select PE26100_USECASE
	help
	  Say Y here to enable the google PE26100 charger driver.

	  To compile this driver as a module, choose M here: the module will be
	  called pe26100.

config PE26100_BUCK_CHARGER
	tristate "PE26100 Buck Charger Driver"
	help
	  Say Y here to enable the google PE26100 buck charger driver.

	  To compile this driver as a module, choose M here: the module will be
	  called pe26100-buck-charger.

config PE26100_USECASE
	tristate "PE26100 Usecase Driver"
	help
	  Say Y here to enable the google PE26100 usecase driver.

	  Usecase state machien driver for the PE26100 charger

	  To compile this driver as a module, choose M here: the module will be
	  called pe26100-usecase.
```

## google-modules/display/common/Kconfig
```kconfig
# SPDX-License-Identifier: MIT

menu "GS Display Configuration"
	depends on DRM

config GOOGLE_DRM_BRIDGE_MODE_SET
	bool "Support for Google specific DRM bridge mode set"
	depends on DRM
	default y if DRM_SAMSUNG
	help
	  Choose this option to support Google's specific DRM bridge modeset
	  operations. This ensures DPU resources are enabled before the bridge
	  modeset. Note that new drivers should not be setting modeset operations.

config GS_DRM_PANEL_UNIFIED
	tristate "Support for GS Unified panel driver"
	depends on OF && DRM
	select DRM_DISPLAY_HELPER
	select DRM_DISPLAY_DP_HELPER
	select DRM_BRIDGE_CONNECTOR
	help
	  Choose this option to support the unified panel driver framework.
	  This option is designed to be decoupled from DPU code
	  to reduce interdependency. This feature is currently in development
	  and is not meant for use on in-market devices.

config GS_PANEL_SIMPLE
	tristate "Support for simple gs_panel, primarily for simulation"
	depends on GS_DRM_PANEL_UNIFIED
	help
	  Select this option to enable support for the simple (sim) panel

config GS_PANEL_S6E3HC4
	tristate "Support for gs_drm-enabled s6e3hc4 panel"
	depends on GS_DRM_PANEL_UNIFIED
	select DRM_DISPLAY_DP_HELPER
	select DRM_DISPLAY_HELPER
	help
	  Select this option to enable support for the s6e3hc4 panel.
	  Specifically, this is the version of the panel driver supported
	  through the newer gs_panel framework.

config GS_PANEL_SMOOTH_HANDOFF_ENABLED
	bool "Support for smooth handoff from bootloader to panel"
	depends on GS_DRM_PANEL_UNIFIED
	default y
	help
	  Select this option to enable a smooth transition from bootloader
	  to panel. When disabled, kernel will turn off panel during handoff
	  if it is on, and turn panel on later in the sequence.
	  Defaults to enabled for desired operational state; disabling should
	  occur for debugging purposes only.

config DEBUG_PANEL_TEST
	bool "Support for panel test module"
	default n
	help
	  Select this option to enable support for panel test modules

config COMMON_PANEL_TEST
	tristate "Support for common panel test module"
	depends on DEBUG_PANEL_TEST
	help
	  Select this option to enable support for the common panel test.
	  By default, this option should be disabled for devices that does not
	  use the panel test modules. For devices that need to use the common test module
	  this option should be enabled.

endmenu
```
