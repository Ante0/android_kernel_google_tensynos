## google-devices/malibu/malibu_defconfig
```kconfig
# CONFIG_MODULE_SIG_ALL is not set
CONFIG_ARCH_GOOGLE=y
CONFIG_ARM_DSU_PMU=m
CONFIG_ARM_NI=m
CONFIG_ARM_SMMU_V3_PIXEL=m
CONFIG_ARM_SMMU_V3_PKVM_PIXEL=m
CONFIG_ARM_SMMU_V3_PMU_PIXEL=m
CONFIG_ARM_SPE_PMU=m
CONFIG_CODEC3P=m
CONFIG_CODEC3P_SLC=n
CONFIG_CODEC3P_VCORE_APG=y
CONFIG_CODEC3P_VPU_RESET=y
CONFIG_CORESIGHT=m
CONFIG_CORESIGHT_CATU=m
CONFIG_CORESIGHT_DUMMY=m
CONFIG_CORESIGHT_LINKS_AND_SINKS=m
CONFIG_CORESIGHT_LINK_AND_SINK_TMC=m
CONFIG_CORESIGHT_SOURCE_ETM4X=m
CONFIG_CORESIGHT_STM=m
CONFIG_CORESIGHT_TRBE=m
CONFIG_COMMON_PANEL_TEST=m
CONFIG_DEBUG_PANEL_TEST=y
CONFIG_DRM_DW_MIPI_CDPHY=m
CONFIG_DRM_DW_MIPI_DSI2H=m
CONFIG_DRM_VERISILICON=m
CONFIG_DWC_DPTX=m
CONFIG_DWC_DPTX_AUDIO=y
# CONFIG_EXYNOS_PD_EL3 is not set
CONFIG_GIA_LIB=m
CONFIG_GOOGLE_AOSS_WDT_HANDLER=m
CONFIG_GOOGLE_ACFW_DEBUG=m
CONFIG_GOOGLE_BCL=m
CONFIG_GOOGLE_BCL_MAX77779=y
CONFIG_GOOGLE_CHIP_INFO=m
CONFIG_GOOGLE_CAP_SYSFS=m
CONFIG_GOOGLE_CPM_CLK=m
CONFIG_GOOGLE_CPM_RST=m
CONFIG_GOOGLE_CPU_LPM_STATS=m
CONFIG_GOOGLE_DA9188_GPIO=m
CONFIG_GOOGLE_DA9188_REGULATOR=m
CONFIG_GOOGLE_DA9188_REGULATOR_REGISTER_ACCESS=y
CONFIG_GOOGLE_DA9188_RTC=m
CONFIG_GOOGLE_DA9188_VGPIO=m
CONFIG_GOOGLE_DVFS_HELPER=m
CONFIG_GOOGLE_DVFS_TARGET_FRONTEND=m
CONFIG_GOOGLE_DW_I3C_MASTER=m
CONFIG_GOOGLE_DW_I3C_MASTER_THI=m
CONFIG_GOOGLE_DW_I3C_XFER_HOST_AP=m
CONFIG_GOOGLE_EHLD_COREINSTR=m
CONFIG_GOOGLE_MFD_DA9188=m
CONFIG_GOOGLE_GDMC_DHUB=m
CONFIG_GOOGLE_GIA_IRQ=m
CONFIG_GOOGLE_GIA_TEST=m
CONFIG_GOOGLE_H2OMG=m
CONFIG_GOOGLE_IRQ_EXTENDED_SYSFS=m
CONFIG_GOOGLE_GPU_PF_STATE=m
CONFIG_GOOGLE_GTC=m
CONFIG_GOOGLE_ICC_HELPER_MOCK_CLIENT=m
CONFIG_GOOGLE_IRM=m
CONFIG_GOOGLE_IRM_DEVFREQ=m
CONFIG_GOOGLE_MBA_AGGREGATOR=m
CONFIG_GOOGLE_MBA_CPM_INTERFACE=m
CONFIG_GOOGLE_MBA_CPM_INTERFACE_TEST=m
CONFIG_GOOGLE_MBA_DOORBELL_INTERFACE=m
CONFIG_GOOGLE_MBA_GDMC_INTERFACE=m
CONFIG_GOOGLE_MBA_GDMC_INTERFACE_TEST=m
CONFIG_GOOGLE_MBA_EBU_INTERFACE=m
CONFIG_GOOGLE_MODEM_UART=m
CONFIG_GOOGLE_ODPM=m
CONFIG_GOOGLE_POWERDASHBOARD=m
CONFIG_GOOGLE_POWER_CONTROLLER=m
CONFIG_GOOGLE_RADIO_BRIDGE=m
CONFIG_GOOGLE_SKIP_S2M_VOTER=m
CONFIG_GOOGLE_SST_PLATFORM=m
CONFIG_GOOGLE_SYSPM=m
CONFIG_GOOGLE_TIMESTAMP_SYNC=m
CONFIG_GOOGLE_TRACE_SOURCE=m
CONFIG_GOOGLE_VOLATILE_DEBUG_UNLOCK=m
CONFIG_GOOGLE_FWMT=m
CONFIG_GOOGLE_MBA_CTRL=m
CONFIG_GOOGLE_LPM_PM_DOMAINS=m
CONFIG_GOOGLE_USB_PHY=m
CONFIG_GOOGLE_EUSB2_REPEATER=m
CONFIG_GOOGLE_USB_ROLE_SW=m
CONFIG_GOOGLE_WDT=m
CONFIG_GOOG_TOUCH_INTERFACE=m
CONFIG_GS_DOMAIN_IDLE=m
CONFIG_GS_DRM_PANEL_UNIFIED=m
CONFIG_GS_PANEL_SIMPLE=m
CONFIG_GS_PERF_MON=m
CONFIG_GSA=m
CONFIG_GSA_GSC=m
CONFIG_GSA_LINUX_MAILBOX=y
CONFIG_GSA_LOG_REGION_SIZE=0x4000
CONFIG_GSA_WAKELOCK=y
CONFIG_HARDLOCKUP_DEBUG_LGA=m
CONFIG_HARDLOCKUP_WATCHDOG=m
CONFIG_I2C_DW_GOOGLE_CORE=m
CONFIG_I2C_DW_GOOGLE_TEST=m
CONFIG_I2C_DW_GOOGLE_QUIRKS=m
CONFIG_NVMEM_RMEM=m
CONFIG_PINCTRL_GOOGLE=m
CONFIG_PINCTRL_MBU=y
CONFIG_PIXEL_CME=y
CONFIG_PIXEL_IOMMU_MAP_BENCHMARK=m
CONFIG_POWERVR_MBU=y
CONFIG_POWERVR_PIXEL_IIF=y
CONFIG_POWERVR_ROGUE=m
CONFIG_SERIAL_8250_DW=y
CONFIG_SERIAL_8250_DW_GOOGLE_QUIRKS=m
CONFIG_SERIAL_8250_DWLIB=y
CONFIG_SOC_MBU=y
CONFIG_SOFT_WATCHDOG=m
CONFIG_SPI_DESIGNWARE=m
CONFIG_SPI_DW_DMA=y
CONFIG_SPI_DW_GOOGLE_QUIRKS=m
CONFIG_SPI_LOOPBACK_TEST=m
CONFIG_SPI_SPIDEV=y
CONFIG_TICK_DRIVEN_LATGOV=m
CONFIG_TOUCHSCREEN_HEATMAP=m
CONFIG_TOUCHSCREEN_OFFLOAD=m
CONFIG_TOUCHSCREEN_TBN=m
CONFIG_TOUCHSCREEN_TBN_AOC_CHANNEL_MODE=y
CONFIG_TZ_PROT=m
CONFIG_UFS_DW_GOOGLE=m
CONFIG_UFS_PIXEL_CRYPTO=y
CONFIG_UFS_PIXEL_FEATURES=y
CONFIG_UFS_PIXEL_READ_BOOST=y
CONFIG_UFS_PIXEL_UIC_ERR_DEBUG=y
CONFIG_USB_DWC3_GOOGLE=m
CONFIG_USB_DWC3_GOOGLE_AUX=m
CONFIG_VERISILICON_CHIP_9x00=y
CONFIG_VERISILICON_DC9400_0x20000005=y
# CONFIG_VERISILICON_DC9400_0x316 is not set
CONFIG_VERISILICON_DC9400_0x32a=y
CONFIG_VERISILICON_MIPI_DSI2H=y
CONFIG_VERISILICON_ONE_LAYER_G2D=y
CONFIG_VH_KERNEL=y
CONFIG_PIXEL_EM=m
CONFIG_VH_FS=m
CONFIG_VH_MM=m
CONFIG_VH_CGROUP=m
CONFIG_VH_SCHED=m
CONFIG_VH_PREEMPTIRQ_TRACEPOINTS=m
CONFIG_VH_SCHED_MAX_CPU_NR=7
CONFIG_VH_SYSTRACE=m
CONFIG_VH_THERMAL=m
CONFIG_PIXEL_METRICS=m
CONFIG_THERMAL_METRICS=y
CONFIG_PERF_METRICS=y
CONFIG_CPUIDLE_METRICS=y
CONFIG_AOC_DRIVER=m
CONFIG_AOC_MBU=y
CONFIG_AOC_ALSA_USB=y
CONFIG_AOC_ALSA_DP_AUDIO=y
CONFIG_AOC_ALSA_INCALL_CAP_3=y
CONFIG_AOC_ALSA_IAMF=y
CONFIG_AOC_USB_AUDIO_OFFLOAD=y
CONFIG_AOSS_SSR_NOTIFIER=m
CONFIG_PCIE_GOOGLE_PHY=m
CONFIG_PCIE_DW_GOOGLE_V2=m
CONFIG_GOOGLE_GEM=m
CONFIG_GOOGLE_GEM_TEST=m
CONFIG_CHR_DEV_SG=m
CONFIG_DEBUG_REBOOT=m
CONFIG_DMABUF_HEAPS_DEFERRED_FREE=m
CONFIG_DMABUF_HEAPS_PAGE_POOL=m
CONFIG_PIXEL_GCMA=m
CONFIG_DMABUF_HEAPS_GOOGLE_GCMA=y
CONFIG_DMABUF_HEAPS_SAMSUNG_CARVEOUT=y
CONFIG_DMABUF_HEAPS_SAMSUNG_CHUNK=y
CONFIG_DMABUF_HEAPS_SAMSUNG_CMA=y
CONFIG_DMABUF_HEAPS_SAMSUNG_SYSTEM=y
CONFIG_DMABUF_SAMSUNG_HEAPS=m
CONFIG_EEPROM_AT24=m
CONFIG_EXYNOS_CONTENT_PATH_PROTECTION=m
CONFIG_GOOGLE_CDD_CPU_IDLE_INFO=m
CONFIG_GOOGLE_CRASH_DEBUG_DUMP=m
CONFIG_GOOGLE_GPDMA=m
CONFIG_GOOGLE_IRQ_CPM=m
CONFIG_GOOGLE_LOGBUFFER=m
CONFIG_GOOGLE_REGMAP_SPMI=m
CONFIG_GOOGLE_VOTABLE=m
CONFIG_GS_DEBUG_TEST=m
CONFIG_I2C_CHARDEV=m
CONFIG_INPUT_KEYCOMBO=m
CONFIG_INPUT_KEYDEBUG=m
CONFIG_KERNEL_TOP=m
CONFIG_MFD_SLG51002=m
CONFIG_REGULATOR_S2DOS07X02_GS=m
CONFIG_REGULATOR_SGM38122=m
CONFIG_REGULATOR_SGM38125=m
CONFIG_PINCTRL_SLG51002=m
CONFIG_PIXEL_DEBUG_KINFO=m
CONFIG_PIXEL_DEBUG_TEST=m
CONFIG_PIXEL_POWER_REBOOT=m
CONFIG_PIXEL_STAT=m
CONFIG_PIXEL_STAT_MM=m
CONFIG_PL330_DMA_GOOGLE=m
CONFIG_PROACTIVE_KILL=m
CONFIG_REGULATOR_SLG51002=m
CONFIG_REGULATOR_SY70206=m
CONFIG_REGULATOR_TPS628600_GS=m
CONFIG_SBB_MUX=m
CONFIG_SMRA=m
CONFIG_SOC_GOOGLE=y
CONFIG_SPMI_SMARTDV=m
CONFIG_SUBSYSTEM_COREDUMP=m
CONFIG_TCPCI_VENDOR_HOOKS=y
CONFIG_TOWERCI=m
CONFIG_TRUSTY=m
CONFIG_TRUSTY_CRASH_IS_PANIC=y
CONFIG_TRUSTY_DMA_BUF_FFA_TAG=y
CONFIG_TRUSTY_WAKELOCK=m
CONFIG_TYPEC_COOLING_DEV=m
CONFIG_TYPEC_MAX77759_CONTAMINANT=m
CONFIG_TYPEC_MAX77779_CONTAMINANT=m
CONFIG_TYPEC_MAX777X9_SPMI=m
CONFIG_GPIO_PCA953X=m
CONFIG_REGULATOR_RT6160_GS=m
CONFIG_PERF_TRACE_CTRS=m
CONFIG_GOOGLE_IIS=m
```

## google-devices/muzel/muzel_defconfig
```kconfig
# private/google-modules/fingerprint/qcom/qfs4008/Kconfig
CONFIG_QCOM_QBT_HANDLER=m

# private/google-modules/misc/h2omg/Kconfig
CONFIG_GOOGLE_H2OMG=m

# private/google-modules/radio/samsung/s5400/Kconfig
CONFIG_CH_EXTENSION=m
CONFIG_CPIF_AP_SUSPEND_DURING_VOICE_CALL=y
CONFIG_CPIF_PAGE_RECYCLING=m
CONFIG_CPIF_TP_MONITOR=m
CONFIG_CP_PKTPROC=m
CONFIG_CP_PKTPROC_UL=m
CONFIG_CP_PMIC=m
CONFIG_CP_THERMAL=m
CONFIG_EXYNOS_MODEM_IF=m
CONFIG_LINK_DEVICE_PCIE=m
CONFIG_LINK_DEVICE_PCIE_IOCC=y
CONFIG_LINK_DEVICE_PCIE_IOMMU=y
CONFIG_LINK_DEVICE_PCIE_SOC_GOOGLE=y
CONFIG_MODEM_IF_QOS=m
CONFIG_SEC_MODEM_S5100=m
CONFIG_SHM_IPC=m
CONFIG_INPUT_POWER_KEYDEBUG=m

# private/google-modules/soc/gs/drivers/soc/google/gnssif_spi/Kconfig
CONFIG_EXYNOS_GNSS_IF_SPI_DMA_SAFE_BUFFER=y

# private/google-modules/soc/gs/drivers/soc/google/gsa/Kconfig
CONFIG_GSA_LOG_REGION_SIZE=0x4000
```

## google-devices/spacecraft/spacecraft_defconfig
```kconfig
CONFIG_GOOGLE_MD2AP_WAKEUP_MONITOR=y
CONFIG_GOOGLE_MODEM_CDD=y
CONFIG_GOOGLE_MODEM_SOC_BW_QOS=y
CONFIG_GOOGLE_WWAN_PKT_PRIO=y
CONFIG_METRICS_COLLECTION_FRAMEWORK=m
CONFIG_MTK_WWAN_PWRCTL_SUPPORT=y
CONFIG_MTK_HOST_DRV_WWAN_SUPPORT=y
CONFIG_MTK_DATA_CPU_LOADING_OPTIMIZE=y
CONFIG_MTK_DEVLINK=y
CONFIG_MTK_DEVLINK_LOGDUMP_SUPPORT=y
CONFIG_MTK_MEMLOG_EVENT_SUPPORT=y
# private/google-modules/touch/sec/p26/Kconfig
CONFIG_TOUCHSCREEN_SEC_TS=m
CONFIG_INPUT_POWER_KEYDEBUG=m
```

## google-modules/amplifiers/aw882xx/Kconfig
```kconfig
# SPDX-License-Identifier: GPL-2.0-only

config SND_SMARTPA_AW882XX
 tristate "SoC Audio for awinic aw882xxseries"
 depends on I2C
 help
 This option enables support for aw882xx series Smart PA.

config AW882XX_CALIB
 bool "Enable aw882xx calibration support"
 depends on SND_SMARTPA_AW882XX
 default n
 help
  This option enables aw882xx calibration support.
  Note, Please check b/417847554 before enable it.
```

## google-modules/aoc/Documentation/devicetree/bindings/google,aoc.yaml
```yaml
# SPDX-License-Identifier: GPL-2.0-only OR BSD-2-Clause
%YAML 1.2
---
$id: http://devicetree.org/schemas/reserved-memory/google,open-dice.yaml#
$schema: http://devicetree.org/meta-schemas/core.yaml#

title: AoC SoC

description: |
  This binding represents the AoC component.

maintainers:
  - Alex Iacobucci <alexiacobucci@google.com>

properties:
  compatible:
    const: google,aoc

  wifi-chip:
    description:
      integer specifying the wifi chip for that particulare device.
    maxItems: 1

  bt-chip:
    description:
      integer specifying the bt chip for that particulare device.
    maxItems: 1

  gdmc-iface:
    description:
      Reference to the GDMC node, if any.
    maxItems: 1

  power-domains:
    description:
      Power domains relevant for AoC.

  power-domain-names:
    description:
      Names for each of the power domains listed in property `power-domains`.

  gsa-enabled:
    description:
      Boolean specifying whether GSA boot for AOC is enabled. Must be unset if false.
    maxItems: 1

  ramdump-header-offset:
    description:
      Location of AoC coredump header as an offset from start of DRAM carveout.

  carveout-paddr-from-aoc:
    description:
      Physical address of DRAM carveout from AoC point of view, used by coredump writer.

  carveout-vaddr-from-aoc:
    description:
      Virtual address of DRAM carveout from AoC point of view, used by coredump writer.

  mbox-doorbell-mode-enabled:
    description:
      Specifies whether doorbell mode is enabled for the target.

  boot-breadcrumbs-enabled:
    description:
      Specifies whether boot breadcrumbs are enabled for the target.

  mbox-non-waking:
    description:
      List of references to the mailboxes which shall be used to handle
      non waking signals. Each list entry has two arguments which specifies
      the offset between base register address and corresponding mask register,
      as well as a register bitmask.
      The number of arguments has to be set as "#non_waking-cells" property in
      the memory resource describing the mailbox.

  coredump-region:
    description:
      Reference to the additional memory carveout where coredump can be stored.
    maxItems: 1

required:
  - compatible
  - power-domains
  - power-domain-names

# TODO: add remaining items in required and properties.

examples:
  - |
    {
      aoc: aoc@9000000 {
        compatible = "google,aoc";
        reg = <0x0 0x09000000 0x0 0x02000000>,
          <0x0 0xB4C0000 0x0 0x000be28>;
        reg-names = "blk_aoc", "lcpm";
        iommus = <&cpuacc_mmu 0x8300>;

        memory-region = <&aoc_reserve>;

        mboxes = <
          &aoc_ap_0_mba_client_0 0
          &aoc_ap_1_mba_client_1 0
          &aoc_ap_2_mba_client_2 0
          &aoc_ap_3_mba_client_3 0
          &aoc_ap_4_mba_client_4 0
          &aoc_ap_5_mba_client_5 0
          &aoc_ap_6_mba_client_6 0
          &aoc_ap_7_mba_client_7 0
          &aoc_ap_8_mba_client_8 0
          &aoc_ap_9_mba_client_9 0
          &aoc_ap_10_mba_client_10 0
          &aoc_ap_11_mba_client_11 0
          &aoc_ap_12_mba_client_12 0
          &aoc_ap_13_mba_client_13 0
          &aoc_ap_14_mba_client_14 0
          &aoc_ap_15_mba_client_15 0
          &aoc_ap_16_mba_client_16 0
          &aoc_ap_17_mba_client_17 0
          &aoc_ap_18_mba_client_18 0
          &aoc_ap_19_mba_client_19 0
        >;

        mbox-doorbell-mode-enabled;

        power-domains = <&sswrp_aoc_pd>, <&aoc_core_pd>;
        power-domain-names = "sswrp_aoc_pd", "aoc_core_pd";

        pinctrl-names = "default", "idle";
        pinctrl-0 = <&aoc_uart0_rxd_rtsn_pins>, <&aoc_uart0_txd_ctsn_pins>,
          <&aoc_uart1_rxd_rtsn_pins>, <&aoc_uart1_txd_ctsn_pins>,
          <&aoc_uart2_pins>, <&aoc_i2c2_pins>, <&aoc_i2c4_pins>,
          <&aoc_i3c0_pins>, <&aoc_i3c1_pins>, <&aoc_tdm1_in_pins>,
          <&aoc_tdm1_out_pins>, <&aoc_pdm_pins>, <&aoc_pdm1_pins>,
          <&aoc_pdm2_pins>, <&aoc_pdm3_pins>, <&aoc_tdm0_in_pins>,
          <&aoc_tdm0_out_pins>, <&aoc_i2s0_in_pins>, <&aoc_i2s0_out_pins>,
          <&aoc_i2s1_in_pins>, <&aoc_i2s1_out_pins>, <&aoc_modem_out_pins>,
          <&aoc_modem_in_pins>, <&aoc_modem_pcm_valid_pins>;
        pinctrl-1 = <>;

        mbox-channels = <20>;

        clock-divider = <1>;

        channel-max-pending-msgs = <128>;
        block-channel-threshold = <64>;

        notify-on-state-transition;
        hotword-supported;
        chre-supported;
        iommu-config-persistent;

        aoc-coredump-mbox = <3>;
        ramdump-header-offset = <0x3000000>;
        carveout-paddr-from-aoc = <0x6000000>;
        carveout-vaddr-from-aoc = <0xB6000000>;

        gdmc-iface = <&goog_mba_gdmc_iface>;

        boot-breadcrumbs-enabled;

        gsa-device = <&gsa>;
        gsa-enabled;
      };
    };
```

## google-modules/aoc/Kconfig
```kconfig
#
# AoC Driver Support
#

config AOC_DRIVER
	tristate "WhiteChapel AoC support"
	default n
	# GOOGLE_MODEMCTL is an optional dependency.
	depends on GOOGLE_MODEMCTL || !GOOGLE_MODEMCTL
	help
		Say yes here to add support for the AoC subsystem in WhiteChapel

config AOC_CHAR_DRIVER
	tristate "WhiteChapel AoC character device support"
	depends on AOC_DRIVER
	default m
	help
		Say yes here to expose AoC services as character devices

config AOC_CHAN_DRIVER
	tristate "WhiteChapel AoC IPC channel support"
	depends on AOC_DRIVER
	default m
	help
		Say yes here to add channelized IPC support for USF

config AOC_CONTROL_DRIVER
	tristate "WhiteChapel AoC Basic Control"
	depends on AOC_DRIVER
	default m
	help
		Say yes here to add basic control for the AoC

config AOC_TBN_DRIVER
	tristate "WhiteChapel AoC TBN service"
	depends on AOC_DRIVER
	default m
	help
		Say yes here to add TBN service for the AoC

config AOC_MBOX_FULL_DRIVER
	tristate "WhiteChapel AoC Mbox Full service"
	depends on AOC_DRIVER
	default m
	help
		This module adds support for
		the Mailbox Full service
		which is part of the AoC subsystem.
		Say yes here to add Mbox Full service for the AoC

config AOC_UWB_DRIVER
	tristate "WhiteChapel AoC UWB service"
	depends on AOC_DRIVER
	default m
	help
		Say yes here to add UWB service for the AoC

config AOC_UNIT_TEST_DRIVER
	tristate "WhiteChapel AoC Unit Test Driver"
	depends on AOC_DRIVER
	default m
	help
		Say yes here to add unit test driver for the AoC

config WC_MBOX
	tristate "Whitechapel Mailbox support"
	depends on AOC_DRIVER
	default m
	help
		Say yes here to build the generic mailbox driver for the exynos
		mailboxes in Whitechapel

choice
	prompt "AoC library version"
	depends on AOC_DRIVER
	default AOC_V1

config AOC_V1
	bool "AoC V1"
	help
		AOC V1

config AOC_LGA
	bool "AoC LGA"
	help
		AOC LGA

config AOC_MBU
	bool "AoC MBU"
	help
		AOC MBU
endchoice
```

## google-modules/aoc/alsa/Kconfig
```kconfig
# SPDX-License-Identifier: GPL-2.0-only
#
# AoC ALSA configuration
#

config AOC_ALSA_USB
	bool "AoC ALSA USB audio support"
	depends on AOC_DRIVER && USB_XHCI_SIDEBAND
	help
		Say yes here to support USB audio

config AOC_ALSA_DP_AUDIO
	bool "AoC ALSA DP audio support"
	depends on AOC_DRIVER
	default y if DRM_SAMSUNG_DP_AUDIO
	default y if DWC_DPTX_AUDIO
	help
		Say yes here to support DP Audio

config AOC_ALSA_INCALL_CAP_3
	bool "AoC ALSA incall capture stream 3"
	depends on AOC_DRIVER
	default n
	help
		Say yes here to support incall capture stream 3

config AOC_ALSA_IAMF
	bool "AoC ALSA audio capture 5 for IAMF support"
	depends on AOC_DRIVER
	default n
	help
		Say yes here to enable support for capturing audio stream 5,
		which is dedicated to the Immersive Audio Model and Format (IAMF).
		This option allows the AoC ALSA driver to handle audio capture for
		IAMF applications.
```
