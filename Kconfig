## Kconfig
```kconfig
# SPDX-License-Identifier: GPL-2.0
#
# For a description of the syntax of this configuration file,
# see Documentation/kbuild/kconfig-language.rst.
#
mainmenu "Linux/$(ARCH) $(KERNELVERSION) Kernel Configuration"

source "scripts/Kconfig.include"

source "init/Kconfig"

source "kernel/Kconfig.freezer"

source "fs/Kconfig.binfmt"

source "mm/Kconfig"

source "net/Kconfig"

source "drivers/Kconfig"

source "fs/Kconfig"

source "security/Kconfig"

source "crypto/Kconfig"

source "lib/Kconfig"

source "lib/Kconfig.debug"

source "Documentation/Kconfig"

choice
	prompt "Google SoC Kconfig.ext to use"
	default KCONFIG_EXT_NONE

config KCONFIG_EXT_NONE
	bool "None"

config KCONFIG_EXT_GS201
	bool "Tensor G2 (gs201)"

config KCONFIG_EXT_ZUMA
	bool "Tensor G3 (zuma)"

config KCONFIG_EXT_ZUMAPRO
	bool "Tensor G4 (zumapro)"

endchoice

if KCONFIG_EXT_GS201
source "google-devices/gs201/Kconfig.ext.gs201"
endif

if KCONFIG_EXT_ZUMA
source "google-devices/zuma/Kconfig.ext.zuma"
endif

if KCONFIG_EXT_ZUMAPRO
source "google-devices/zumapro/Kconfig.ext.zumapro"
endif
```

## google-devices/lga/lga_defconfig
```kconfig
CONFIG_AOC_LGA=y
CONFIG_ARCH_GOOGLE=y
CONFIG_ARM_SMMU_V3_PIXEL=m
CONFIG_ARM_SMMU_V3_PKVM_PIXEL=m
CONFIG_ARM_SMMU_V3_PMU_PIXEL=m
# CONFIG_CACHEFILES is not set
CONFIG_CODEC3P=m
CONFIG_CORESIGHT=m
CONFIG_CORESIGHT_CATU=m
CONFIG_CORESIGHT_LINKS_AND_SINKS=m
CONFIG_CORESIGHT_LINK_AND_SINK_TMC=m
CONFIG_CORESIGHT_SOURCE_ETM4X=m
CONFIG_CORESIGHT_STM=m
CONFIG_CORESIGHT_TRBE=m
CONFIG_GOOGLE_DEVFREQ=m
CONFIG_DEVFREQ_GOV_SIMPLE_ONDEMAND=y
# CONFIG_DEVTMPFS is not set
# CONFIG_DEVTMPFS_MOUNT is not set
CONFIG_DMABUF_HEAPS=y
CONFIG_DMABUF_HEAPS_CMA=m
CONFIG_DRM_DW_MIPI_CDPHY=m
CONFIG_DRM_DW_MIPI_DSI2H=m
# CONFIG_DRM_FBDEV_EMULATION is not set
CONFIG_DRM_G2D=m
# CONFIG_DRM_HDLCD is not set
CONFIG_DRM_VERISILICON=m
# CONFIG_ENABLE_DEFAULT_TRACERS is not set
CONFIG_EXT4_FS_POSIX_ACL=y
# CONFIG_EXYNOS_PD_EL3 is not set
# CONFIG_FB is not set
# CONFIG_FB_VIRTUAL is not set
# CONFIG_FSCACHE_DEBUG is not set
# CONFIG_FSCACHE_STATS is not set
# CONFIG_FTRACE_RECORD_RECURSION is not set
# CONFIG_FTRACE_STARTUP_TEST is not set
# CONFIG_FTRACE_SYSCALLS is not set
# CONFIG_FUNCTION_PROFILER is not set
CONFIG_GOOGLE_ACFW_DEBUG=m
CONFIG_GOOGLE_BCL=m
CONFIG_GOOGLE_BCL_MAX77779=y
CONFIG_GOOGLE_CAP_SYSFS=m
CONFIG_GOOGLE_CCF_DEVFREQ=m
CONFIG_GOOGLE_CDD_CPU_IDLE_INFO=m
CONFIG_GOOGLE_CPM_CLK=m
CONFIG_GOOGLE_CPM_LOG=m
CONFIG_GOOGLE_CPM_RST=m
CONFIG_GOOGLE_CPU_FREQ=m
CONFIG_GOOGLE_CPU_LPM_STATS=m
CONFIG_GOOGLE_CSTATE_CTRL=m
CONFIG_GOOGLE_DA9188_GPIO=m
CONFIG_GOOGLE_DA9188_REGULATOR=m
CONFIG_GOOGLE_DA9188_REGULATOR_REGISTER_ACCESS=y
CONFIG_GOOGLE_DA9188_RTC=m
CONFIG_GOOGLE_DA9188_VGPIO=m
# CONFIG_GOOGLE_GDMC is not set
CONFIG_GOOGLE_DTA_GADGET=m
CONFIG_GOOGLE_DVFS_HELPER=m
CONFIG_GOOGLE_EBU=m
CONFIG_GOOGLE_LCM=m
CONFIG_GOOGLE_EHLD_COREINSTR=m
CONFIG_GOOGLE_GPDMA=m
CONFIG_GOOGLE_GPU_PF_STATE=m
CONFIG_GOOGLE_GTC=m
CONFIG_GOOGLE_ICC_HELPER_MOCK_CLIENT=m
CONFIG_GOOGLE_IP_IDLE_NOTIFIER=m
CONFIG_GOOGLE_IRM=m
CONFIG_GOOGLE_LPM_PM_DOMAINS=m
CONFIG_GOOGLE_MBA_CTRL=m
CONFIG_GOOGLE_MBA_AGGREGATOR=m
CONFIG_GOOGLE_MBA_GDMC_INTERFACE=m
CONFIG_GOOGLE_MBA_GDMC_INTERFACE_TEST=m
CONFIG_GOOGLE_MBA_CPM_INTERFACE=m
CONFIG_GOOGLE_MBA_CPM_INTERFACE_TEST=m
CONFIG_GOOGLE_MBA_EBU_INTERFACE=m
CONFIG_GOOGLE_MFD_DA9188=m
CONFIG_GOOGLE_MEM_QOS_MOCK_CLIENT=m
CONFIG_GOOGLE_GDMC_DHUB=m
CONFIG_GOOGLE_GEM=m
CONFIG_GOOGLE_GEM_TEST=m
CONFIG_GOOGLE_ODPM=m
CONFIG_GOOGLE_PF_STATE_CPM=m
CONFIG_GOOGLE_POWERDASHBOARD=m
CONFIG_GOOGLE_POWER_CONTROLLER=m
CONFIG_GOOGLE_SKIP_S2M_VOTER=m
CONFIG_GOOGLE_TRACE_SOURCE=m
CONFIG_GOOGLE_THERMAL_CPM_MBOX=m
CONFIG_GOOGLE_TIMESTAMP_SYNC=m
CONFIG_GOOGLE_USB_PHY=m
CONFIG_GOOGLE_USB_ROLE_SW=m
CONFIG_GOOGLE_EUSB2_REPEATER=m
CONFIG_GOOGLE_WDT=m
CONFIG_GOOGLE_SST_PLATFORM=m
CONFIG_GS_DRM_PANEL_UNIFIED=m
CONFIG_GS_PANEL_SIMPLE=m
CONFIG_HARDLOCKUP_WATCHDOG=m
CONFIG_I2C_DW_GOOGLE_CORE=m
CONFIG_I2C_DW_GOOGLE_QUIRKS=m
CONFIG_IIF=m
# CONFIG_INITRAMFS_COMPRESSION_LZMA is not set
# CONFIG_INITRAMFS_COMPRESSION_LZO is not set
# CONFIG_INITRAMFS_COMPRESSION_NONE is not set
# CONFIG_INITRAMFS_COMPRESSION_XZ is not set
# CONFIG_INITRAMFS_COMPRESSION_ZSTD is not set
CONFIG_INITRAMFS_SOURCE=""
# CONFIG_KPROBE_EVENTS_ON_NOTRACE is not set
CONFIG_LWIS=m
# CONFIG_MODULE_SIG_ALL is not set
# CONFIG_NETFS_STATS is not set
CONFIG_NETFS_SUPPORT=m
CONFIG_NVMEM_RMEM=m
CONFIG_PCIE_DW_GOOGLE=m
CONFIG_PINCTRL_GOOGLE=m
CONFIG_PINCTRL_LGA=y
CONFIG_PL330_DMA_GOOGLE=m
CONFIG_POWERVR_LGA=y
CONFIG_POWERVR_PIXEL_IIF=y
CONFIG_POWERVR_ROGUE=m
# CONFIG_PSTORE_FTRACE is not set
# CONFIG_RDO_CPUIDLE_WFI_ONLY is not set
CONFIG_RDO_EXPERIMENTAL=y
CONFIG_RDO_EXPERIMENTAL_MANUAL_LPCM=m
# CONFIG_RDO_EXPERIMENTAL_MBA is not set
# CONFIG_RDO_EXPERIMENTAL_PMIC is not set
# CONFIG_RD_BZIP2 is not set
# CONFIG_RD_LZMA is not set
# CONFIG_RD_LZO is not set
# CONFIG_RD_XZ is not set
CONFIG_REGULATOR=y
CONFIG_SCSI=y
CONFIG_SERIAL_8250_DW=y
CONFIG_SERIAL_8250_DWLIB=y
CONFIG_SERIAL_8250_DW_GOOGLE_QUIRKS=m
CONFIG_SOC_LGA=y
CONFIG_SOFT_WATCHDOG=m
CONFIG_GOOGLE_CHIP_INFO=m
CONFIG_SPI_DESIGNWARE=m
CONFIG_SPI_DW_DMA=y
CONFIG_SPI_DW_GOOGLE_QUIRKS=m
CONFIG_SPI_LOOPBACK_TEST=m
CONFIG_SPI_SPIDEV=y
CONFIG_SYNC_FILE=y
CONFIG_UFS_DW_GOOGLE=m
CONFIG_UFS_PIXEL_FEATURES=y
CONFIG_UFS_PIXEL_CRYPTO=y
CONFIG_USB_CONFIGFS_F_DM=m
CONFIG_USB_DWC3=y
CONFIG_USB_DWC3_DUAL_ROLE=y
# CONFIG_USB_DWC3_GADGET is not set
CONFIG_USB_DWC3_GOOGLE=m
# CONFIG_USB_DWC3_HOST is not set
CONFIG_USB_DWC3_OF_SIMPLE=y
# CONFIG_USB_G_SERIAL is not set
CONFIG_VERISILICON_CHIP_9x00=y
CONFIG_VERISILICON_DC9400_0x32a=y
# CONFIG_VERISILICON_DEC is not set
CONFIG_VERISILICON_MIPI_DSI2H=y
# CONFIG_VERISILICON_MMU is not set
CONFIG_VH_FS=m
# CONFIG_VIRTIO_BLK is not set
# CONFIG_VIRTIO_MEM is not set
# CONFIG_VIRTIO_MMIO is not set
# CONFIG_VIRTIO_MMIO_CMDLINE_DEVICES is not set
# CONFIG_VT is not set
CONFIG_GOOGLE_PMU_EHLD=m
CONFIG_GOOGLE_MODEMCTL=m
CONFIG_POWER_STATE_BLOCKERS_SECTION=m
CONFIG_AOC_ALSA_DP_AUDIO=y
CONFIG_AOC_ALSA_INCALL_CAP_3=y
CONFIG_AOC_ALSA_IAMF=y
CONFIG_AOC_ALSA_USB=y
CONFIG_AOC_DRIVER=m
CONFIG_AOC_USB_AUDIO_OFFLOAD=y
CONFIG_AOSS_SSR_NOTIFIER=m
CONFIG_ARM_CMN=m
CONFIG_ARM_DSU_PMU=m
CONFIG_BOOKERCI=m
CONFIG_CFG80211=m
CONFIG_CHR_DEV_SG=m
CONFIG_COMMON_PANEL_TEST=m
# CONFIG_CPUIDLE_METRICS=y
CONFIG_DEBUG_PANEL_TEST=y
CONFIG_DEBUG_REBOOT=m
CONFIG_DMABUF_HEAPS_GOOGLE_GCMA=y
CONFIG_DMABUF_HEAPS_SAMSUNG_CARVEOUT=y
CONFIG_DMABUF_HEAPS_SAMSUNG_CHUNK=y
CONFIG_DMABUF_HEAPS_SAMSUNG_CMA=y
CONFIG_DMABUF_HEAPS_SAMSUNG_SYSTEM=y
CONFIG_DMABUF_SAMSUNG_HEAPS=m
CONFIG_DWC_DPTX=m
CONFIG_DWC_DPTX_AUDIO=y
CONFIG_EEPROM_AT24=m
CONFIG_EXYNOS_CONTENT_PATH_PROTECTION=m
CONFIG_EXYNOS_GNSS_IF_SPI=m
CONFIG_GIA_LIB=m
CONFIG_GOOGLE_CCF_DEVFREQ=m
CONFIG_GOOGLE_CRASH_DEBUG_DUMP=m
CONFIG_GOOGLE_DEVFREQ=m
CONFIG_GOOGLE_DSU_FREQ=m
CONFIG_GOOGLE_DVFS_HELPER=m
CONFIG_GOOGLE_DW_I3C_MASTER=m
CONFIG_GOOGLE_GIA_IRQ=m
CONFIG_GOOGLE_GIA_TEST=m
CONFIG_GOOGLE_IRM=m
CONFIG_GOOGLE_IRM_DEVFREQ=m
CONFIG_GOOGLE_IRQ_CPM=m
CONFIG_GOOGLE_IRQ_EXTENDED_SYSFS=m
CONFIG_GOOGLE_LOGBUFFER=m
CONFIG_GOOGLE_MEM_QOS=m
CONFIG_GOOGLE_RA=m
CONFIG_GOOGLE_REGMAP_SPMI=m
CONFIG_GOOGLE_SLC=m
CONFIG_GOOGLE_VOLATILE_DEBUG_UNLOCK=m
CONFIG_GOOGLE_VOTABLE=m
CONFIG_GOOG_TOUCH_INTERFACE=m
CONFIG_GSA=m
CONFIG_GSA_GSC=m
CONFIG_GSA_LINUX_MAILBOX=y
CONFIG_GS_DEBUG_TEST=m
CONFIG_GS_DOMAIN_IDLE=m
CONFIG_GS_PANEL_S6E3HC4=m
CONFIG_GS_PERF_MON=m
CONFIG_HARDLOCKUP_DEBUG_LGA=m
CONFIG_I2C_CHARDEV=m
CONFIG_INPUT_KEYCOMBO=m
CONFIG_INPUT_KEYDEBUG=m
CONFIG_KERNEL_TOP=m
CONFIG_MAC80211=m
CONFIG_METRICS_COLLECTION_FRAMEWORK=m
CONFIG_MFD_SLG51002=m
# CONFIG_PERF_METRICS=y
CONFIG_PERF_TRACE_CTRS=m
CONFIG_PINCTRL_SLG51002=m
CONFIG_PIXEL_BOOT_METRICS=m
CONFIG_PIXEL_DEBUG_KINFO=m
CONFIG_PIXEL_DEBUG_TEST=m
CONFIG_PIXEL_EM=m
CONFIG_PIXEL_EM_FREQUENCY_SCALING=m
CONFIG_PIXEL_EM_VOLTAGE_SCALING=m
CONFIG_PIXEL_GCMA=m
CONFIG_PIXEL_IOMMU_MAP_BENCHMARK=m
CONFIG_PIXEL_METRICS=m
CONFIG_PIXEL_POWER_REBOOT=m
CONFIG_PIXEL_STAT=m
CONFIG_PIXEL_STAT_MM=m
CONFIG_PROACTIVE_KILL=m
CONFIG_REGULATOR_RT6160_GS=m
CONFIG_REGULATOR_S2DOS07X02_GS=m
CONFIG_REGULATOR_SLG51002=m
CONFIG_REGULATOR_TPS628600_GS=m
CONFIG_S5910=m
CONFIG_SBB_MUX=m
CONFIG_SLC_PARTITION_MANAGER=m
CONFIG_SLC_PARTITION_MANAGER_LEGACY=y
CONFIG_SMRA=m
CONFIG_SOC_GOOGLE=y
CONFIG_SPMI_BITBANG=m
CONFIG_SPMI_SMARTDV=m
CONFIG_SUBSYSTEM_COREDUMP=m
CONFIG_TCPCI_VENDOR_HOOKS=y
CONFIG_THERMAL_METRICS=y
CONFIG_TICK_DRIVEN_LATGOV=m
CONFIG_TOUCHSCREEN_HEATMAP=m
CONFIG_TOUCHSCREEN_OFFLOAD=m
CONFIG_TOUCHSCREEN_TBN=m
CONFIG_TOUCHSCREEN_TBN_AOC_CHANNEL_MODE=y
CONFIG_TRUSTY=m
CONFIG_TRUSTY_CRASH_IS_PANIC=y
CONFIG_TRUSTY_DMA_BUF_FFA_TAG=y
CONFIG_TRUSTY_VIRTIO_IPC=m
CONFIG_TYPEC_COOLING_DEV=m
CONFIG_TYPEC_MAX77759_CONTAMINANT=m
CONFIG_TYPEC_MAX77779_CONTAMINANT=m
CONFIG_TYPEC_MAX777X9_SPMI=m
CONFIG_TZ_PROT=m
CONFIG_VERISILICON_DC9400_0x316=y
CONFIG_VH_CGROUP=m
CONFIG_VH_KERNEL=y
CONFIG_VH_MM=m
CONFIG_VH_PREEMPTIRQ_TRACEPOINTS=m
CONFIG_VH_SCHED=m
CONFIG_THERMAL_METRICS=y
CONFIG_PERF_METRICS=y
CONFIG_CPUIDLE_METRICS=y
CONFIG_VH_SCHED_MAX_CPU_NR=8
CONFIG_VH_SYSTRACE=m
CONFIG_VH_THERMAL=m
CONFIG_ZSMALLOC=m
```

## google-devices/malibu/Kconfig.ext.malibu
```kconfig
# SPDX-License-Identifier: GPL-2.0-only

source "$(KCONFIG_SOC_RDO_PREFIX)Kconfig"

source "$(KCONFIG_SOC_RDO_PREFIX)aoss-ssr-notifier/Kconfig"

source "$(KCONFIG_SOC_RDO_PREFIX)ap-pmic/Kconfig"

source "$(KCONFIG_SOC_RDO_PREFIX)boot-diary/Kconfig"

source "$(KCONFIG_SOC_RDO_PREFIX)cap-sysfs/Kconfig"

source "$(KCONFIG_SOC_RDO_PREFIX)clk/google/Kconfig"

source "$(KCONFIG_SOC_RDO_PREFIX)clocksource/google/sst/Kconfig"

source "$(KCONFIG_SOC_RDO_PREFIX)cpm-cli/Kconfig"

source "$(KCONFIG_SOC_RDO_PREFIX)cpu-lpm-stats/Kconfig"

source "$(KCONFIG_SOC_RDO_PREFIX)cs-ets/Kconfig"

source "$(KCONFIG_SOC_RDO_PREFIX)cstate-ctrl/Kconfig"

source "$(KCONFIG_SOC_RDO_PREFIX)drivers/clk/google/Kconfig"

source "$(KCONFIG_SOC_RDO_PREFIX)drivers/dma/Kconfig"

source "$(KCONFIG_SOC_RDO_PREFIX)drivers/i2c/busses/Kconfig"

source "$(KCONFIG_SOC_RDO_PREFIX)drivers/i3c/master/Kconfig"

source "$(KCONFIG_SOC_RDO_PREFIX)drivers/i3c/master_thi/Kconfig"

source "$(KCONFIG_SOC_RDO_PREFIX)drivers/irqchip/Kconfig"

source "$(KCONFIG_SOC_RDO_PREFIX)drivers/mailbox/Kconfig"

source "$(KCONFIG_SOC_RDO_PREFIX)drivers/perf/Kconfig"

source "$(KCONFIG_SOC_RDO_PREFIX)drivers/pinctrl/google/Kconfig"

source "$(KCONFIG_SOC_RDO_PREFIX)drivers/power/Kconfig"

source "$(KCONFIG_SOC_RDO_PREFIX)drivers/rst/google/Kconfig"

source "$(KCONFIG_SOC_RDO_PREFIX)drivers/soc/google/cdd/Kconfig"

source "$(KCONFIG_SOC_RDO_PREFIX)drivers/soc/google/cdd-cpu/Kconfig"

source "$(KCONFIG_SOC_RDO_PREFIX)drivers/soc/google/debug/Kconfig"

source "$(KCONFIG_SOC_RDO_PREFIX)drivers/soc/google/fwmt/Kconfig"

source "$(KCONFIG_SOC_RDO_PREFIX)drivers/soc/google/fwtp/Kconfig"

source "$(KCONFIG_SOC_RDO_PREFIX)drivers/soc/google/Kconfig"

source "$(KCONFIG_SOC_RDO_PREFIX)drivers/soc/google/vdu/Kconfig"

source "$(KCONFIG_SOC_RDO_PREFIX)drivers/spi/Kconfig"

source "$(KCONFIG_SOC_RDO_PREFIX)drivers/spmi/Kconfig"

source "$(KCONFIG_SOC_RDO_PREFIX)drivers/tty/serial/8250/Kconfig"

source "$(KCONFIG_SOC_RDO_PREFIX)drivers/tty/serial/modem-uart/Kconfig"

source "$(KCONFIG_SOC_RDO_PREFIX)drivers/ufs/Kconfig"

source "$(KCONFIG_SOC_RDO_PREFIX)ebu/Kconfig"

source "$(KCONFIG_SOC_RDO_PREFIX)edac/Kconfig"

source "$(KCONFIG_SOC_RDO_PREFIX)experimental/Kconfig"

source "$(KCONFIG_SOC_RDO_PREFIX)gadget/dta/Kconfig"

source "$(KCONFIG_SOC_RDO_PREFIX)gadget/perf_test/Kconfig"

source "$(KCONFIG_SOC_RDO_PREFIX)gpca/Kconfig"

source "$(KCONFIG_SOC_RDO_PREFIX)hardlockup-debug/Kconfig"

source "$(KCONFIG_SOC_RDO_PREFIX)interconnect/Kconfig"

source "$(KCONFIG_SOC_RDO_PREFIX)ip-idle-notifier/Kconfig"

source "$(KCONFIG_SOC_RDO_PREFIX)lpcm/Kconfig"

source "$(KCONFIG_SOC_RDO_PREFIX)mem-qos/Kconfig"

source "$(KCONFIG_SOC_RDO_PREFIX)odpm/Kconfig"

source "$(KCONFIG_SOC_RDO_PREFIX)pci/Kconfig"

source "$(KCONFIG_SOC_RDO_PREFIX)phy/Kconfig"

source "$(KCONFIG_SOC_RDO_PREFIX)power-controller/Kconfig"

source "$(KCONFIG_SOC_RDO_PREFIX)powerdashboard/Kconfig"

source "$(KCONFIG_SOC_RDO_PREFIX)pwm/Kconfig"

source "$(KCONFIG_SOC_RDO_PREFIX)thermal/Kconfig"

source "$(KCONFIG_SOC_RDO_PREFIX)trace/Kconfig"

source "$(KCONFIG_SOC_RDO_PREFIX)usb/Kconfig"

source "$(KCONFIG_SOC_RDO_PREFIX)watchdog/Kconfig"

source "$(KCONFIG_SOC_GS_PREFIX)drivers/dma-buf/heaps/Kconfig"

source "$(KCONFIG_SOC_GS_PREFIX)drivers/iommu/Kconfig"

source "$(KCONFIG_SOC_GS_PREFIX)drivers/input/Kconfig"

source "$(KCONFIG_SOC_GS_PREFIX)drivers/mfd/Kconfig"

source "$(KCONFIG_SOC_GS_PREFIX)drivers/misc/sbb-mux/Kconfig"

source "$(KCONFIG_SOC_GS_PREFIX)drivers/misc/sscoredump/Kconfig"

source "$(KCONFIG_SOC_GS_PREFIX)drivers/pinctrl/Kconfig"

source "$(KCONFIG_SOC_GS_PREFIX)drivers/power/reset/Kconfig"

source "$(KCONFIG_SOC_GS_PREFIX)drivers/regulator/Kconfig"

source "$(KCONFIG_SOC_GS_PREFIX)drivers/soc/google/Kconfig"

source "$(KCONFIG_SOC_GS_PREFIX)drivers/spmi/Kconfig"

source "$(KCONFIG_SOC_GS_PREFIX)drivers/usb/dwc3/Kconfig"

source "$(KCONFIG_SOC_GS_PREFIX)drivers/usb/role-sw/Kconfig"

source "$(KCONFIG_SOC_GS_PREFIX)drivers/usb/typec/tcpm/google/Kconfig"

source "$(KCONFIG_EXT_MODULES_PREFIX)private/google-modules/aoc/Kconfig"

source "$(KCONFIG_EXT_MODULES_PREFIX)private/google-modules/aoc/alsa/Kconfig"

source "$(KCONFIG_EXT_MODULES_PREFIX)private/google-modules/aoc/usb/Kconfig"

source "$(KCONFIG_EXT_MODULES_PREFIX)private/google-modules/bms/misc/Kconfig"

source "$(KCONFIG_EXT_MODULES_PREFIX)private/google-modules/display/common/Kconfig"

source "$(KCONFIG_EXT_MODULES_PREFIX)private/google-modules/display/interfaces/synopsys/dwc_dptx/Kconfig"

source "$(KCONFIG_EXT_MODULES_PREFIX)private/google-modules/display/vsi-drm/bridge/synopsys/dsi2host/Kconfig"

source "$(KCONFIG_EXT_MODULES_PREFIX)private/google-modules/display/vsi-drm/phy/synopsys/Kconfig"

source "$(KCONFIG_EXT_MODULES_PREFIX)private/google-modules/display/vsi-drm/verisilicon/Kconfig"

source "$(KCONFIG_EXT_MODULES_PREFIX)private/google-modules/display/vsi-g2d/google/Kconfig"

source "$(KCONFIG_EXT_MODULES_PREFIX)private/google-modules/iommu/arm-smmu-v3/drivers/iommu/Kconfig"

source "$(KCONFIG_EXT_MODULES_PREFIX)private/google-modules/iommu/arm-smmu-v3/drivers/perf/Kconfig"

source "$(KCONFIG_EXT_MODULES_PREFIX)private/google-modules/lwis/Kconfig"

source "$(KCONFIG_EXT_MODULES_PREFIX)private/google-modules/misc/h2omg/Kconfig"

source "$(KCONFIG_EXT_MODULES_PREFIX)private/google-modules/perf/Kconfig"

source "$(KCONFIG_EXT_MODULES_PREFIX)private/google-modules/power/reset/Kconfig"

source "$(KCONFIG_EXT_MODULES_PREFIX)private/google-modules/power/mitigation/Kconfig"

source "$(KCONFIG_EXT_MODULES_PREFIX)private/google-modules/powervr/Kconfig"

source "$(KCONFIG_EXT_MODULES_PREFIX)private/google-modules/radio/common/metrics_collection/Kconfig"

source "$(KCONFIG_EXT_MODULES_PREFIX)private/google-modules/radio/common/radio-bridge/Kconfig"

source "$(KCONFIG_EXT_MODULES_PREFIX)private/google-modules/soc/gs/drivers/soc/google/gsa/Kconfig"

source "$(KCONFIG_EXT_MODULES_PREFIX)private/google-modules/touch/common/Kconfig"

source "$(KCONFIG_EXT_MODULES_PREFIX)private/google-modules/trusty/drivers/trusty/Kconfig"

source "$(KCONFIG_EXT_MODULES_PREFIX)private/google-modules/video/cnm/Kconfig"

source "$(KCONFIG_EXT_MODULES_PREFIX)private/google-modules/soc/rdo/drivers/iis/Kconfig"
```
