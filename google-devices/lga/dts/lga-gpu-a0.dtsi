// SPDX-License-Identifier: GPL-2.0-only

#include "lga-base.dtsi"

&gpu_pf_state {
	pf_state_rates =
		/* FABHBW votes	MEMSS votes	GMC votes */
		<             0	          0	        0>,
		<             0	          0	        1>,
		<             1	          1	        2>,
		<             1	          1	        3>,
		<             2	          2	        4>,
		<             2	          2	        5>,
		<             3	          3	        6>,
		<             3	          3	        7>,
		<             4	          4	        8>,
		<             4	          4	        9>,
		<             5	          5	       10>,
		<             5	          5	       11>,
		<             6	          6	       12>,
		<             7	          7	       13>;
};

&gpu {
	vote_manager {
		soft_max_freq = <998000000>;
	};
};
