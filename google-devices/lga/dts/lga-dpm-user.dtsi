// SPDX-License-Identifier: GPL-2.0-only OR BSD-2-Clause

#include <dt-bindings/soc/google/google-cdd-def.h>

&dpm {
	/* If you change 'version', please bump dpm_ver in the init_dpm.sh script (b/351346396) */
	version = <101>; /* 'version' should be equal in all lga-dpm-*.dtsi files */
	variant = "user";

	security {
		cp_mem_not_clear	= <0>;
		dbg_mem_enable		= <0>;
		seh_enable		= <0>;
		pm_test_enable		= <0>;
		seclog_enable		= <0>;
		harxlog_enable		= <0>;
		sdm_enable		= <0>;
		ERXPFG_enable		= <0>;
	};

	abl {
		ramdump_mode		= <0>;
		ramdump2usb		= <0>;
		tp_dram_enable		= <0>;
		aoc_sram_dump		= <0>;
		gslc_dump		= <0>;
		apc_cache_dump		= <0>;
	};
}; /* end of dpm */
