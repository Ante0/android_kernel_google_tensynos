// SPDX-License-Identifier: GPL-2.0-only

&irm_gmc_freq {
	gmc-memss-table =
		/* gmc		memss */
		/bits/ 64 <  409000000	178000000 >,
		/bits/ 64 <  537000000	178000000 >,
		/bits/ 64 <  672000000	233000000 >,
		/bits/ 64 <  844000000	233000000 >,
		/bits/ 64 <  998000000	466000000 >,
		/bits/ 64 < 1344000000	466000000 >,
		/bits/ 64 < 1536000000	666000000 >,
		/bits/ 64 < 1689000000	666000000 >,
		/bits/ 64 < 1996000000	711000000 >,
		/bits/ 64 < 2227000000	800000000 >,
		/bits/ 64 < 2688000000	800000000 >,
		/bits/ 64 < 3148000000	800000000 >,
		/bits/ 64 < 3686000000	932000000 >,
		/bits/ 64 < 4224000000	932000000 >;
};
