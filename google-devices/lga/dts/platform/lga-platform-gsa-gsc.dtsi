// SPDX-License-Identifier: GPL-2.0-only

/* Setup GSA_GSC proxy driver to talk to GSC over GSA */
&gsa {
	gsa_gsc@0 {
		compatible = "google,gs101-gsa-gsc-v1";

		interrupt-parent = <&cpm_pinctrl>;
		interrupts = <1 0 0>;
		gsc,ctdl_ap_irq = < GSC2AP_IRQ(GPIO_ACTIVE_HIGH) >;
	};
};

