// SPDX-License-Identifier: GPL-2.0-only

&irm_gmc_freq {
	gmc-memss-table =
		/* gmc		memss */
		/bits/ 64 < 410000000	178000000 >,
		/bits/ 64 < 672000000	233000000 >,
		/bits/ 64 < 998400000	333000000 >,
		/bits/ 64 < 1536000000	466000000 >,
		/bits/ 64 < 1996800000	666000000 >,
		/bits/ 64 < 2688000000	711000000 >,
		/bits/ 64 < 3686400000	800000000 >,
		/bits/ 64 < 4224000000	932000000 >;
};
