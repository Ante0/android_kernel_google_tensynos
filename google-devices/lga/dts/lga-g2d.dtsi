// SPDX-License-Identifier: GPL-2.0 OR BSD-3-Clause

#include <dt-bindings/interrupt-controller/arm-gic.h>
#include <dt-bindings/interrupt-controller/lga-gic.h>
#include <dt-bindings/interrupt-controller/irq-gia-google-lga.h>

/ {
	sswrp_g2d: sswrp_g2d@3f200000 {
		compatible = "simple-bus";
		#address-cells = <1>;
		#size-cells = <1>;
		ranges = <0x0 0x0 0x3f200000 0x1d7000>;

		g2d_core: g2d_core@150000 {
			compatible = "google,g2d-drm-device";
			reg = <0x0150000 0x20000>;
			interrupt-parent = <&g2d_level_aggr_2_intr>;
			interrupts = <G2D_GIA_LEVEL_2_AGGR_IP_NS_GIA_INPUT_IRQ_PIPE1_FRAME_DONE>,
				<G2D_GIA_LEVEL_2_AGGR_IP_NS_GIA_INPUT_IRQ_PIPE0_FRAME_DONE>,
				<G2D_GIA_LEVEL_2_AGGR_IP_NS_GIA_INPUT_IRQ_PIPE1_FRAME_START>,
				<G2D_GIA_LEVEL_2_AGGR_IP_NS_GIA_INPUT_IRQ_PIPE0_FRAME_START>,
				<G2D_GIA_LEVEL_2_AGGR_IP_NS_GIA_INPUT_IRQ_SW_RST_DONE>,
				<G2D_GIA_LEVEL_2_AGGR_IP_NS_GIA_INPUT_IRQ_PIPE1_PVRIC_ENCODE_ERROR>,
				<G2D_GIA_LEVEL_2_AGGR_IP_NS_GIA_INPUT_IRQ_PIPE1_PVRIC_DECODE_ERROR>,
				<G2D_GIA_LEVEL_2_AGGR_IP_NS_GIA_INPUT_IRQ_PIPE0_PVRIC_ENCODE_ERROR>,
				<G2D_GIA_LEVEL_2_AGGR_IP_NS_GIA_INPUT_IRQ_PIPE0_PVRIC_DECODE_ERROR>,
				<G2D_GIA_LEVEL_2_AGGR_IP_NS_GIA_INPUT_IRQ_AXI_BUS_ERROR>,
				<G2D_GIA_LEVEL_2_AGGR_IP_NS_GIA_INPUT_IRQ_AXI_WR_BUS_HANG>,
				<G2D_GIA_LEVEL_2_AGGR_IP_NS_GIA_INPUT_IRQ_AXI_RD_BUS_HANG>,
				<G2D_GIA_LEVEL_2_AGGR_IP_NS_GIA_INPUT_IRQ_APB_HANG>;
			interrupt-names = "irq_g2d_pipe1_frame_done",
				"irq_g2d_pipe0_frame_done",
				"irq_g2d_pipe1_frame_start",
				"irq_g2d_pipe0_frame_start",
				"irq_g2d_sw_rst_done",
				"irq_g2d_pipe1_pvric_encode_error",
				"irq_g2d_pipe1_pvric_decode_error",
				"irq_g2d_pipe0_pvric_encode_error",
				"irq_g2d_pipe0_pvric_decode_error",
				"irq_g2d_axi_bus_error",
				"irq_g2d_axi_wr_bus_hang",
				"irq_g2d_axi_rd_bus_hang",
				"irq_g2d_apb_hang";
			power-domains = <&g2d_core_pd>;
			iommus = <&inf_smmu 0x8501>;

			interconnects = <&icc_gmc SSWRP_G2D &icc_gmc GMC>;
			interconnect-names = "sswrp-g2d";

			devfreq = <&g2d_freq>;
		};
	};
};

