// SPDX-License-Identifier: GPL-2.0-only
/*
 * yogi device tree source
 *
 * Copyright 2025 Google LLC
 */

/dts-v1/;
/plugin/;

/* define board-specific  GPIO macros before other devicetrees */
#include "malibu-yogi-dvt-pinctrl.dtsi"
#include "malibu-dabears-common.dtsi"
#include "malibu-yogi-lsio.dtsi"
#include "malibu-yogi-common.dtsi"
#include "malibu-yogi-camera-pmic.dtsi"
#include "malibu-yogi-camera.dtsi"


/ {
	board_id = <0x80704>;
	board_rev = <0x010000>;
	fragment@boardbase {
		target-path = "/";
		__overlay__ {
			model = "YOGI DVT 1.0 based on MALIBU";
			compatible = "google,malibu-yogi", "google,malibu";
		};
	};
};

