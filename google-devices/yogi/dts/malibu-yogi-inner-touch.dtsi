// SPDX-License-Identifier: GPL-2.0-only OR BSD-3-Clause
/*
 * yogi inner touch device tree source
 *
 * Copyright 2025 Google LLC
 */

&inner_touch {
	status = "ok";

	compatible = "st,fst2";
	spi-max-frequency = <19200000>;
	rx-sample-delay-ns = <25>;
	pinctrl-names = "pmx_ts_active", "pmx_ts_suspend";

	st,dchip_id = /bits/ 8 <0x46 0x54>;
	st,max-coords = <2076 2152>;
	st,device_name = "fts";
	st,irq-gpio = <TS1_2_AOSS_INT_L_1V2(GPIO_ACTIVE_LOW)>;
	st,reset-gpio = <PMICS2TS1_RESET_L_1V2(GPIO_ACTIVE_LOW)>;
	st,grip_area = /bits/ 8 <15>; /* Left and right grip rejection
					 area. Unit: pixels */
	st,mm2px = /bits/ 8 <15>; /* 2152 px / 146.5512 mm  = 14.684 */
	st,sensor_inverted_x;
	st,hdm_frame_enabled;

	goog,firmware_names = "st_fts.ubin";
	goog,test_limits_names = "stm_fts_production_limits.csv";

	goog,tbn-enabled;
	//goog,tbn-protection-enabled;
	goog,touch-sim-enabled;
	goog,offload-enabled;
	goog,v4l2-enabled;
	goog,dev-id = <0>;
	goog,touch_offload_id = /bits/ 8 <0x26 0x50 0x10 0x00>;
	goog,display-resolution = /bits/ 16 <2076 2152>;
	goog,channel-num = /bits/ 16 <38 39>;
	goog,offload-caps-data-types = /bits/ 16 <0x1F>;
	goog,offload-caps-scan-types = /bits/ 16 <0xC0>;
	goog,offload-caps-context-channel-types = /bits/ 16 <0x0500>;
	goog,offload-caps-coord-filter;
	goog,late-sense-on-enabled;
	goog,timestamp-correction-enabled;
	goog,default-report-rate = <120>;
};

&google_gs_iyida {
	touch = <&inner_touch>;
};
