// SPDX-License-Identifier: GPL-2.0-only
/*
 * Battery charging thermal config for Yogi
 *
 * Copyright 2025 Google LLC
 *
 */

&google_cpm {
	/* thermal budgets */
	google,mdis-thermal-mitigation =
	<3710000 3571000 3443000 3297000 3162000 3040000 2918000 2810000 2703000
	2598000 2493000 2330000 2200000 2080000 1968000 1865000 1770000 1684000
	1595000 1506000 1444000 1382000 1351000 1320000 1273000 1225000>;
	/* PD+main-charger */
	google,mdis-out0-limits =
	<4000000 3880000 3760000 3640000 3520000 3400000 3280000 3160000 3040000
	2920000 2800000 2680000 2560000 2440000 2320000 2200000 2080000 1960000
	1840000 1720000 1600000 1480000 1360000 1240000 1120000 1000000>;
	/* PE26100 Buck charger */
	google,mdis-out1-limits =
	<5590000 5406400 5222800 5039200 4855600 4672000 4488400 4304800 4121200
	3937600 3754000 3570400 3386800 3203200 3019600 2836000 2652400 2468800
	2285200 2101600 1918000 1734400 1550800 1367200 1183600 1000000>;
	/* PE26100 CP charger */
	google,mdis-out2-limits =
	<5590000 5446400 5302800 5159200 5015600 4872000 4728400 4584800 4441200
	4297600 4154000 4010400 3866800 3723200 3579600 3436000 3292400 3148800
	3005200 2861600 2718000 2574400 2430800 2287200 2143600 2000000>;
};

&google_wlc {
	bpp_mdis_pwr = <5000000 4906200 4812400 4718600 4624800 4531000 4437200
			4343400 4249600 4155800 4062000 3968200 3874400 3780600
			3686800 3593000 3499200 3405400 3311600 3217800 3124000
			3030200 2936400 2842600 2748800 2655000>;
	mpp-mdis-max77779 = <15000000 14539920 14079840 13619760 13159680 12699600 12239520
			     11779440 11319360 10859280 10399200 9939120 9479040 9018960
			     8558880 8098800 7638720 7178640 6718560 6258480 5798400
			     5338320 4878240 4418160 3958080 3498000>;
	mpp-mdis-pe26100-buck = <20000000 19265600 18531200 17796800 17062400 16328000 15593600
				 14859200 14124800 13390400 12656000 11921600 11187200 10452800
				 9718400 8984000 8249600 7515200 6780800 6046400 5312000
				 4577600 3843200 3108800 2374400 1640000>;
	mpp-mdis-pe26100-cp = <15000000 14555200 14110400 13665600 13220800 12776000 12331200
			       11886400 11441600 10996800 10552000 10107200 9662400 9217600
			       8772800 8328000 7883200 7438400 6993600 6548800 6104000
			       5659200 5214400 4769600 4324800 3880000>;
};
