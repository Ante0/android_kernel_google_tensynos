// SPDX-License-Identifier: GPL-2.0-only
/*
 * Battery device tree entries
 *
 * Copyright 2025 Google LLC
 *
 */

max77779,config {

	/* 9YI4-B-ATL-4010_Proxy-G1.ini.txt.overlay, b/462212107#comment2 */
	max77779,atl-1k {
		max77779,batt-id-kohm = <1>;
		max77779,model-version = <2>;
		max77779,fg-model = /bits/ 16 <
			0x9600 0xaba0 0xb780 0xb910 0xbb60 0xbd30 0xbf10 0xc0d0
			0xc420 0xc800 0xcbf0 0xd190 0xd5a0 0xd9c0 0xdd70 0xe180
			0x0020 0x0160 0x0d10 0x0d50 0x1080 0x1490 0x1010 0x0c00
			0x0710 0x07b0 0x0670 0x0660 0x06e0 0x07b0 0x0450 0x0450
		>;
		max77779,fg-params = /bits/ 16 <
			/* 0x00C0 */	0xc1b0	/* nnvcfg0 */
			/* 0x00B6 */	0x043b	/* nrelaxcfg */
			/* 0x009F */	0x660e	/* nLearnCFG */
			/* 0x000C */	0x4207	/* Config */
			/* 0x00AB */	0x0081	/* Config2 */
			/* 0x00BC */	0x5f00	/* nFullSOCThr */
			/* 0x00A9 */	0x0204	/* nfullcaprep */
			/* 0x00B3 */	0x0204	/* ndesigncap */
			/* 0x0046 */	0x0c80	/* dPacc */
			/* 0x00A5 */	0x0204	/* nfullcapnom */
			/* 0x00C6 */	0xa95a	/* nVEmpty */
			/* 0x00A0 */	0x320a	/* nQRTable00 */
			/* 0x00A1 */	0x1504	/* nQRTable10 */
			/* 0x00A2 */	0x0680	/* nQRTable20 */
			/* 0x00A3 */	0x0580	/* nQRTable30 */
			/* 0x00A6 */	0x03e0	/* nRCOMP0 */
			/* 0x00A7 */	0x1402	/* nTempCo */
			/* 0x009C */	0x00a5	/* nichgterm */
			/* 0x00B2 */	0x3870	/* nmisccfg */
			/* 0x009E */	0x0400	/* nModelCfg */
			/* 0x00CA */	0xc8ff	/* nThermCfg */
			/* 0x009D */	0xcea7	/* nFilterCfg */
		>;
		max77779,fg_regval = /bits/ 16 <
			0x1F 0xA95A	/* VEmpty */
			0x3A 0x1002	/* SOCHold */
		>;
		max77779,fg_n_regval = /bits/ 16 <
			0xB7 0x2240	/* nConvgCfg */
			0xC8 0xC8FF	/* nThermCfg3 */
			0xC9 0xC8FF	/* nThermCfg2 */
		>;
		max77779,fg-aafv = /bits/ 32 <
			  0   95  0xf  0x00a5
			 20   90  0xf  0x0053
			 40   85  0xf  0x0053
			 60   80  0xf  0x0053
			 80   75  0xf  0x0053
			100   70  0xf  0x0053
		>;
	};

	/* 9YI4-B-LWN-3950-G1.ini.txt.overlay, b/462216388#comment2 */
	max77779,lwn-4k {
		max77779,batt-id-kohm = <4>;
		max77779,model-version = <2>;
		max77779,fg-model = /bits/ 16 <
			0x9610 0xaa00 0xb800 0xb910 0xbae0 0xbd10 0xbe50 0xbf70
			0xc170 0xc320 0xc660 0xc990 0xce00 0xd270 0xd9d0 0xe060
			0x0020 0x0130 0x1580 0x0ca0 0x1000 0x1600 0x1430 0x0d30
			0x0be0 0x07b0 0x0730 0x06f0 0x0650 0x06c0 0x0700 0x0700
		>;
		max77779,fg-params = /bits/ 16 <
			/* 0x00C0 */	0xc1b0	/* nnvcfg0 */
			/* 0x00B6 */	0x043b	/* nrelaxcfg */
			/* 0x009F */	0x660e	/* nLearnCFG */
			/* 0x000C */	0x4207	/* Config */
			/* 0x00AB */	0x0081	/* Config2 */
			/* 0x00BC */	0x5f00	/* nFullSOCThr */
			/* 0x00A9 */	0x0210	/* nfullcaprep */
			/* 0x00B3 */	0x0210	/* ndesigncap */
			/* 0x0046 */	0x0c80	/* dPacc */
			/* 0x00A5 */	0x0210	/* nfullcapnom */
			/* 0x00C6 */	0xa95a	/* nVEmpty */
			/* 0x00A0 */	0x3b05	/* nQRTable00 */
			/* 0x00A1 */	0x1a82	/* nQRTable10 */
			/* 0x00A2 */	0x0a80	/* nQRTable20 */
			/* 0x00A3 */	0x0780	/* nQRTable30 */
			/* 0x00A6 */	0x0470	/* nRCOMP0 */
			/* 0x00A7 */	0x1502	/* nTempCo */
			/* 0x009C */	0x00a5	/* nichgterm */
			/* 0x00B2 */	0x3870	/* nmisccfg */
			/* 0x009E */	0x0400	/* nModelCfg */
			/* 0x00CA */	0xc8ff	/* nThermCfg */
			/* 0x009D */	0xcea7	/* nFilterCfg */
		>;
		max77779,fg_regval = /bits/ 16 <
			0x1F 0xA95A	/* VEmpty */
			0x3A 0x1002	/* SOCHold */
		>;
		max77779,fg_n_regval = /bits/ 16 <
			0xB7 0x2240	/* nConvgCfg */
			0xC8 0xC8FF	/* nThermCfg3 */
			0xC9 0xC8FF	/* nThermCfg2 */
		>;
		max77779,fg-aafv = /bits/ 32 <
			  0   95  0xf  0x00a5
			 20   90  0xf  0x0053
			 40   85  0xf  0x0053
			 60   80  0xf  0x0053
			 80   75  0xf  0x0053
			100   70  0xf  0x0053
		>;
	};
};
