// SPDX-License-Identifier: GPL-2.0-only
/*
 * yogi device tree source
 *
 * Copyright 2025 Google LLC
 */

/dts-v1/;
/plugin/;

/* define board-specific  GPIO macros before other devicetrees */
#include "malibu-yogi-pinctrl.dtsi"
#include "malibu-dabears-common.dtsi"
#include "malibu-dabears-sbbm.dtsi"
#include "malibu-yogi-lsio.dtsi"
#include "malibu-yogi-common.dtsi"
#include "malibu-yogi-camera-pmic.dtsi"
#include "malibu-yogi-camera.dtsi"
#include "malibu-yogi-wingboard-charging.dtsi"

/ {
	board_id = <0x80703>;
	board_rev = <0x01010f>;
	fragment@boardbase {
		target-path = "/";
		__overlay__ {
			model = "YOGI EVT 1.1 Wingboard based on MALIBU";
			compatible = "google,malibu-yogi", "google,malibu";
		};
	};
};

