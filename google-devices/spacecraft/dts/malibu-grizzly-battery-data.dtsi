// SPDX-License-Identifier: GPL-2.0-only
/*
 * Battery device tree entries
 *
 * Copyright 2025 Google LLC
 *
 */
max77779,config {
	/* CGY4_ATL_4060_G001.ini.txt, b/467501623#comment2 */
	max77779,atl-1k {
		max77779,batt-id-kohm = <1>;
		max77779,model-version = <2>;
		max77779,fg-model = /bits/ 16 <
			0x9610 0xac80 0xb790 0xb840 0xb970 0xbb80 0xbdb0 0xbf80
			0xc250 0xc4e0 0xc9e0 0xcd00 0xd230 0xd540 0xdc80 0xe070
			0x0020 0x0120 0x1e80 0x11f0 0x0cb0 0x1350 0x1170 0x0ed0
			0x07f0 0x06f0 0x07f0 0x05f0 0x0730 0x06d0 0x04a0 0x04a0
		>;
		max77779,fg-params = /bits/ 16 <
			/* 0x00C0 */	0xc1b0	/* nnvcfg0 */
			/* 0x00B6 */	0x083b	/* nrelaxcfg */
			/* 0x009F */	0x660e	/* nLearnCFG */
			/* 0x000C */	0x4207	/* Config */
			/* 0x00AB */	0x0081	/* Config2 */
			/* 0x00BC */	0x5f00	/* nFullSOCThr */
			/* 0x00A9 */	0x07c0	/* nfullcaprep */
			/* 0x00B3 */	0x07c0	/* ndesigncap */
			/* 0x0046 */	0x0c80	/* dPacc */
			/* 0x00A5 */	0x07c0	/* nfullcapnom */
			/* 0x00C6 */	0xa55a	/* nVEmpty */
			/* 0x00A0 */	0x2a8e	/* nQRTable00 */
			/* 0x00A1 */	0x1504	/* nQRTable10 */
			/* 0x00A2 */	0x0a81	/* nQRTable20 */
			/* 0x00A3 */	0x0781	/* nQRTable30 */
			/* 0x00A6 */	0x0600	/* nRCOMP0 */
			/* 0x00A7 */	0x1a03	/* nTempCo */
			/* 0x009C */	0x027a	/* nichgterm */
			/* 0x00B2 */	0x3870	/* nmisccfg */
			/* 0x009E */	0x0400	/* nModelCfg */
			/* 0x00CA */	0xc8ff	/* nThermCfg */
			/* 0x009D */	0xcea4	/* nFilterCfg */
		>;
		max77779,fg_n_regval = /bits/ 16 <
			0xB7 0x2240	/* nConvgCfg */
		>;
		max77779,fg-aafv = /bits/ 32 <
			  0   95  0xf  0x027a
			 20   90  0xf  0x013d
			 40   85  0xf  0x013d
			 60   80  0xf  0x013d
			 80   75  0xf  0x013d
			100   70  0xf  0x013d
		>;
	};

	/* CGY4_LWN_4062_G001.ini.txt, b/467501629#comment2 */
	max77779,lwn-4k {
		max77779,batt-id-kohm = <4>;
		max77779,model-version = <2>;
		max77779,fg-model = /bits/ 16 <
			0x9610 0xacd0 0xb810 0xb910 0xbb50 0xbdb0 0xbfc0 0xc290
			0xc710 0xca40 0xcea0 0xd210 0xd5d0 0xd950 0xdd20 0xe100
			0x0020 0x01d0 0x1230 0x0b70 0x13a0 0x1480 0x0eb0 0x06d0
			0x0780 0x05f0 0x06e0 0x05e0 0x0760 0x0770 0x05e0 0x05e0
		>;
		max77779,fg-params = /bits/ 16 <
			/* 0x00C0 */	0xc1b0	/* nnvcfg0 */
			/* 0x00B6 */	0x083b	/* nrelaxcfg */
			/* 0x009F */	0x660e	/* nLearnCFG */
			/* 0x000C */	0x4207	/* Config */
			/* 0x00AB */	0x0081	/* Config2 */
			/* 0x00BC */	0x5f00	/* nFullSOCThr */
			/* 0x00A9 */	0x07dd	/* nfullcaprep */
			/* 0x00B3 */	0x07dd	/* ndesigncap */
			/* 0x0046 */	0x0c80	/* dPacc */
			/* 0x00A5 */	0x07dd	/* nfullcapnom */
			/* 0x00C6 */	0xa55a	/* nVEmpty */
			/* 0x00A0 */	0x2e13	/* nQRTable00 */
			/* 0x00A1 */	0x180c	/* nQRTable10 */
			/* 0x00A2 */	0x0d02	/* nQRTable20 */
			/* 0x00A3 */	0x0901	/* nQRTable30 */
			/* 0x00A6 */	0x0640	/* nRCOMP0 */
			/* 0x00A7 */	0x1a03	/* nTempCo */
			/* 0x009C */	0x0284	/* nichgterm */
			/* 0x00B2 */	0x3870	/* nmisccfg */
			/* 0x009E */	0x0400	/* nModelCfg */
			/* 0x00CA */	0xc8ff	/* nThermCfg */
			/* 0x009D */	0xcea4	/* nFilterCfg */
		>;
		max77779,fg_n_regval = /bits/ 16 <
			0xB7 0x2240	/* nConvgCfg */
		>;
		max77779,fg-aafv = /bits/ 32 <
			  0   95  0xf  0x0284
			 20   90  0xf  0x0142
			 40   85  0xf  0x0142
			 60   80  0xf  0x0142
			 80   75  0xf  0x0142
			100   70  0xf  0x0142
		>;
	};
};
