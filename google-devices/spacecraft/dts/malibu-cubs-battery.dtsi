// SPDX-License-Identifier: GPL-2.0-only
/*
 * Battery device tree entries specific to Kodiak Proto0
 *
 * Copyright 2025 Google LLC
 *
 */

&google_battery {
	google,chg-battery-capacity = <4840>;

	google,chg-cv-limits = <4200000 4300000 4350000 4400000 4530000>;
	google,chg-temp-limits = <0 100 200 300 420 460 480 550>;
	google,chg-cc-limits = <
		 50   50   30   30    0
		 70   70   30   30   30
		120  120  120   50   50
		120  120  120   50   50
		120  120  120   50   50
		 50   50    0    0    0
		 30    0    0    0    0
	>;

	google,chg-topoff-limits = <242 242 242 484 1452 968 0>;

	google,ttf-temp-idx = <2>;
	google,ttf-adapter = <4500>;
	google,ttf-soc-table = < 66 71 74 77 89 93  97 100>;
	google,ttf-elap-table = <32 40 50 63 79 90 173 100>;
	google,ttf-tier-table = <0 76 82>;
	google,ttf-report-max-ratio = <0>;

	google,vbatt-crit-deadline-sec = <120>;

	/* Virtual temperature compensation co-efficients y = t + (m * i * i) + c */
	google,vt-comp-m = <699>; /* 0.0699 */
	google,vt-comp-c = <(-367)>; /* -0.367 */
};

&max77779_fg {
	maxim,fg-data {
		#include "malibu-cubs-battery-data.dtsi"
	};
};
