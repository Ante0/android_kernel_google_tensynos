// SPDX-License-Identifier: GPL-2.0-only
/*
 * kodiak device tree source
 *
 * Copyright 2025 Google LLC
 */

/dts-v1/;
/plugin/;

/* define board-specific  GPIO macros before other devicetrees */
#include "malibu-kodiak-evt-pinctrl.dtsi"
#include "malibu-dabears-common.dtsi"
#include "malibu-dabears-evt-pinctrl.dtsi"
#include "malibu-dabears-sbbm.dtsi"
#include "malibu-kodiak-lsio.dtsi"
#include "malibu-kodiak-proto-evt-lsio.dtsi"
#include "malibu-kodiak-common.dtsi"
#include "malibu-dabears-camera-pmic.dtsi"
#include "malibu-kodiak-camera.dtsi"
#include "malibu-kodiak-evt1-battery.dtsi"
#include "malibu-kodiak-evt1-charging.dtsi"
#include "malibu-spacecraft-wingboard-charging.dtsi"

/ {
	board_id = <0x80403>;
	board_rev = <0x01010f>;
	fragment@boardbase {
		target-path = "/";
		__overlay__ {
			model = "KODIAK EVT 1.1 Wingboard based on MALIBU";
			compatible = "google,malibu-kodiak", "google,malibu";
		};
	};
};

&ln8411_dc {
	status = "disabled";
};

