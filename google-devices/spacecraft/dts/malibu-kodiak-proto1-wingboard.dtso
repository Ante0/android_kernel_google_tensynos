// SPDX-License-Identifier: GPL-2.0-only
/*
 * kodiak device tree source
 *
 * Copyright 2025 Google LLC
 */

/dts-v1/;
/plugin/;

/* define board-specific  GPIO macros before other devicetrees */
#include "malibu-kodiak-pinctrl.dtsi"
#include "malibu-dabears-common.dtsi"
#include "malibu-dabears-sbbm.dtsi"
#include "malibu-kodiak-proto-lsio.dtsi"
#include "malibu-kodiak-common.dtsi"
#include "malibu-dabears-camera-pmic-proto1.dtsi"
#include "malibu-kodiak-proto1-camera.dtsi"
#include "malibu-kodiak-proto1-battery.dtsi"
#include "google-base/platform/malibu-pm-quarantine.dtsi"
#include "malibu-spacecraft-wingboard-charging.dtsi"

/ {
	board_id = <0x80402>;
	board_rev = <0x01000f>;
	fragment@boardbase {
		target-path = "/";
		__overlay__ {
			model = "KODIAK Proto 1.0 Wingboard based on MALIBU";
			compatible = "google,malibu-kodiak", "google,malibu";
		};
	};
};

&ln8411_dc {
	status = "disabled";
};

