// SPDX-License-Identifier: GPL-2.0-only
/*
 * cubs device tree source
 *
 * Copyright 2025 Google LLC
 */

/dts-v1/;
/plugin/;

/* define board-specific  GPIO macros before other devicetrees */
#include "malibu-cubs-dvt-pinctrl.dtsi"
#include "malibu-dabears-common.dtsi"
#include "malibu-dabears-evt-pinctrl.dtsi"
#include "malibu-cubs-lsio.dtsi"
#include "malibu-cubs-common.dtsi"
#include "malibu-cubs-camera-pmic.dtsi"
#include "malibu-cubs-camera.dtsi"


/ {
	board_id = <0x80604>;
	board_rev = <0x010000>;
	fragment@boardbase {
		target-path = "/";
		__overlay__ {
			model = "CUBS DVT 1.0 based on MALIBU";
			compatible = "google,malibu-cubs", "google,malibu";
		};
	};
};

