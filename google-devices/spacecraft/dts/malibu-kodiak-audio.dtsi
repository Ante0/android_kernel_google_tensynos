// SPDX-License-Identifier: GPL-2.0-only
/*
 * kodiak audio device tree source
 *
 * Copyright 2025 Google LLC
 */

&aoc {
	aoc-board-cfg = "PKK4";
	aoc-board-id = <0x80402>;
	aoc-board-rev = <0x10000>;
};