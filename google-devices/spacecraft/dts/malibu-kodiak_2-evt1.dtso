// SPDX-License-Identifier: GPL-2.0-only
/*
 * kodiak device tree source
 *
 * Copyright 2025 Google LLC
 */

/dts-v1/;
/plugin/;

/* define board-specific  GPIO macros before other devicetrees */
#include "malibu-kodiak-evt-pinctrl.dtsi"
#include "malibu-dabears-common.dtsi"
#include "malibu-dabears-evt-pinctrl.dtsi"
#include "malibu-kodiak-lsio.dtsi"
#include "malibu-kodiak-common.dtsi"
#include "malibu-dabears-camera-pmic.dtsi"
#include "malibu-kodiak-camera.dtsi"
#include "malibu-kodiak-evt1-battery.dtsi"
#include "malibu-kodiak-evt1-charging.dtsi"


/ {
	board_id = <0x80403>;
	board_rev = <0x010001>;
	fragment@boardbase {
		target-path = "/";
		__overlay__ {
			model = "KODIAK EVT 1.0 based on MALIBU";
			compatible = "google,malibu-kodiak_2", "google,malibu";
		};
	};
};

