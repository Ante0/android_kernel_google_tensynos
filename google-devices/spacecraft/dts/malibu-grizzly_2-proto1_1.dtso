// SPDX-License-Identifier: GPL-2.0-only
/*
 * grizzly device tree source
 *
 * Copyright 2025 Google LLC
 */

/dts-v1/;
/plugin/;

/* define board-specific  GPIO macros before other devicetrees */
#include "malibu-grizzly-pinctrl.dtsi"
#include "malibu-dabears-common.dtsi"
#include "malibu-grizzly-proto-lsio.dtsi"
#include "malibu-grizzly-common.dtsi"
#include "malibu-dabears-camera-pmic-proto1_1.dtsi"
#include "malibu-kodiak-proto1_1-camera.dtsi"


/ {
	board_id = <0x80502>;
	board_rev = <0x010101>;
	fragment@boardbase {
		target-path = "/";
		__overlay__ {
			model = "GRIZZLY Proto 1.1 based on MALIBU";
			compatible = "google,malibu-grizzly_2", "google,malibu";
		};
	};
};

