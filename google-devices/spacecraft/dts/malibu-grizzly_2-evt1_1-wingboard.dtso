// SPDX-License-Identifier: GPL-2.0-only
/*
 * grizzly device tree source
 *
 * Copyright 2025 Google LLC
 */

/dts-v1/;
/plugin/;

/* define board-specific  GPIO macros before other devicetrees */
#include "malibu-grizzly-evt-pinctrl.dtsi"
#include "malibu-dabears-common.dtsi"
#include "malibu-dabears-evt-pinctrl.dtsi"
#include "malibu-dabears-sbbm.dtsi"
#include "malibu-grizzly-lsio.dtsi"
#include "malibu-grizzly-common.dtsi"
#include "malibu-dabears-camera-pmic.dtsi"
#include "malibu-kodiak-camera.dtsi"
#include "malibu-spacecraft-wingboard-charging.dtsi"

/ {
	board_id = <0x80503>;
	board_rev = <0x01010d>;
	fragment@boardbase {
		target-path = "/";
		__overlay__ {
			model = "GRIZZLY EVT 1.1 Wingboard based on MALIBU";
			compatible = "google,malibu-grizzly_2", "google,malibu";
		};
	};
};

