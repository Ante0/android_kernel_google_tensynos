// SPDX-License-Identifier: GPL-2.0-only

#include <dt-bindings/gpio/google,mbu.h>
#include "malibu-pinctrl-test-lsios.dtsi"
#include "malibu-pinctrl-test-aoss.dtsi"
#include "malibu-pinctrl-test-lsioe.dtsi"
#include "malibu-pinctrl-test-hsios.dtsi"
#include "malibu-pinctrl-test-gdmc.dtsi"

/ {
	fragment@pinctrl-test {
		target-path = "/";
		__overlay__ {
			pinctrl_test {
				compatible = "google,pinctrl-test";
				pinctrl-0 = <&xlsios_vsync2_default>,
					<&xlsios_spiu3_csn_ctsn_default>,
					<&xlsios_camera_mute_n_default>,
					<&xlsios_spiu3_mosi_txd_default>,
					<&xlsios_vsync5_default>,
					<&xlsios_spiu3_sclk_rtsn_default>,
					<&xlsios_spiu0_csn_ctsn_default>,
					<&xlsios_spiu1_miso_rxd_default>,
					<&xlsios_i23c0_scl_default>,
					<&xlsios_gpio14_default>,
					<&xlsios_pwm_2_default>,
					<&xlsios_spiu1_csn_ctsn_default>,
					<&xlsios_spiu3_miso_rxd_default>,
					<&xlsios_gpio3_default>,
					<&xlsios_vsync3_default>,
					<&xlsios_vsync1_default>,
					<&xlsios_pwm_1_default>,
					<&xlsios_i23c2_sda_default>,
					<&xlsios_i23c4_sda_default>,
					<&xlsios_i23c3_scl_default>,
					<&xlsios_spiu2_miso_rxd_default>,
					<&xlsios_spiu2_csn_ctsn_default>,
					<&xlsios_gpio0_default>,
					<&xlsios_vsync4_default>,
					<&xlsios_i23c4_scl_default>,
					<&xlsios_gpio11_default>,
					<&xlsios_i23c2_scl_default>,
					<&xlsios_vsync0_default>,
					<&xlsios_gpio2_default>,
					<&xlsios_gpio13_default>,
					<&xlsios_spiu1_sclk_rtsn_default>,
					<&xlsios_spiu1_mosi_txd_default>,
					<&xlsios_i23c0_sda_default>,
					<&xlsios_i23c3_sda_default>,
					<&xlsios_spiu2_mosi_txd_default>,
					<&xlsios_gpio12_default>,
					<&xlsios_vsync6_default>,
					<&xlsios_spiu2_sclk_rtsn_default>,
					<&xaoss_amb_spi0_mosi_default>,
					<&xaoss_amb_spi0_sclk_default>,
					<&xaoss_sc_i2c2_sda_default>,
					<&xaoss_cpm_gpio6_default>,
					<&xaoss_sc_gpio9_default>,
					<&xaoss_amb_uart1_txd_default>,
					<&xaoss_amb_spi3_csn_default>,
					<&xaoss_cpm_i2c0_scl_default>,
					<&xaoss_cpm_gpio4_default>,
					<&xaoss_cpm_gpi0_default>,
					<&xaoss_amb_spi0_miso_default>,
					<&xaoss_amb_uart1_ctsn_default>,
					<&xaoss_amb_uart0_rtsn_default>,
					<&xaoss_cpm_gpio5_default>,
					<&xaoss_sc_gpio3_default>,
					<&xaoss_amb_uart0_rxd_default>,
					<&xaoss_sc_i2c2_scl_default>,
					<&xaoss_amb_spi2_mosi_default>,
					<&xaoss_cpm_gpio8_default>,
					<&xaoss_amb_spi3_mosi_default>,
					<&xaoss_sc_gpio1_default>,
					<&xaoss_sc_gpio13_default>,
					<&xaoss_amb_uart0_ctsn_default>,
					<&xaoss_sc_i2c3_sda_default>,
					<&xaoss_cpm_i2c0_sda_default>,
					<&xaoss_amb_uart4_rtsn_default>,
					<&xaoss_amb_spi1_sclk_default>,
					<&xaoss_amb_spi3_sclk_default>,
					<&xaoss_amb_spi1_miso_default>,
					<&xaoss_amb_spi0_csn_default>,
					<&xaoss_amb_spi1_mosi_default>,
					<&xaoss_cpm_gpio11_default>,
					<&xaoss_amb_spi2_sclk_default>,
					<&xaoss_sc_gpio2_default>,
					<&xaoss_sc_spi6_csn_default>,
					<&xaoss_amb_uart1_rtsn_default>,
					<&xaoss_cpm_gpio12_default>,
					<&xaoss_cpm_gpi1_default>,
					<&xaoss_cpm_gpio1_default>,
					<&xaoss_amb_uart0_txd_default>,
					<&xaoss_amb_uart3_rtsn_default>,
					<&xaoss_cpm_gpio10_default>,
					<&xaoss_sc_gpio5_default>,
					<&xaoss_sc_gpio4_default>,
					<&xaoss_amb_uart3_ctsn_default>,
					<&xaoss_amb_spi2_miso_default>,
					<&xaoss_amb_spi1_csn_default>,
					<&xaoss_sc_gpio12_default>,
					<&xaoss_amb_uart1_rxd_default>,
					<&xaoss_sc_gpio11_default>,
					<&xaoss_amb_spi3_miso_default>,
					<&xaoss_amb_spi2_csn_default>,
					<&xlsioe_gpio27_default>,
					<&xlsioe_gpio37_default>,
					<&xlsioe_gpio20_default>,
					<&xlsioe_gpio29_default>,
					<&xlsioe_gpio19_default>,
					<&xlsioe_i23c5_sda_default>,
					<&xlsioe_gpio28_default>,
					<&xlsioe_gpio36_default>,
					<&xlsioe_i23c9_scl_default>,
					<&xlsioe_i23c7_scl_default>,
					<&xlsioe_i23c8_sda_default>,
					<&xlsioe_gpio25_default>,
					<&xlsioe_gpio34_default>,
					<&xlsioe_i23c5_scl_default>,
					<&xlsioe_i23c6_scl_default>,
					<&xlsioe_i23c7_sda_default>,
					<&xlsioe_i23c8_scl_default>,
					<&xlsioe_i23c9_sda_default>,
					<&xlsioe_gpio24_default>,
					<&xlsioe_i23c6_sda_default>,
					<&xlsioe_gpio33_default>,
					<&xhsios_gpio2_default>,
					<&xhsios_gpio7_default>,
					<&xhsios_gpio1_default>,
					<&xhsios_gpio0_default>,
					<&xhsios_gpio6_default>,
					<&xhsios_gpio5_default>,
					<&xhsios_gpio4_default>,
					<&xhsios_gpio3_default>,
					<&xgdmc_in_debug_1_default>,
					<&xgdmc_uart0_txd_default>;
				pinctrl-names = "sc-test-0";
				sc-gpios = <&lsios_pinctrl XLSIOS_GPIO11 GPIO_ACTIVE_LOW>,
					<&aoss_pinctrl XAOSS_CPM_GPIO6 GPIO_ACTIVE_LOW>,
					<&aoss_pinctrl XAOSS_CPM_GPIO5 GPIO_ACTIVE_LOW>,
					<&aoss_pinctrl XAOSS_CPM_GPIO8 GPIO_ACTIVE_LOW>,
					<&aoss_pinctrl XAOSS_SC_GPIO1 GPIO_ACTIVE_LOW>,
					<&aoss_pinctrl XAOSS_SC_GPIO13 GPIO_ACTIVE_LOW>,
					<&aoss_pinctrl XAOSS_SC_I2C3_SDA GPIO_ACTIVE_LOW>,
					<&aoss_pinctrl XAOSS_AMB_UART4_RTSn GPIO_ACTIVE_LOW>,
					<&aoss_pinctrl XAOSS_SC_GPIO2 GPIO_ACTIVE_LOW>,
					<&aoss_pinctrl XAOSS_CPM_GPIO1 GPIO_ACTIVE_LOW>,
					<&aoss_pinctrl XAOSS_AMB_UART3_RTSn GPIO_ACTIVE_LOW>,
					<&aoss_pinctrl XAOSS_CPM_GPIO10 GPIO_ACTIVE_LOW>,
					<&aoss_pinctrl XAOSS_SC_GPIO5 GPIO_ACTIVE_LOW>,
					<&aoss_pinctrl XAOSS_SC_GPIO4 GPIO_ACTIVE_LOW>,
					<&aoss_pinctrl XAOSS_AMB_UART3_CTSn GPIO_ACTIVE_LOW>,
					<&aoss_pinctrl XAOSS_SC_GPIO12 GPIO_ACTIVE_LOW>,
					<&aoss_pinctrl XAOSS_SC_GPIO11 GPIO_ACTIVE_LOW>,
					<&lsioe_pinctrl XLSIOE_GPIO27 GPIO_ACTIVE_LOW>,
					<&lsioe_pinctrl XLSIOE_GPIO33 GPIO_ACTIVE_LOW>,
					<&hsios_pinctrl XHSIOS_GPIO5 GPIO_ACTIVE_LOW>,
					<&gdmc_pinctrl XGDMC_UART0_TXD GPIO_ACTIVE_LOW>;
			};
		};
	};
};
