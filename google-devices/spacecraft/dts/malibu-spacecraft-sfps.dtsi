// SPDX-License-Identifier: GPL-2.0-only
/*
 * Side fingerprint device tree source
 *
 * Copyright 2025 Google LLC
 */

&odm {
	goodixfp: goodixfp {
		status = "okay";
		compatible = "goodix,fingerprint";
		interrupt-parent = <&aoss_pinctrl>;
		interrupts = <XAOSS_CPM_GPIO13 0 0>;
		spi-max-frequency = <1000000>;
		pinctrl-names = "default";
		pinctrl-0 = <&fps2aoss_int_l>;
		fp-gpio-irq = <&aoss_pinctrl XAOSS_CPM_GPIO13 GPIO_ACTIVE_LOW>;
		fp-gpio-reset = <&lsios_pinctrl XLSIOS_SPIU0_SCLK_RTSn GPIO_ACTIVE_LOW>;
	};
};
