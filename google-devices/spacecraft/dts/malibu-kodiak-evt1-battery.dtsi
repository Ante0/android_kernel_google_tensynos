// SPDX-License-Identifier: GPL-2.0-only
/*
 * Battery device tree entries specific to Kodiak EVT1
 *
 * Copyright 2025 Google LLC
 *
 */

&google_battery {
	google,aact-cv-limits = <4100000 4200000 4250000 4300000 4350000 4400000 4530000>;
	google,aact-temp-limits = <0 100 200 300 420 460 480 550>;
	google,chg-aact-ecc = <0 600>;
	google,aact-cc-limits = <
		 50   50   50   50   30   30    0
		 70   70   70   70   30   30   30
		180  150  150  150  150   50   50
		180  150  150  150  150   50   50
		150  150  150  150  150   50   50
		 50   50   50   50    0    0    0
		 30   30    0    0    0    0    0
		 50   50   50   50   30   30    0
		 70   70   70   70   30   30   30
		150  150  150  150  150   50   50
		150  150  150  150  150   50   50
		150  150  150  150  150   50   50
		 50   50   50   50    0    0    0
		 30   30    0    0    0    0    0
	>;
	google,aact-config = <1>;
};
