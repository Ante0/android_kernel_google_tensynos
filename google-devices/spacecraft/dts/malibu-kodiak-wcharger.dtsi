// SPDX-License-Identifier: GPL-2.0-only
/*
 * Wireless charger device tree for Spacecraft
 *
 * Copyright 2025 Google LLC
 *
 */

&google_wlc {
	google,project_id = /bits/ 8 <0x07>;
	vdden-gpio = <AP2QI_ENVDD(GPIO_ACTIVE_HIGH)>; /* ENVDD, AP2QI_ENVDD */
	google,wlc-bootloader = "CPS4041_BL.bin";
	google,wlc-firmware = "CPS4041_A0_07.bin";
	google,has-mpp25-wlc-dc = <1>;
	google,dploss_steps = <9000 12000 14750>;

	google,wlc-chg-configs = <&wlc_config_max77779 &wlc_config_pe26100_buck
				  &wlc_config_pe26100_cp &wlc_config_ln8411>;
};
