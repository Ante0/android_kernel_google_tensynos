// SPDX-License-Identifier: GPL-2.0-only
/*
 * kodiak device tree source
 *
 * Copyright 2025 Google LLC
 */

/dts-v1/;
/plugin/;

/* define board-specific  GPIO macros before other devicetrees */
#include "malibu-kodiak-proto1-pinctrl.dtsi"
#include "malibu-dabears-common.dtsi"
#include "malibu-kodiak-proto-evt-lsio.dtsi"
#include "malibu-kodiak-proto-lsio.dtsi"
#include "malibu-kodiak-common.dtsi"
#include "malibu-dabears-camera-pmic-proto1.dtsi"
#include "malibu-kodiak-proto1-camera.dtsi"
#include "malibu-kodiak-proto1-battery.dtsi"
#include "google-base/platform/malibu-pm-quarantine.dtsi"

/ {
	board_id = <0x80402>;
	board_rev = <0x010000>;
	fragment@boardbase {
		target-path = "/";
		__overlay__ {
			model = "KODIAK Proto 1.0 based on MALIBU";
			compatible = "google,malibu-kodiak", "google,malibu";
		};
	};
};

