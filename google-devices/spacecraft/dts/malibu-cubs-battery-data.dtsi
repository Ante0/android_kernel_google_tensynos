// SPDX-License-Identifier: GPL-2.0-only
/*
 * Battery device tree entries
 *
 * Copyright 2025 Google LLC
 *
 */
max77779,config {
	/* 4CS4_ATL_4057_G001.ini.txt, b/467506082#comment2 */
	max77779,atl-1k {
		max77779,batt-id-kohm = <1>;
		max77779,model-version = <2>;
		max77779,fg-model = /bits/ 16 <
			0x9600 0xadc0 0xb7e0 0xb900 0xba80 0xbbf0 0xbd20 0xbf90
			0xc310 0xc640 0xc9f0 0xcda0 0xd170 0xd4e0 0xd9b0 0xe000
			0x0020 0x0170 0x15e0 0x0ec0 0x0d30 0x1480 0x1470 0x0c80
			0x0800 0x06f0 0x07e0 0x05f0 0x0710 0x0760 0x0530 0x0530
		>;
		max77779,fg-params = /bits/ 16 <
			/* 0x00C0 */	0xc1b0	/* nnvcfg0 */
			/* 0x00B6 */	0x083b	/* nrelaxcfg */
			/* 0x009F */	0x660e	/* nLearnCFG */
			/* 0x000C */	0x4207	/* Config */
			/* 0x00AB */	0x0081	/* Config2 */
			/* 0x00BC */	0x5f00	/* nFullSOCThr */
			/* 0x00A9 */	0x07f3	/* nfullcaprep */
			/* 0x00B3 */	0x07f3	/* ndesigncap */
			/* 0x0046 */	0x0c80	/* dPacc */
			/* 0x00A5 */	0x07f3	/* nfullcapnom */
			/* 0x00C6 */	0xa55a	/* nVEmpty */
			/* 0x00A0 */	0x3807	/* nQRTable00 */
			/* 0x00A1 */	0x1900	/* nQRTable10 */
			/* 0x00A2 */	0x0980	/* nQRTable20 */
			/* 0x00A3 */	0x0580	/* nQRTable30 */
			/* 0x00A6 */	0x0600	/* nRCOMP0 */
			/* 0x00A7 */	0x1a03	/* nTempCo */
			/* 0x009C */	0x028b	/* nichgterm */
			/* 0x00B2 */	0x3870	/* nmisccfg */
			/* 0x009E */	0x0400	/* nModelCfg */
			/* 0x00CA */	0xc8ff	/* nThermCfg */
			/* 0x009D */	0xcea4	/* nFilterCfg */
		>;
		max77779,fg_n_regval = /bits/ 16 <
			0xB7 0x2240	/* nConvgCfg */
		>;
		max77779,fg-aafv = /bits/ 32 <
			  0   95  0xf  0x028b
			 20   90  0xf  0x0145
			 40   85  0xf  0x0145
			 60   80  0xf  0x0145
			 80   75  0xf  0x0145
			100   70  0xf  0x0145
		>;
	};

	/* 4CS4_LWN_3985_G001.ini.txt, b/467504871#comment2 */
	max77779,lwn-4k {
		max77779,batt-id-kohm = <4>;
		max77779,model-version = <2>;
		max77779,fg-model = /bits/ 16 <
			0x9610 0xad60 0xb760 0xb9b0 0xbc30 0xbd70 0xbf20 0xc170
			0xc2a0 0xc5c0 0xcb70 0xcfc0 0xd340 0xd870 0xdc50 0xe040
			0x0020 0x0180 0x0df0 0x0d00 0x16f0 0x1450 0x0f90 0x0bf0
			0x07d0 0x06f0 0x05e0 0x06c0 0x0680 0x0830 0x0620 0x0620
		>;
		max77779,fg-params = /bits/ 16 <
			/* 0x00C0 */	0xc1b0	/* nnvcfg0 */
			/* 0x00B6 */	0x083b	/* nrelaxcfg */
			/* 0x009F */	0x660e	/* nLearnCFG */
			/* 0x000C */	0x4207	/* Config */
			/* 0x00AB */	0x0081	/* Config2 */
			/* 0x00BC */	0x5f00	/* nFullSOCThr */
			/* 0x00A9 */	0x080b	/* nfullcaprep */
			/* 0x00B3 */	0x080b	/* ndesigncap */
			/* 0x0046 */	0x0c80	/* dPacc */
			/* 0x00A5 */	0x080b	/* nfullcapnom */
			/* 0x00C6 */	0xa55a	/* nVEmpty */
			/* 0x00A0 */	0x3908	/* nQRTable00 */
			/* 0x00A1 */	0x1a05	/* nQRTable10 */
			/* 0x00A2 */	0x0a80	/* nQRTable20 */
			/* 0x00A3 */	0x0780	/* nQRTable30 */
			/* 0x00A6 */	0x0690	/* nRCOMP0 */
			/* 0x00A7 */	0x1c02	/* nTempCo */
			/* 0x009C */	0x0292	/* nichgterm */
			/* 0x00B2 */	0x3870	/* nmisccfg */
			/* 0x009E */	0x0400	/* nModelCfg */
			/* 0x00CA */	0xc8ff	/* nThermCfg */
			/* 0x009D */	0xcea4	/* nFilterCfg */
		>;
		max77779,fg_n_regval = /bits/ 16 <
			0xB7 0x2240	/* nConvgCfg */
		>;
		max77779,fg-aafv = /bits/ 32 <
			  0   95  0xf  0x0292
			 20   90  0xf  0x0149
			 40   85  0xf  0x0149
			 60   80  0xf  0x0149
			 80   75  0xf  0x0149
			100   70  0xf  0x0149
		>;
	};
};
