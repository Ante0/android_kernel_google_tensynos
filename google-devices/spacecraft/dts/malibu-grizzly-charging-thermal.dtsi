// SPDX-License-Identifier: GPL-2.0-only
/*
 * Battery charging thermal config
 *
 * Copyright 2025 Google LLC
 *
 */

&google_cpm {
	/* thermal budgets */
	google,mdis-thermal-mitigation =
	<3710000 3571000 3443000 3297000 3162000 3040000 2918000 2810000 2703000
	 2598000 2493000 2330000 2200000 2080000 1968000 1865000 1770000 1684000
	 1595000 1506000 1444000 1382000 1351000 1320000 1273000 1225000>;
	/* PD+main-charger */
	google,mdis-out0-limits =
	<4000000 3880000 3760000 3640000 3520000 3400000 3280000 3160000 3040000
	 2920000 2800000 2680000 2560000 2440000 2320000 2200000 2080000 1960000
	 1840000 1720000 1600000 1480000 1360000 1240000 1120000 1000000>;
	/* PE26100 Buck charger */
	google,mdis-out1-limits =
	<5648000 5462080 5276160 5090240 4904320 4718400 4532480 4346560 4160640
	 3974720 3788800 3602880 3416960 3231040 3045120 2859200 2673280 2487360
	 2301440 2115520 1929600 1743680 1557760 1371840 1185920 1000000>;
	/* PE26100 CP charger */
	google,mdis-out2-limits =
	<5648000 5502080 5356160 5210240 5064320 4918400 4772480 4626560 4480640
	 4334720 4188800 4042880 3896960 3751040 3605120 3459200 3313280 3167360
	 3021440 2875520 2729600 2583680 2437760 2291840 2145920 2000000>;
};

&google_wlc {
	mpp-mdis-max77779 = <15000000 14543440 14086880 13630320 13173760 12717200 12260640
			     11804080 11347520 10890960 10434400 9977840 9521280  9064720
			     8608160 8151600 7695040 7238480 6781920 6325360 5868800
			     5412240 4955680 4499120 4042560 3586000>;
	mpp-mdis-pe26100-cp = <15000000 14543440 14086880 13630320 13173760 12717200 12260640
			       11804080 11347520 10890960 10434400 9977840 9521280 9064720
			       8608160 8151600 7695040 7238480 6781920 6325360 5868800
			       5412240 4955680 4499120 4042560 3586000>;
	mpp-mdis-pe26100-buck = <20000000 19265600 18531200 17796800 17062400 16328000 15593600
				 14859200 14124800 13390400 12656000 11921600 11187200 10452800
				 9718400 8984000 8249600 7515200 6780800 6046400 5312000
				 4577600 3843200 3108800 2374400 1640000>;
};
