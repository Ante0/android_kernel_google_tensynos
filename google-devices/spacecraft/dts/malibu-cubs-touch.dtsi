// SPDX-License-Identifier: GPL-2.0-only OR BSD-3-Clause
/*
 * cubs touch device tree source
 *
 * Copyright 2025 Google LLC
 */

#include "google-base/platform/malibu-platform-touch.dtsi"
#include "google-base/malibu-synaptics-touch.dtsi"

&spitouch {
	status = "okay";

	synaptics,firmware_names = "synaptics_4cs4.img",
		"synaptics_4cs4_ba.img", "synaptics_4cs4_bb.img";
	synaptics,metadata-enabled;
	synaptics,panel_id_map = <0x65002520 2
				0x65004130 2>;
	synaptics,panel_map = <&google_gs_dcsda 0
				&google_gs_dcsdb 1>;
	synaptics,pixels-per-mm = <17>;
	synaptics,test_algo = <0 1 1>;

	goog,channel-num = /bits/ 16 <16 36>;
	goog,display-resolution = /bits/ 16 <1080 2424>;
	//goog,init-mf-mode = <4>;
	goog,late-sense-on-enabled;
	goog,lptw-suppress-coords-enabled;
	goog,lptw-tracking-area = <390 690 1629 1929>;
	goog,manual-heatmap-from-irq;
	goog,panel_map = <&google_gs_dcsda 0>, <&google_gs_dcsdb 1>;
	goog,offload-caps-data-types = /bits/ 16 <0x1F>;
	goog,offload-caps-scan-types = /bits/ 16 <0xC0>;
	goog,offload-caps-context-channel-types = /bits/ 16 <0x0500>;
	goog,offload-caps-coord-filter;
	goog,offload-enabled;
	goog,reset-after-selftest;
	goog,timestamp-correction-enabled;
	goog,touch_offload_ids = /bits/ 8 <0x26 0x10 0x10 0x30 0x26 0x10 0x10 0x10>;
	goog,touch-sim-enabled;
	goog,v4l2-enabled;
	goog,tbn-enabled;

	vdd-supply = <&ldo_27s_reg>;
	avdd-supply = <&ldo_26s_reg>;

};

&tbn {
	/* Panel Settings */
	tbn,panel_setting_version = /bits/ 8 <1>;
	tbn,gesture_type = /bits/ 8 <3>;
	tbn,panel_height_pixel = /bits/ 16 <2424>;
	tbn,panel_height_mm = /bits/ 16 <146>;
	tbn,lptw_support_int2 = /bits/ 8 <1>;

	/* STTW Configs */
	tbn,sttw_version = /bits/ 8 <1>;
	tbn,sttw_min_x = /bits/ 16 <910>;
	tbn,sttw_max_x = /bits/ 16 <9890>;
	tbn,sttw_min_y = /bits/ 16 <1790>;
	tbn,sttw_max_y = /bits/ 16 <22450>;
	tbn,sttw_min_frame_count = /bits/ 8 <3>;
	tbn,sttw_max_frame_count = /bits/ 8 <31>;
	tbn,sttw_motion_tolerance = /bits/ 16 <2550>;
	tbn,sttw_max_touch_size = /bits/ 8 <40>;

	/* LPTW Configs */
	tbn,lptw_version = /bits/ 8 <1>;
	tbn,lptw_min_x = /bits/ 16 <3400>;
	tbn,lptw_max_x = /bits/ 16 <7400>;
	tbn,lptw_min_y = /bits/ 16 <15790>;
	tbn,lptw_max_y = /bits/ 16 <19790>;
	tbn,lptw_min_frame_count = /bits/ 8 <1>;
	tbn,lptw_max_touch_size = /bits/ 8 <40>;
	tbn,lptw_marginal_min_x = /bits/ 16 <3400>;
	tbn,lptw_marginal_max_x = /bits/ 16 <7400>;
	tbn,lptw_marginal_min_y = /bits/ 16 <15790>;
	tbn,lptw_marginal_max_y = /bits/ 16 <19790>;
	tbn,lptw_monitor_channel_min_tx = /bits/ 8 <6>;
	tbn,lptw_monitor_channel_max_tx = /bits/ 8 <9>;
	tbn,lptw_monitor_channel_min_rx = /bits/ 8 <24>;
	tbn,lptw_monitor_channel_max_rx = /bits/ 8 <27>;
	tbn,lptw_min_node_count = /bits/ 8 <8>;
	tbn,lptw_motion_tolerance_inner = /bits/ 16 <2550>;
	tbn,lptw_motion_tolerance_outer = /bits/ 16 <5450>;
	tbn,lptw_int2_assert_min_x = /bits/ 16 <4400>;
	tbn,lptw_int2_assert_max_x = /bits/ 16 <6400>;
	tbn,lptw_int2_assert_min_y = /bits/ 16 <16790>;
	tbn,lptw_int2_assert_max_y = /bits/ 16 <18790>;
	tbn,lptw_int2_deassert_min_x = /bits/ 16 <3400>;
	tbn,lptw_int2_deassert_max_x = /bits/ 16 <7400>;
	tbn,lptw_int2_deassert_min_y = /bits/ 16 <15790>;
	tbn,lptw_int2_deassert_max_y = /bits/ 16 <19790>;
};

&google_gs_dcsda {
	touch = <&spitouch>;
};

&google_gs_dcsdb {
	touch = <&spitouch>;
};

&spitouch {
	synaptics,pt05_high_name = "synaptics,pt05_high", "synaptics,pt05_high_b",
		"synaptics,pt05_high_b";
	synaptics,pt05_low_name = "synaptics,pt05_low", "synaptics,pt05_low_b",
		"synaptics,pt05_low_b";
	synaptics,pt05_gap_x_name = "synaptics,pt05_gap_x", "synaptics,pt05_gap_x_b",
		"synaptics,pt05_gap_x_b";
	synaptics,pt05_gap_y_name = "synaptics,pt05_gap_y", "synaptics,pt05_gap_y_b",
		"synaptics,pt05_gap_y_b";
	synaptics,pt0a_high_name = "synaptics,pt0a_high", "synaptics,pt0a_high_b",
		"synaptics,pt0a_high_b";
	synaptics,pt0a_low_name = "synaptics,pt0a_low", "synaptics,pt0a_low_b",
		"synaptics,pt0a_low_b";
	synaptics,pt10_high_name = "synaptics,pt10_high", "synaptics,pt10_high_b",
		"synaptics,pt10_high_b";
	synaptics,pt10_low_name = "synaptics,pt10_low", "synaptics,pt10_low_b",
		"synaptics,pt10_low_b";
	synaptics,pt10_gap_x_name = "synaptics,pt10_gap_x", "synaptics,pt10_gap_x_b",
		"synaptics,pt10_gap_x_b";
	synaptics,pt10_gap_y_name = "synaptics,pt10_gap_y", "synaptics,pt10_gap_y_b",
		"synaptics,pt10_gap_y_b";
	synaptics,pt11_high_name = "synaptics,pt11_high", "synaptics,pt11_high_b",
		"synaptics,pt11_high_b";
	synaptics,pt11_low_name = "synaptics,pt11_low", "synaptics,pt11_low_b",
		"synaptics,pt11_low_b";
	synaptics,pt12_high_name = "synaptics,pt12_high", "synaptics,pt12_high_b",
		"synaptics,pt12_high_b";
	synaptics,pt12_low_name = "synaptics,pt12_low", "synaptics,pt12_low_b",
		"synaptics,pt12_low_b";
	synaptics,pt16_high_name = "synaptics,pt16_high", "synaptics,pt16_high_b",
		"synaptics,pt16_high_b";
	synaptics,pt16_low_name = "synaptics,pt16_low", "synaptics,pt16_low_b",
		"synaptics,pt16_low_b";
	synaptics,pt1a_low_name = "synaptics,pt1a_low", "synaptics,pt1a_low_b",
		"synaptics,pt1a_low_b";

	synaptics,pt05_high = /bits/ 16 <
490 550 590 590 590 590 590 590 590 590 590 590 590 590 590 590 590 590 575 575 575 575 575 575 575 575 575 575 575 575 575 575 575 575 550 260
490 590 590 590 590 590 590 590 590 590 590 590 590 590 590 590 590 590 590 590 590 590 590 590 590 590 590 590 590 590 590 590 590 590 590 550
590 590 590 590 590 590 590 590 590 590 590 590 590 590 590 590 590 590 590 590 590 590 590 590 590 590 590 590 590 590 590 590 590 590 590 660
590 590 590 590 590 590 590 590 590 590 590 590 590 590 590 590 590 590 590 590 590 590 590 590 590 590 590 590 590 590 590 590 590 590 590 590
590 590 590 590 590 590 590 590 590 590 590 590 590 590 590 590 590 590 590 590 590 590 590 590 590 590 590 590 590 590 590 590 590 590 590 730
590 590 590 590 590 590 590 590 590 590 590 590 590 590 590 590 590 590 590 590 590 590 590 590 590 590 590 590 590 590 590 590 590 590 590 730
590 590 590 590 590 590 590 590 590 590 590 590 590 590 590 590 590 590 590 590 590 590 590 590 590 590 590 590 590 590 590 590 590 590 590 730
600 660 600 590 590 590 590 590 590 590 590 590 590 590 590 590 590 590 590 590 590 590 590 590 590 590 590 590 590 590 590 590 590 590 590 730
600 660 600 590 590 590 590 590 590 590 590 590 590 590 590 590 590 590 590 590 590 590 590 590 590 590 590 590 590 590 590 590 590 590 590 730
590 590 590 590 590 590 590 590 590 590 590 590 590 590 590 590 590 590 590 590 590 590 590 590 590 590 590 590 590 590 590 590 590 590 590 730
590 590 590 590 590 590 590 590 590 590 590 590 590 590 590 590 590 590 590 590 590 590 590 590 590 590 590 590 590 590 590 590 590 590 590 730
590 590 590 590 590 590 590 590 590 590 590 590 590 590 590 590 590 590 590 590 590 590 590 590 590 590 590 590 590 590 590 590 590 590 590 660
590 590 590 590 590 590 590 590 590 590 590 590 590 590 590 590 590 590 590 590 590 590 590 590 590 590 590 590 590 590 590 590 590 590 590 590
590 590 590 590 590 590 590 590 590 590 590 590 590 590 590 590 590 590 590 590 590 590 590 590 590 590 590 590 590 590 590 590 590 590 590 660
490 590 590 590 590 590 590 590 590 590 590 590 590 590 590 590 590 590 590 590 590 590 590 590 590 590 590 590 590 590 590 590 590 590 590 550
230 550 575 575 575 575 575 575 575 575 575 575 575 575 575 575 575 575 575 575 575 575 575 575 575 575 575 575 575 575 575 575 575 575 575 490>;
	synaptics,pt05_low = /bits/ 16 <
75 120 220 220 220 220 220 220 220 220 220 220 220 220 220 220 220 220 180 180 180 180 180 180 180 180 180 180 180 180 180 180 180 180 120 33
75 220 220 220 220 220 220 220 220 220 220 220 220 220 220 220 220 220 220 220 220 220 220 220 220 220 220 220 220 220 220 220 220 220 220 120
220 220 220 220 220 220 220 220 220 220 220 220 220 220 220 220 220 220 220 220 220 220 220 220 220 220 220 220 220 220 220 220 220 220 220 180
220 220 220 220 220 220 220 220 220 220 220 220 220 220 220 220 220 220 220 220 220 220 220 220 220 220 220 220 220 220 220 220 220 220 220 220
220 220 220 220 220 220 220 220 220 220 220 220 220 220 220 220 220 220 220 220 220 220 220 220 220 220 220 220 220 220 220 220 220 220 220 180
220 220 220 220 220 220 220 220 220 220 220 220 220 220 220 220 220 220 220 220 220 220 220 220 220 220 220 220 220 220 220 220 220 220 220 180
220 220 220 220 220 220 220 220 220 220 220 220 220 220 220 220 220 220 220 220 220 220 220 220 220 220 220 220 220 220 220 220 220 220 220 180
120 200 120 220 220 220 220 220 220 220 220 220 220 220 220 220 220 220 220 220 220 220 220 220 220 220 220 220 220 220 220 220 220 220 220 180
120 200 120 220 220 220 220 220 220 220 220 220 220 220 220 220 220 220 220 220 220 220 220 220 220 220 220 220 220 220 220 220 220 220 220 180
220 220 220 220 220 220 220 220 220 220 220 220 220 220 220 220 220 220 220 220 220 220 220 220 220 220 220 220 220 220 220 220 220 220 220 180
220 220 220 220 220 220 220 220 220 220 220 220 220 220 220 220 220 220 220 220 220 220 220 220 220 220 220 220 220 220 220 220 220 220 220 180
220 220 220 220 220 220 220 220 220 220 220 220 220 220 220 220 220 220 220 220 220 220 220 220 220 220 220 220 220 220 220 220 220 220 220 180
220 220 220 220 220 220 220 220 220 220 220 220 220 220 220 220 220 220 220 220 220 220 220 220 220 220 220 220 220 220 220 220 220 220 220 220
220 220 220 220 220 220 220 220 220 220 220 220 220 220 220 220 220 220 220 220 220 220 220 220 220 220 220 220 220 220 220 220 220 220 220 180
75 220 220 220 220 220 220 220 220 220 220 220 220 220 220 220 220 220 220 220 220 220 220 220 220 220 220 220 220 220 220 220 220 220 220 120
13 120 180 180 180 180 180 180 180 180 180 180 180 180 180 180 180 180 180 180 180 180 180 180 180 180 180 180 180 180 180 180 180 180 180 75>;
	synaptics,pt05_gap_x = /bits/ 16 <
69 46 39 39 39 39 39 39 39 39 39 39 39 39 39 39 39 39 39 27 39 39 39 39 39 39 39 39 39 39 39 39 39 39 96 96
54 27 27 27 27 27 27 27 27 27 27 27 27 27 27 27 27 27 27 27 27 27 27 27 27 27 27 27 27 27 27 27 27 27 99 54
27 27 27 27 27 27 27 27 27 27 27 27 27 27 27 27 27 27 27 27 27 27 27 27 27 27 27 27 27 27 27 27 27 27 39 27
27 27 27 27 27 27 27 27 27 27 27 27 27 27 27 27 27 27 27 27 27 27 27 27 27 27 27 27 27 27 27 27 27 27 39 27
27 27 27 27 27 27 27 27 27 27 27 27 27 27 27 27 27 27 27 27 27 27 27 27 27 27 27 27 27 27 27 27 27 27 39 27
27 27 27 27 27 27 27 27 27 27 27 27 27 27 27 27 27 27 27 27 27 27 27 27 27 27 27 27 27 27 27 27 27 27 39 27
39 46 39 27 27 27 27 27 27 27 27 27 27 27 27 27 27 27 27 27 27 27 27 27 27 27 27 27 27 27 27 27 27 27 46 27
54 54 39 27 27 27 27 27 27 27 27 27 27 27 27 27 27 27 27 27 27 27 27 27 27 27 27 27 27 27 27 27 27 27 99 27
54 54 39 27 27 27 27 27 27 27 27 27 27 27 27 27 27 27 27 27 27 27 27 27 27 27 27 27 27 27 27 27 27 27 99 27
27 27 27 27 27 27 27 27 27 27 27 27 27 27 27 27 27 27 27 27 27 27 27 27 27 27 27 27 27 27 27 27 27 27 46 27
27 27 27 27 27 27 27 27 27 27 27 27 27 27 27 27 27 27 27 27 27 27 27 27 27 27 27 27 27 27 27 27 27 27 46 27
27 27 27 27 27 27 27 27 27 27 27 27 27 27 27 27 27 27 27 27 27 27 27 27 27 27 27 27 27 27 27 27 27 27 39 27
27 27 27 27 27 27 27 27 27 27 27 27 27 27 27 27 27 27 27 27 27 27 27 27 27 27 27 27 27 27 27 27 27 27 39 27
54 27 27 27 27 27 27 27 27 27 27 27 27 27 27 27 27 27 27 27 27 27 27 27 27 27 27 27 27 27 27 27 27 27 39 54
99 46 39 39 39 39 39 39 39 39 39 39 39 39 39 39 39 39 39 27 39 39 39 39 39 39 39 39 39 39 39 39 39 39 46 46
99 39 27 27 27 27 27 27 27 27 27 27 27 27 27 27 27 27 27 27 27 27 27 27 27 27 27 27 27 27 27 27 27 27 54 27>;
	synaptics,pt05_gap_y = /bits/ 16 <
115 80 65 65 65 65 65 65 65 65 65 65 65 65 65 65 65 65 65 65 65 65 65 65 65 65 65 65 65 65 65 65 65 65 125 125
95 65 62 62 62 62 62 62 62 62 62 62 62 62 62 62 62 62 62 62 62 62 62 62 62 62 62 62 62 62 62 62 62 62 95 95
65 65 62 62 62 62 62 62 62 62 62 62 62 62 62 62 62 62 62 62 62 62 62 62 62 62 62 62 62 62 62 62 62 62 80 65
65 65 62 62 62 62 62 62 62 62 62 62 62 62 62 62 62 62 62 62 62 62 62 62 62 62 62 62 62 62 62 62 62 62 80 65
65 65 62 62 62 62 62 62 62 62 62 62 62 62 62 62 62 62 62 62 62 62 62 62 62 62 62 62 62 62 62 62 62 62 80 65
65 65 62 62 62 62 62 62 62 62 62 62 62 62 62 62 62 62 62 62 62 62 62 62 62 62 62 62 62 62 62 62 62 62 80 65
65 80 62 62 62 62 62 62 62 62 62 62 62 62 62 62 62 62 62 62 62 62 62 62 62 62 62 62 62 62 62 62 62 62 80 65
80 80 62 62 62 62 62 62 62 62 62 62 62 62 62 62 62 62 62 62 62 62 62 62 62 62 62 62 62 62 62 62 62 62 80 65
80 80 62 62 62 62 62 62 62 62 62 62 62 62 62 62 62 62 62 62 62 62 62 62 62 62 62 62 62 62 62 62 62 62 80 65
65 65 62 62 62 62 62 62 62 62 62 62 62 62 62 62 62 62 62 62 62 62 62 62 62 62 62 62 62 62 62 62 62 62 80 65
65 65 62 62 62 62 62 62 62 62 62 62 62 62 62 62 62 62 62 62 62 62 62 62 62 62 62 62 62 62 62 62 62 62 80 65
65 65 62 62 62 62 62 62 62 62 62 62 62 62 62 62 62 62 62 62 62 62 62 62 62 62 62 62 62 62 62 62 62 62 80 65
65 65 62 62 62 62 62 62 62 62 62 62 62 62 62 62 62 62 62 62 62 62 62 62 62 62 62 62 62 62 62 62 62 62 80 65
80 65 62 62 62 62 62 62 62 62 62 62 62 62 62 62 62 62 62 62 62 62 62 62 62 62 62 62 62 62 62 62 62 62 80 80
128 80 65 65 65 65 65 65 65 65 65 65 65 65 65 65 65 65 65 65 65 65 65 65 65 65 65 65 65 65 65 65 65 65 80 95
128 80 62 62 62 62 62 62 62 62 62 62 62 62 62 62 62 62 62 62 62 62 62 62 62 62 62 62 62 62 62 62 62 80 95 65>;

	synaptics,pt0a_high = /bits/ 16 <
40 40 40 40 40 40 40 40 40 40 40 40 40 40 40 40 40 40 40 40 40 40 40 40 40 40 40 40 40 40 40 40 40 40 40 40
40 40 40 40 40 40 40 40 40 40 40 40 40 40 40 40 40 40 40 40 40 40 40 40 40 40 40 40 40 40 40 40 40 40 40 40
40 40 40 40 40 40 40 40 40 40 40 40 40 40 40 40 40 40 40 40 40 40 40 40 40 40 40 40 40 40 40 40 40 40 40 40
40 40 40 40 40 40 40 40 40 40 40 40 40 40 40 40 40 40 40 40 40 40 40 40 40 40 40 40 40 40 40 40 40 40 40 40
40 40 40 40 40 40 40 40 40 40 40 40 40 40 40 40 40 40 40 40 40 40 40 40 40 40 40 40 40 40 40 40 40 40 40 40
40 40 40 40 40 40 40 40 40 40 40 40 40 40 40 40 40 40 40 40 40 40 40 40 40 40 40 40 40 40 40 40 40 40 40 40
40 40 40 40 40 40 40 40 40 40 40 40 40 40 40 40 40 40 40 40 40 40 40 40 40 40 40 40 40 40 40 40 40 40 40 40
40 40 40 40 40 40 40 40 40 40 40 40 40 40 40 40 40 40 40 40 40 40 40 40 40 40 40 40 40 40 40 40 40 40 40 40
40 40 40 40 40 40 40 40 40 40 40 40 40 40 40 40 40 40 40 40 40 40 40 40 40 40 40 40 40 40 40 40 40 40 40 40
40 40 40 40 40 40 40 40 40 40 40 40 40 40 40 40 40 40 40 40 40 40 40 40 40 40 40 40 40 40 40 40 40 40 40 40
40 40 40 40 40 40 40 40 40 40 40 40 40 40 40 40 40 40 40 40 40 40 40 40 40 40 40 40 40 40 40 40 40 40 40 40
40 40 40 40 40 40 40 40 40 40 40 40 40 40 40 40 40 40 40 40 40 40 40 40 40 40 40 40 40 40 40 40 40 40 40 40
40 40 40 40 40 40 40 40 40 40 40 40 40 40 40 40 40 40 40 40 40 40 40 40 40 40 40 40 40 40 40 40 40 40 40 40
40 40 40 40 40 40 40 40 40 40 40 40 40 40 40 40 40 40 40 40 40 40 40 40 40 40 40 40 40 40 40 40 40 40 40 40
40 40 40 40 40 40 40 40 40 40 40 40 40 40 40 40 40 40 40 40 40 40 40 40 40 40 40 40 40 40 40 40 40 40 40 40
40 40 40 40 40 40 40 40 40 40 40 40 40 40 40 40 40 40 40 40 40 40 40 40 40 40 40 40 40 40 40 40 40 40 40 40>;
	synaptics,pt0a_low = /bits/ 16 <
(-40) (-40) (-40) (-40) (-40) (-40) (-40) (-40) (-40) (-40) (-40) (-40) (-40) (-40) (-40) (-40) (-40) (-40) (-40) (-40) (-40) (-40) (-40) (-40) (-40) (-40) (-40) (-40) (-40) (-40) (-40) (-40) (-40) (-40) (-40) (-40)
(-40) (-40) (-40) (-40) (-40) (-40) (-40) (-40) (-40) (-40) (-40) (-40) (-40) (-40) (-40) (-40) (-40) (-40) (-40) (-40) (-40) (-40) (-40) (-40) (-40) (-40) (-40) (-40) (-40) (-40) (-40) (-40) (-40) (-40) (-40) (-40)
(-40) (-40) (-40) (-40) (-40) (-40) (-40) (-40) (-40) (-40) (-40) (-40) (-40) (-40) (-40) (-40) (-40) (-40) (-40) (-40) (-40) (-40) (-40) (-40) (-40) (-40) (-40) (-40) (-40) (-40) (-40) (-40) (-40) (-40) (-40) (-40)
(-40) (-40) (-40) (-40) (-40) (-40) (-40) (-40) (-40) (-40) (-40) (-40) (-40) (-40) (-40) (-40) (-40) (-40) (-40) (-40) (-40) (-40) (-40) (-40) (-40) (-40) (-40) (-40) (-40) (-40) (-40) (-40) (-40) (-40) (-40) (-40)
(-40) (-40) (-40) (-40) (-40) (-40) (-40) (-40) (-40) (-40) (-40) (-40) (-40) (-40) (-40) (-40) (-40) (-40) (-40) (-40) (-40) (-40) (-40) (-40) (-40) (-40) (-40) (-40) (-40) (-40) (-40) (-40) (-40) (-40) (-40) (-40)
(-40) (-40) (-40) (-40) (-40) (-40) (-40) (-40) (-40) (-40) (-40) (-40) (-40) (-40) (-40) (-40) (-40) (-40) (-40) (-40) (-40) (-40) (-40) (-40) (-40) (-40) (-40) (-40) (-40) (-40) (-40) (-40) (-40) (-40) (-40) (-40)
(-40) (-40) (-40) (-40) (-40) (-40) (-40) (-40) (-40) (-40) (-40) (-40) (-40) (-40) (-40) (-40) (-40) (-40) (-40) (-40) (-40) (-40) (-40) (-40) (-40) (-40) (-40) (-40) (-40) (-40) (-40) (-40) (-40) (-40) (-40) (-40)
(-40) (-40) (-40) (-40) (-40) (-40) (-40) (-40) (-40) (-40) (-40) (-40) (-40) (-40) (-40) (-40) (-40) (-40) (-40) (-40) (-40) (-40) (-40) (-40) (-40) (-40) (-40) (-40) (-40) (-40) (-40) (-40) (-40) (-40) (-40) (-40)
(-40) (-40) (-40) (-40) (-40) (-40) (-40) (-40) (-40) (-40) (-40) (-40) (-40) (-40) (-40) (-40) (-40) (-40) (-40) (-40) (-40) (-40) (-40) (-40) (-40) (-40) (-40) (-40) (-40) (-40) (-40) (-40) (-40) (-40) (-40) (-40)
(-40) (-40) (-40) (-40) (-40) (-40) (-40) (-40) (-40) (-40) (-40) (-40) (-40) (-40) (-40) (-40) (-40) (-40) (-40) (-40) (-40) (-40) (-40) (-40) (-40) (-40) (-40) (-40) (-40) (-40) (-40) (-40) (-40) (-40) (-40) (-40)
(-40) (-40) (-40) (-40) (-40) (-40) (-40) (-40) (-40) (-40) (-40) (-40) (-40) (-40) (-40) (-40) (-40) (-40) (-40) (-40) (-40) (-40) (-40) (-40) (-40) (-40) (-40) (-40) (-40) (-40) (-40) (-40) (-40) (-40) (-40) (-40)
(-40) (-40) (-40) (-40) (-40) (-40) (-40) (-40) (-40) (-40) (-40) (-40) (-40) (-40) (-40) (-40) (-40) (-40) (-40) (-40) (-40) (-40) (-40) (-40) (-40) (-40) (-40) (-40) (-40) (-40) (-40) (-40) (-40) (-40) (-40) (-40)
(-40) (-40) (-40) (-40) (-40) (-40) (-40) (-40) (-40) (-40) (-40) (-40) (-40) (-40) (-40) (-40) (-40) (-40) (-40) (-40) (-40) (-40) (-40) (-40) (-40) (-40) (-40) (-40) (-40) (-40) (-40) (-40) (-40) (-40) (-40) (-40)
(-40) (-40) (-40) (-40) (-40) (-40) (-40) (-40) (-40) (-40) (-40) (-40) (-40) (-40) (-40) (-40) (-40) (-40) (-40) (-40) (-40) (-40) (-40) (-40) (-40) (-40) (-40) (-40) (-40) (-40) (-40) (-40) (-40) (-40) (-40) (-40)
(-40) (-40) (-40) (-40) (-40) (-40) (-40) (-40) (-40) (-40) (-40) (-40) (-40) (-40) (-40) (-40) (-40) (-40) (-40) (-40) (-40) (-40) (-40) (-40) (-40) (-40) (-40) (-40) (-40) (-40) (-40) (-40) (-40) (-40) (-40) (-40)
(-40) (-40) (-40) (-40) (-40) (-40) (-40) (-40) (-40) (-40) (-40) (-40) (-40) (-40) (-40) (-40) (-40) (-40) (-40) (-40) (-40) (-40) (-40) (-40) (-40) (-40) (-40) (-40) (-40) (-40) (-40) (-40) (-40) (-40) (-40) (-40)>;

	synaptics,pt10_high =  /bits/ 16 <
25 25 25 25 25 25 25 25 25 25 25 25 25 25 25 25 25 25 25 25 25 25 25 25 25 25 25 25 25 25 25 25 25 25 25 25
25 25 25 25 25 25 25 25 25 25 25 25 25 25 25 25 25 25 25 25 25 25 25 25 25 25 25 25 25 25 25 25 25 25 25 25
25 25 25 25 25 25 25 25 25 25 25 25 25 25 25 25 25 25 25 25 25 25 25 25 25 25 25 25 25 25 25 25 25 25 25 25
25 25 25 25 25 25 25 25 25 25 25 25 25 25 25 25 25 25 25 25 25 25 25 25 25 25 25 25 25 25 25 25 25 25 25 25
25 25 25 25 25 25 25 25 25 25 25 25 25 25 25 25 25 25 25 25 25 25 25 25 25 25 25 25 25 25 25 25 25 25 25 25
25 25 25 25 25 25 25 25 25 25 25 25 25 25 25 25 25 25 25 25 25 25 25 25 25 25 25 25 25 25 25 25 25 25 25 25
25 25 25 25 25 25 25 25 25 25 25 25 25 25 25 25 25 25 25 25 25 25 25 25 25 25 25 25 25 25 25 25 25 25 25 25
25 25 25 25 25 25 25 25 25 25 25 25 25 25 25 25 25 25 25 25 25 25 25 25 25 25 25 25 25 25 25 25 25 25 25 25
25 25 25 25 25 25 25 25 25 25 25 25 25 25 25 25 25 25 25 25 25 25 25 25 25 25 25 25 25 25 25 25 25 25 25 25
25 25 25 25 25 25 25 25 25 25 25 25 25 25 25 25 25 25 25 25 25 25 25 25 25 25 25 25 25 25 25 25 25 25 25 25
25 25 25 25 25 25 25 25 25 25 25 25 25 25 25 25 25 25 25 25 25 25 25 25 25 25 25 25 25 25 25 25 25 25 25 25
25 25 25 25 25 25 25 25 25 25 25 25 25 25 25 25 25 25 25 25 25 25 25 25 25 25 25 25 25 25 25 25 25 25 25 25
25 25 25 25 25 25 25 25 25 25 25 25 25 25 25 25 25 25 25 25 25 25 25 25 25 25 25 25 25 25 25 25 25 25 25 25
25 25 25 25 25 25 25 25 25 25 25 25 25 25 25 25 25 25 25 25 25 25 25 25 25 25 25 25 25 25 25 25 25 25 25 25
25 25 25 25 25 25 25 25 25 25 25 25 25 25 25 25 25 25 25 25 25 25 25 25 25 25 25 25 25 25 25 25 25 25 25 25
25 25 25 25 25 25 25 25 25 25 25 25 25 25 25 25 25 25 25 25 25 25 25 25 25 25 25 25 25 25 25 25 25 25 25 25>;
	synaptics,pt10_low = /bits/ 16 <
0 0 0 0 0 0 0 0 0 0 0 0 0 0 0 0 0 0 0 0 0 0 0 0 0 0 0 0 0 0 0 0 0 0 0 0
0 0 0 0 0 0 0 0 0 0 0 0 0 0 0 0 0 0 0 0 0 0 0 0 0 0 0 0 0 0 0 0 0 0 0 0
0 0 0 0 0 0 0 0 0 0 0 0 0 0 0 0 0 0 0 0 0 0 0 0 0 0 0 0 0 0 0 0 0 0 0 0
0 0 0 0 0 0 0 0 0 0 0 0 0 0 0 0 0 0 0 0 0 0 0 0 0 0 0 0 0 0 0 0 0 0 0 0
0 0 0 0 0 0 0 0 0 0 0 0 0 0 0 0 0 0 0 0 0 0 0 0 0 0 0 0 0 0 0 0 0 0 0 0
0 0 0 0 0 0 0 0 0 0 0 0 0 0 0 0 0 0 0 0 0 0 0 0 0 0 0 0 0 0 0 0 0 0 0 0
0 0 0 0 0 0 0 0 0 0 0 0 0 0 0 0 0 0 0 0 0 0 0 0 0 0 0 0 0 0 0 0 0 0 0 0
0 0 0 0 0 0 0 0 0 0 0 0 0 0 0 0 0 0 0 0 0 0 0 0 0 0 0 0 0 0 0 0 0 0 0 0
0 0 0 0 0 0 0 0 0 0 0 0 0 0 0 0 0 0 0 0 0 0 0 0 0 0 0 0 0 0 0 0 0 0 0 0
0 0 0 0 0 0 0 0 0 0 0 0 0 0 0 0 0 0 0 0 0 0 0 0 0 0 0 0 0 0 0 0 0 0 0 0
0 0 0 0 0 0 0 0 0 0 0 0 0 0 0 0 0 0 0 0 0 0 0 0 0 0 0 0 0 0 0 0 0 0 0 0
0 0 0 0 0 0 0 0 0 0 0 0 0 0 0 0 0 0 0 0 0 0 0 0 0 0 0 0 0 0 0 0 0 0 0 0
0 0 0 0 0 0 0 0 0 0 0 0 0 0 0 0 0 0 0 0 0 0 0 0 0 0 0 0 0 0 0 0 0 0 0 0
0 0 0 0 0 0 0 0 0 0 0 0 0 0 0 0 0 0 0 0 0 0 0 0 0 0 0 0 0 0 0 0 0 0 0 0
0 0 0 0 0 0 0 0 0 0 0 0 0 0 0 0 0 0 0 0 0 0 0 0 0 0 0 0 0 0 0 0 0 0 0 0
0 0 0 0 0 0 0 0 0 0 0 0 0 0 0 0 0 0 0 0 0 0 0 0 0 0 0 0 0 0 0 0 0 0 0 0>;
	synaptics,pt10_gap_x = /bits/ 16 <
25 25 25 25 25 25 25 25 25 25 25 25 25 25 25 25 25 25 25 25 25 25 25 25 25 25 25 25 25 25 25 25 25 25 25 25
25 25 25 25 25 25 25 25 25 25 25 25 25 25 25 25 25 25 25 25 25 25 25 25 25 25 25 25 25 25 25 25 25 25 25 25
25 25 25 25 25 25 25 25 25 25 25 25 25 25 25 25 25 25 25 25 25 25 25 25 25 25 25 25 25 25 25 25 25 25 25 25
25 25 25 25 25 25 25 25 25 25 25 25 25 25 25 25 25 25 25 25 25 25 25 25 25 25 25 25 25 25 25 25 25 25 25 25
25 25 25 25 25 25 25 25 25 25 25 25 25 25 25 25 25 25 25 25 25 25 25 25 25 25 25 25 25 25 25 25 25 25 25 25
25 25 25 25 25 25 25 25 25 25 25 25 25 25 25 25 25 25 25 25 25 25 25 25 25 25 25 25 25 25 25 25 25 25 25 25
25 25 25 25 25 25 25 25 25 25 25 25 25 25 25 25 25 25 25 25 25 25 25 25 25 25 25 25 25 25 25 25 25 25 25 25
25 25 25 25 25 25 25 25 25 25 25 25 25 25 25 25 25 25 25 25 25 25 25 25 25 25 25 25 25 25 25 25 25 25 25 25
25 25 25 25 25 25 25 25 25 25 25 25 25 25 25 25 25 25 25 25 25 25 25 25 25 25 25 25 25 25 25 25 25 25 25 25
25 25 25 25 25 25 25 25 25 25 25 25 25 25 25 25 25 25 25 25 25 25 25 25 25 25 25 25 25 25 25 25 25 25 25 25
25 25 25 25 25 25 25 25 25 25 25 25 25 25 25 25 25 25 25 25 25 25 25 25 25 25 25 25 25 25 25 25 25 25 25 25
25 25 25 25 25 25 25 25 25 25 25 25 25 25 25 25 25 25 25 25 25 25 25 25 25 25 25 25 25 25 25 25 25 25 25 25
25 25 25 25 25 25 25 25 25 25 25 25 25 25 25 25 25 25 25 25 25 25 25 25 25 25 25 25 25 25 25 25 25 25 25 25
25 25 25 25 25 25 25 25 25 25 25 25 25 25 25 25 25 25 25 25 25 25 25 25 25 25 25 25 25 25 25 25 25 25 25 25
25 25 25 25 25 25 25 25 25 25 25 25 25 25 25 25 25 25 25 25 25 25 25 25 25 25 25 25 25 25 25 25 25 25 25 25
25 25 25 25 25 25 25 25 25 25 25 25 25 25 25 25 25 25 25 25 25 25 25 25 25 25 25 25 25 25 25 25 25 25 25 25>;
	synaptics,pt10_gap_y = /bits/ 16 <
45 45 45 45 45 45 45 45 45 45 45 45 45 45 45 45 45 45 45 45 45 45 45 45 45 45 45 45 45 45 45 45 45 45 45 45
45 45 45 45 45 45 45 45 45 45 45 45 45 45 45 45 45 45 45 45 45 45 45 45 45 45 45 45 45 45 45 45 45 45 45 45
45 45 45 45 45 45 45 45 45 45 45 45 45 45 45 45 45 45 45 45 45 45 45 45 45 45 45 45 45 45 45 45 45 45 45 45
45 45 45 45 45 45 45 45 45 45 45 45 45 45 45 45 45 45 45 45 45 45 45 45 45 45 45 45 45 45 45 45 45 45 45 45
45 45 45 45 45 45 45 45 45 45 45 45 45 45 45 45 45 45 45 45 45 45 45 45 45 45 45 45 45 45 45 45 45 45 45 45
45 45 45 45 45 45 45 45 45 45 45 45 45 45 45 45 45 45 45 45 45 45 45 45 45 45 45 45 45 45 45 45 45 45 45 45
45 45 45 45 45 45 45 45 45 45 45 45 45 45 45 45 45 45 45 45 45 45 45 45 45 45 45 45 45 45 45 45 45 45 45 45
45 45 45 45 45 45 45 45 45 45 45 45 45 45 45 45 45 45 45 45 45 45 45 45 45 45 45 45 45 45 45 45 45 45 45 45
45 45 45 45 45 45 45 45 45 45 45 45 45 45 45 45 45 45 45 45 45 45 45 45 45 45 45 45 45 45 45 45 45 45 45 45
45 45 45 45 45 45 45 45 45 45 45 45 45 45 45 45 45 45 45 45 45 45 45 45 45 45 45 45 45 45 45 45 45 45 45 45
45 45 45 45 45 45 45 45 45 45 45 45 45 45 45 45 45 45 45 45 45 45 45 45 45 45 45 45 45 45 45 45 45 45 45 45
45 45 45 45 45 45 45 45 45 45 45 45 45 45 45 45 45 45 45 45 45 45 45 45 45 45 45 45 45 45 45 45 45 45 45 45
45 45 45 45 45 45 45 45 45 45 45 45 45 45 45 45 45 45 45 45 45 45 45 45 45 45 45 45 45 45 45 45 45 45 45 45
45 45 45 45 45 45 45 45 45 45 45 45 45 45 45 45 45 45 45 45 45 45 45 45 45 45 45 45 45 45 45 45 45 45 45 45
45 45 45 45 45 45 45 45 45 45 45 45 45 45 45 45 45 45 45 45 45 45 45 45 45 45 45 45 45 45 45 45 45 45 45 45
45 45 45 45 45 45 45 45 45 45 45 45 45 45 45 45 45 45 45 45 45 45 45 45 45 45 45 45 45 45 45 45 45 45 45 45>;

	synaptics,pt11_high =  /bits/ 16 <
146 146 146 146 146 146 146 146 146 146 146 146 146 146 146 146 146 146 146 146 146 146 146 146 146 146 146 146 146 146 146 146 146 146 146 146
146 146 146 146 146 146 146 146 146 146 146 146 146 146 146 146 146 146 146 146 146 146 146 146 146 146 146 146 146 146 146 146 146 146 146 146
146 146 146 146 146 146 146 146 146 146 146 146 146 146 146 146 146 146 146 146 146 146 146 146 146 146 146 146 146 146 146 146 146 146 146 146
146 146 146 146 146 146 146 146 146 146 146 146 146 146 146 146 146 146 146 146 146 146 146 146 146 146 146 146 146 146 146 146 146 146 146 146
146 146 146 146 146 146 146 146 146 146 146 146 146 146 146 146 146 146 146 146 146 146 146 146 146 146 146 146 146 146 146 146 146 146 146 146
146 146 146 146 146 146 146 146 146 146 146 146 146 146 146 146 146 146 146 146 146 146 146 146 146 146 146 146 146 146 146 146 146 146 146 146
146 146 146 146 146 146 146 146 146 146 146 146 146 146 146 146 146 146 146 146 146 146 146 146 146 146 146 146 146 146 146 146 146 146 146 146
146 146 146 146 146 146 146 146 146 146 146 146 146 146 146 146 146 146 146 146 146 146 146 146 146 146 146 146 146 146 146 146 146 146 146 146
146 146 146 146 146 146 146 146 146 146 146 146 146 146 146 146 146 146 146 146 146 146 146 146 146 146 146 146 146 146 146 146 146 146 146 146
146 146 146 146 146 146 146 146 146 146 146 146 146 146 146 146 146 146 146 146 146 146 146 146 146 146 146 146 146 146 146 146 146 146 146 146
146 146 146 146 146 146 146 146 146 146 146 146 146 146 146 146 146 146 146 146 146 146 146 146 146 146 146 146 146 146 146 146 146 146 146 146
146 146 146 146 146 146 146 146 146 146 146 146 146 146 146 146 146 146 146 146 146 146 146 146 146 146 146 146 146 146 146 146 146 146 146 146
146 146 146 146 146 146 146 146 146 146 146 146 146 146 146 146 146 146 146 146 146 146 146 146 146 146 146 146 146 146 146 146 146 146 146 146
146 146 146 146 146 146 146 146 146 146 146 146 146 146 146 146 146 146 146 146 146 146 146 146 146 146 146 146 146 146 146 146 146 146 146 146
146 146 146 146 146 146 146 146 146 146 146 146 146 146 146 146 146 146 146 146 146 146 146 146 146 146 146 146 146 146 146 146 146 146 146 146
146 146 146 146 146 146 146 146 146 146 146 146 146 146 146 146 146 146 146 146 146 146 146 146 146 146 146 146 146 146 146 146 146 146 146 146>;
	synaptics,pt11_low = /bits/ 16 <
83 83 83 83 83 83 83 83 83 83 83 83 83 83 83 83 83 83 83 83 83 83 83 83 83 83 83 83 83 83 83 83 83 83 83 83
83 83 83 83 83 83 83 83 83 83 83 83 83 83 83 83 83 83 83 83 83 83 83 83 83 83 83 83 83 83 83 83 83 83 83 83
83 83 83 83 83 83 83 83 83 83 83 83 83 83 83 83 83 83 83 83 83 83 83 83 83 83 83 83 83 83 83 83 83 83 83 83
83 83 83 83 83 83 83 83 83 83 83 83 83 83 83 83 83 83 83 83 83 83 83 83 83 83 83 83 83 83 83 83 83 83 83 83
83 83 83 83 83 83 83 83 83 83 83 83 83 83 83 83 83 83 83 83 83 83 83 83 83 83 83 83 83 83 83 83 83 83 83 83
83 83 83 83 83 83 83 83 83 83 83 83 83 83 83 83 83 83 83 83 83 83 83 83 83 83 83 83 83 83 83 83 83 83 83 83
83 83 83 83 83 83 83 83 83 83 83 83 83 83 83 83 83 83 83 83 83 83 83 83 83 83 83 83 83 83 83 83 83 83 83 83
83 83 83 83 83 83 83 83 83 83 83 83 83 83 83 83 83 83 83 83 83 83 83 83 83 83 83 83 83 83 83 83 83 83 83 83
83 83 83 83 83 83 83 83 83 83 83 83 83 83 83 83 83 83 83 83 83 83 83 83 83 83 83 83 83 83 83 83 83 83 83 83
83 83 83 83 83 83 83 83 83 83 83 83 83 83 83 83 83 83 83 83 83 83 83 83 83 83 83 83 83 83 83 83 83 83 83 83
83 83 83 83 83 83 83 83 83 83 83 83 83 83 83 83 83 83 83 83 83 83 83 83 83 83 83 83 83 83 83 83 83 83 83 83
83 83 83 83 83 83 83 83 83 83 83 83 83 83 83 83 83 83 83 83 83 83 83 83 83 83 83 83 83 83 83 83 83 83 83 83
83 83 83 83 83 83 83 83 83 83 83 83 83 83 83 83 83 83 83 83 83 83 83 83 83 83 83 83 83 83 83 83 83 83 83 83
83 83 83 83 83 83 83 83 83 83 83 83 83 83 83 83 83 83 83 83 83 83 83 83 83 83 83 83 83 83 83 83 83 83 83 83
83 83 83 83 83 83 83 83 83 83 83 83 83 83 83 83 83 83 83 83 83 83 83 83 83 83 83 83 83 83 83 83 83 83 83 83
83 83 83 83 83 83 83 83 83 83 83 83 83 83 83 83 83 83 83 83 83 83 83 83 83 83 83 83 83 83 83 83 83 83 83 83>;

	synaptics,pt12_high = <
260000 260000 260000 260000 260000 260000 260000 260000 260000 260000 260000 260000 260000 260000 260000 260000 260000 260000 260000 260000 260000 260000 260000 260000 260000 260000 260000 260000 260000 260000 260000 260000 260000 260000 260000 260000 360000 360000 360000 360000 360000 360000 360000 360000 360000 360000 360000 360000 360000 360000 360000 360000>;
	synaptics,pt12_low = <
145000 145000 145000 145000 145000 145000 145000 145000 145000 145000 145000 145000 145000 145000 145000 145000 145000 145000 145000 145000 145000 145000 145000 145000 145000 145000 145000 145000 145000 145000 145000 145000 145000 145000 145000 145000 230000 230000 230000 230000 230000 230000 230000 230000 230000 230000 230000 230000 230000 230000 230000 230000>;

	synaptics,pt16_high =  /bits/ 16 <
330 535 610 610 610 610 610 610 610 610 610 610 610 610 610 620 620 620 610 610 610 610 610 610 610 610 610 610 610 610 610 610 610 610 535 230
470 620 620 620 620 620 620 620 620 620 620 620 620 620 620 620 620 620 620 620 620 620 620 620 620 620 620 620 620 620 620 620 620 620 620 510
620 620 620 620 620 620 620 620 620 620 620 620 620 620 620 620 620 620 620 620 620 620 620 620 620 620 620 620 620 620 620 620 620 620 620 660
620 620 620 620 620 620 620 620 620 620 620 620 620 620 620 620 620 620 620 620 620 620 620 620 620 620 620 620 620 620 620 620 620 620 620 620
620 620 620 620 620 620 620 620 620 620 620 620 620 620 620 620 620 620 620 620 620 620 620 620 620 620 620 620 620 620 620 620 620 620 620 660
620 620 620 620 620 620 620 620 620 620 620 620 620 620 620 620 620 620 620 620 620 620 620 620 620 620 620 620 620 620 620 620 620 620 620 730
620 620 620 620 620 620 620 620 620 620 620 620 620 620 620 620 620 620 620 620 620 620 620 620 620 620 620 620 620 620 620 620 620 620 620 730
580 730 580 620 620 620 620 620 620 620 620 620 620 620 620 620 620 620 620 620 620 620 620 620 620 620 620 620 620 620 620 620 620 620 620 730
580 730 580 620 620 620 620 620 620 620 620 620 620 620 620 620 620 620 620 620 620 620 620 620 620 620 620 620 620 620 620 620 620 620 620 730
620 620 620 620 620 620 620 620 620 620 620 620 620 620 620 620 620 620 620 620 620 620 620 620 620 620 620 620 620 620 620 620 620 620 620 730
620 620 620 620 620 620 620 620 620 620 620 620 620 620 620 620 620 620 620 620 620 620 620 620 620 620 620 620 620 620 620 620 620 620 620 730
620 620 620 620 620 620 620 620 620 620 620 620 620 620 620 620 620 620 620 620 620 620 620 620 620 620 620 620 620 620 620 620 620 620 620 660
620 620 620 620 620 620 620 620 620 620 620 620 620 620 620 620 620 620 620 620 620 620 620 620 620 620 620 620 620 620 620 620 620 620 620 620
620 620 620 620 620 620 620 620 620 620 620 620 620 620 620 620 620 620 620 620 620 620 620 620 620 620 620 620 620 620 620 620 620 620 620 660
470 620 620 620 620 620 620 620 620 620 620 620 620 620 620 620 620 620 620 620 620 620 620 620 620 620 620 620 620 620 620 620 620 620 620 535
185 510 610 610 610 610 610 610 610 610 610 610 610 610 610 610 610 610 610 610 610 610 610 610 610 610 610 610 610 610 610 610 610 610 610 470>;
	synaptics,pt16_low = /bits/ 16 <
100 180 210 210 210 210 210 210 210 210 210 210 210 210 210 220 220 220 210 210 210 210 210 210 210 210 210 210 210 210 210 210 210 210 180 40
150 220 220 220 220 220 220 220 220 220 220 220 220 220 220 220 220 220 220 220 220 220 220 220 220 220 220 220 220 220 220 220 220 220 220 175
220 220 220 220 220 220 220 220 220 220 220 220 220 220 220 220 220 220 220 220 220 220 220 220 220 220 220 220 220 220 220 220 220 220 220 230
220 220 220 220 220 220 220 220 220 220 220 220 220 220 220 220 220 220 220 220 220 220 220 220 220 220 220 220 220 220 220 220 220 220 220 220
220 220 220 220 220 220 220 220 220 220 220 220 220 220 220 220 220 220 220 220 220 220 220 220 220 220 220 220 220 220 220 220 220 220 220 230
220 220 220 220 220 220 220 220 220 220 220 220 220 220 220 220 220 220 220 220 220 220 220 220 220 220 220 220 220 220 220 220 220 220 220 270
220 220 220 220 220 220 220 220 220 220 220 220 220 220 220 220 220 220 220 220 220 220 220 220 220 220 220 220 220 220 220 220 220 220 220 270
180 270 180 220 220 220 220 220 220 220 220 220 220 220 220 220 220 220 220 220 220 220 220 220 220 220 220 220 220 220 220 220 220 220 220 270
180 270 180 220 220 220 220 220 220 220 220 220 220 220 220 220 220 220 220 220 220 220 220 220 220 220 220 220 220 220 220 220 220 220 220 270
220 220 220 220 220 220 220 220 220 220 220 220 220 220 220 220 220 220 220 220 220 220 220 220 220 220 220 220 220 220 220 220 220 220 220 270
220 220 220 220 220 220 220 220 220 220 220 220 220 220 220 220 220 220 220 220 220 220 220 220 220 220 220 220 220 220 220 220 220 220 220 270
220 220 220 220 220 220 220 220 220 220 220 220 220 220 220 220 220 220 220 220 220 220 220 220 220 220 220 220 220 220 220 220 220 220 220 230
220 220 220 220 220 220 220 220 220 220 220 220 220 220 220 220 220 220 220 220 220 220 220 220 220 220 220 220 220 220 220 220 220 220 220 220
220 220 220 220 220 220 220 220 220 220 220 220 220 220 220 220 220 220 220 220 220 220 220 220 220 220 220 220 220 220 220 220 220 220 220 230
150 220 220 220 220 220 220 220 220 220 220 220 220 220 220 220 220 220 220 220 220 220 220 220 220 220 220 220 220 220 220 220 220 220 220 180
30 175 210 210 210 210 210 210 210 210 210 210 210 210 210 210 210 210 210 210 210 210 210 210 210 210 210 210 210 210 210 210 210 210 210 150>;

	synaptics,pt1a_low = <
10000 10000 10000 10000 10000 10000 10000 10000 10000 10000 10000 10000 10000 10000 10000 10000 10000 10000 10000 10000 10000 10000 10000 10000 10000 10000 10000 10000 10000 10000 10000 10000 10000 10000 10000 10000 10000 10000 10000 10000 10000 10000 10000 10000 10000 10000 10000 10000 10000 10000 10000 10000>;

synaptics,pt05_high_ical = /bits/ 16 <
588 660 708 708 708 708 708 708 708 708 708 708 708 708 708 708 708 708 690 690 690 690 690 690 690 690 690 690 690 690 690 690 690 690 660 312
588 708 708 708 708 708 708 708 708 708 708 708 708 708 708 708 708 708 708 708 708 708 708 708 708 708 708 708 708 708 708 708 708 708 708 660
708 708 708 708 708 708 708 708 708 708 708 708 708 708 708 708 708 708 708 708 708 708 708 708 708 708 708 708 708 708 708 708 708 708 708 792
708 708 708 708 708 708 708 708 708 708 708 708 708 708 708 708 708 708 708 708 708 708 708 708 708 708 708 708 708 708 708 708 708 708 708 708
708 708 708 708 708 708 708 708 708 708 708 708 708 708 708 708 708 708 708 708 708 708 708 708 708 708 708 708 708 708 708 708 708 708 708 876
708 708 708 708 708 708 708 708 708 708 708 708 708 708 708 708 708 708 708 708 708 708 708 708 708 708 708 708 708 708 708 708 708 708 708 876
708 708 708 708 708 708 708 708 708 708 708 708 708 708 708 708 708 708 708 708 708 708 708 708 708 708 708 708 708 708 708 708 708 708 708 876
720 792 720 708 708 708 708 708 708 708 708 708 708 708 708 708 708 708 708 708 708 708 708 708 708 708 708 708 708 708 708 708 708 708 708 876
720 792 720 708 708 708 708 708 708 708 708 708 708 708 708 708 708 708 708 708 708 708 708 708 708 708 708 708 708 708 708 708 708 708 708 876
708 708 708 708 708 708 708 708 708 708 708 708 708 708 708 708 708 708 708 708 708 708 708 708 708 708 708 708 708 708 708 708 708 708 708 876
708 708 708 708 708 708 708 708 708 708 708 708 708 708 708 708 708 708 708 708 708 708 708 708 708 708 708 708 708 708 708 708 708 708 708 876
708 708 708 708 708 708 708 708 708 708 708 708 708 708 708 708 708 708 708 708 708 708 708 708 708 708 708 708 708 708 708 708 708 708 708 792
708 708 708 708 708 708 708 708 708 708 708 708 708 708 708 708 708 708 708 708 708 708 708 708 708 708 708 708 708 708 708 708 708 708 708 708
708 708 708 708 708 708 708 708 708 708 708 708 708 708 708 708 708 708 708 708 708 708 708 708 708 708 708 708 708 708 708 708 708 708 708 792
588 708 708 708 708 708 708 708 708 708 708 708 708 708 708 708 708 708 708 708 708 708 708 708 708 708 708 708 708 708 708 708 708 708 708 660
276 660 690 690 690 690 690 690 690 690 690 690 690 690 690 690 690 690 690 690 690 690 690 690 690 690 690 690 690 690 690 690 690 690 690 588>;
	synaptics,pt05_low_ical = /bits/ 16 <
38 60 110 110 110 110 110 110 110 110 110 110 110 110 110 110 110 110 90 90 90 90 90 90 90 90 90 90 90 90 90 90 90 90 60 17
38 110 110 110 110 110 110 110 110 110 110 110 110 110 110 110 110 110 110 110 110 110 110 110 110 110 110 110 110 110 110 110 110 110 110 60
110 110 110 110 110 110 110 110 110 110 110 110 110 110 110 110 110 110 110 110 110 110 110 110 110 110 110 110 110 110 110 110 110 110 110 90
110 110 110 110 110 110 110 110 110 110 110 110 110 110 110 110 110 110 110 110 110 110 110 110 110 110 110 110 110 110 110 110 110 110 110 110
110 110 110 110 110 110 110 110 110 110 110 110 110 110 110 110 110 110 110 110 110 110 110 110 110 110 110 110 110 110 110 110 110 110 110 90
110 110 110 110 110 110 110 110 110 110 110 110 110 110 110 110 110 110 110 110 110 110 110 110 110 110 110 110 110 110 110 110 110 110 110 90
110 110 110 110 110 110 110 110 110 110 110 110 110 110 110 110 110 110 110 110 110 110 110 110 110 110 110 110 110 110 110 110 110 110 110 90
60 100 60 110 110 110 110 110 110 110 110 110 110 110 110 110 110 110 110 110 110 110 110 110 110 110 110 110 110 110 110 110 110 110 110 90
60 100 60 110 110 110 110 110 110 110 110 110 110 110 110 110 110 110 110 110 110 110 110 110 110 110 110 110 110 110 110 110 110 110 110 90
110 110 110 110 110 110 110 110 110 110 110 110 110 110 110 110 110 110 110 110 110 110 110 110 110 110 110 110 110 110 110 110 110 110 110 90
110 110 110 110 110 110 110 110 110 110 110 110 110 110 110 110 110 110 110 110 110 110 110 110 110 110 110 110 110 110 110 110 110 110 110 90
110 110 110 110 110 110 110 110 110 110 110 110 110 110 110 110 110 110 110 110 110 110 110 110 110 110 110 110 110 110 110 110 110 110 110 90
110 110 110 110 110 110 110 110 110 110 110 110 110 110 110 110 110 110 110 110 110 110 110 110 110 110 110 110 110 110 110 110 110 110 110 110
110 110 110 110 110 110 110 110 110 110 110 110 110 110 110 110 110 110 110 110 110 110 110 110 110 110 110 110 110 110 110 110 110 110 110 90
38 110 110 110 110 110 110 110 110 110 110 110 110 110 110 110 110 110 110 110 110 110 110 110 110 110 110 110 110 110 110 110 110 110 110 60
7 60 90 90 90 90 90 90 90 90 90 90 90 90 90 90 90 90 90 90 90 90 90 90 90 90 90 90 90 90 90 90 90 90 90 38>;
	synaptics,pt05_gap_x_ical = /bits/ 16 <
79 56 49 49 49 49 49 49 49 49 49 49 49 49 49 49 49 49 49 37 49 49 49 49 49 49 49 49 49 49 49 49 49 49 106 106
64 37 37 37 37 37 37 37 37 37 37 37 37 37 37 37 37 37 37 37 37 37 37 37 37 37 37 37 37 37 37 37 37 37 109 64
37 37 37 37 37 37 37 37 37 37 37 37 37 37 37 37 37 37 37 37 37 37 37 37 37 37 37 37 37 37 37 37 37 37 49 37
37 37 37 37 37 37 37 37 37 37 37 37 37 37 37 37 37 37 37 37 37 37 37 37 37 37 37 37 37 37 37 37 37 37 49 37
37 37 37 37 37 37 37 37 37 37 37 37 37 37 37 37 37 37 37 37 37 37 37 37 37 37 37 37 37 37 37 37 37 37 49 37
37 37 37 37 37 37 37 37 37 37 37 37 37 37 37 37 37 37 37 37 37 37 37 37 37 37 37 37 37 37 37 37 37 37 49 37
49 56 49 37 37 37 37 37 37 37 37 37 37 37 37 37 37 37 37 37 37 37 37 37 37 37 37 37 37 37 37 37 37 37 56 37
64 64 49 37 37 37 37 37 37 37 37 37 37 37 37 37 37 37 37 37 37 37 37 37 37 37 37 37 37 37 37 37 37 37 109 37
64 64 49 37 37 37 37 37 37 37 37 37 37 37 37 37 37 37 37 37 37 37 37 37 37 37 37 37 37 37 37 37 37 37 109 37
37 37 37 37 37 37 37 37 37 37 37 37 37 37 37 37 37 37 37 37 37 37 37 37 37 37 37 37 37 37 37 37 37 37 56 37
37 37 37 37 37 37 37 37 37 37 37 37 37 37 37 37 37 37 37 37 37 37 37 37 37 37 37 37 37 37 37 37 37 37 56 37
37 37 37 37 37 37 37 37 37 37 37 37 37 37 37 37 37 37 37 37 37 37 37 37 37 37 37 37 37 37 37 37 37 37 49 37
37 37 37 37 37 37 37 37 37 37 37 37 37 37 37 37 37 37 37 37 37 37 37 37 37 37 37 37 37 37 37 37 37 37 49 37
64 37 37 37 37 37 37 37 37 37 37 37 37 37 37 37 37 37 37 37 37 37 37 37 37 37 37 37 37 37 37 37 37 37 49 64
109 56 49 49 49 49 49 49 49 49 49 49 49 49 49 49 49 49 49 37 49 49 49 49 49 49 49 49 49 49 49 49 49 49 56 56
109 49 37 37 37 37 37 37 37 37 37 37 37 37 37 37 37 37 37 37 37 37 37 37 37 37 37 37 37 37 37 37 37 37 64 37>;

	synaptics,pt12_high_ical = <
 312000 312000 312000 312000 312000 312000 312000 312000 312000 312000 312000 312000 312000 312000 312000 312000 312000 312000 312000 312000 312000 312000 312000 312000 312000 312000 312000 312000 312000 312000 312000 312000 312000 312000 312000 312000 432000 432000 432000 432000 432000 432000 432000 432000 432000 432000 432000 432000 432000 432000 432000 432000>;
	synaptics,pt12_low_ical = <
116000 116000 116000 116000 116000 116000 116000 116000 116000 116000 116000 116000 116000 116000 116000 116000 116000 116000 116000 116000 116000 116000 116000 116000 116000 116000 116000 116000 116000 116000 116000 116000 116000 116000 116000 116000 184000 184000 184000 184000 184000 184000 184000 184000 184000 184000 184000 184000 184000 184000 184000 184000>;

	synaptics,pt05_high_b = /bits/ 16 <
312 1041 1208 1204 1201 1195 1190 1188 1186 1183 1180 1178 1171 1171 1173 1179 1188 1209 1052 1051 1050 1051 1050 1049 1047 1049 1048 1048 1050 1044 1042 1043 1043 1038 902 217
822 1049 1046 1043 1039 1036 1034 1034 1033 1032 1032 1030 1025 1024 1024 1025 1025 1028 1022 1021 1021 1021 1021 1019 1018 1019 1018 1019 1020 1016 1015 1014 1015 1012 1012 899
938 1047 1041 1038 1035 1032 1029 1029 1029 1028 1028 1025 1021 1020 1020 1021 1020 1023 1019 1017 1018 1018 1018 1017 1015 1016 1016 1016 1017 1014 1012 1011 1012 1011 1013 1003
944 1051 1048 1042 1039 1036 1033 1033 1033 1032 1031 1029 1024 1023 1023 1025 1023 1024 1023 1022 1022 1022 1022 1020 1018 1020 1020 1019 1020 1017 1015 1015 1015 1014 1016 999
948 1055 1075 1046 1043 1039 1037 1037 1036 1035 1035 1032 1027 1027 1026 1027 1026 1027 1027 1025 1025 1025 1025 1023 1022 1022 1022 1021 1022 1019 1017 1016 1017 1016 1017 1011
943 1048 1043 1040 1037 1033 1030 1031 1030 1029 1029 1027 1022 1021 1021 1022 1021 1022 1021 1020 1021 1021 1020 1019 1017 1019 1018 1017 1018 1016 1014 1014 1014 1013 1015 1017
944 1048 1046 1045 1041 1037 1034 1034 1034 1032 1032 1030 1025 1024 1024 1025 1024 1025 1025 1023 1023 1024 1023 1021 1020 1021 1020 1020 1020 1017 1015 1015 1015 1015 1016 1025
879 657 1010 1040 1037 1033 1030 1029 1028 1028 1028 1025 1021 1020 1019 1020 1019 1020 1020 1020 1019 1019 1020 1018 1016 1018 1017 1017 1018 1015 1013 1013 1013 1012 1014 1032
880 681 1021 1044 1040 1036 1033 1033 1032 1030 1030 1028 1023 1022 1022 1023 1022 1023 1024 1022 1022 1022 1023 1021 1018 1021 1020 1019 1021 1017 1015 1015 1015 1014 1015 1043
940 1045 1043 1040 1037 1033 1031 1030 1030 1028 1028 1026 1021 1020 1019 1021 1019 1021 1022 1021 1021 1021 1021 1019 1018 1020 1019 1018 1018 1016 1014 1014 1015 1013 1015 1026
943 1051 1044 1042 1038 1035 1032 1032 1031 1030 1030 1028 1023 1022 1022 1023 1021 1023 1024 1023 1022 1023 1023 1021 1019 1021 1020 1020 1019 1017 1015 1015 1015 1014 1015 1015
941 1049 1042 1039 1036 1033 1030 1030 1029 1029 1028 1026 1021 1020 1020 1021 1020 1021 1022 1021 1021 1022 1022 1020 1018 1020 1018 1018 1018 1016 1014 1014 1014 1013 1014 1011
938 1047 1041 1037 1035 1031 1029 1029 1029 1027 1027 1025 1020 1019 1019 1020 1019 1020 1022 1021 1020 1020 1021 1019 1017 1019 1018 1018 1018 1015 1013 1013 1013 1029 1033 1003
935 1045 1038 1035 1032 1028 1026 1026 1026 1024 1025 1022 1017 1016 1016 1018 1017 1018 1021 1020 1020 1020 1020 1018 1016 1018 1018 1017 1018 1015 1013 1013 1014 1013 1014 1019
803 1042 1038 1035 1032 1028 1026 1027 1026 1025 1025 1023 1018 1017 1016 1018 1017 1019 1022 1020 1020 1021 1021 1019 1017 1019 1018 1019 1019 1016 1014 1014 1015 1014 1013 895
146 914 1090 1089 1088 1083 1081 1082 1081 1080 1080 1078 1074 1072 1072 1072 1072 1073 1140 1134 1132 1129 1128 1129 1126 1127 1124 1121 1120 1120 1117 1114 1113 1099 1001 314>;
	synaptics,pt05_low_b = /bits/ 16 <
102 542 629 627 626 623 620 619 618 617 615 613 610 610 611 614 619 630 548 548 547 548 547 546 545 547 546 546 547 544 543 543 544 541 469 71
428 628 627 625 623 621 619 620 619 618 618 617 614 614 613 614 614 616 612 612 612 612 612 611 610 611 610 610 611 609 608 607 608 607 606 468
489 627 624 622 620 619 617 617 616 616 616 614 612 611 611 612 611 613 610 610 610 610 610 609 608 609 609 609 609 607 607 606 607 606 607 522
492 630 628 625 623 621 619 619 619 618 618 617 613 613 613 614 613 614 613 612 612 612 612 611 610 611 611 611 611 609 608 608 608 608 609 521
494 632 644 627 625 623 621 621 621 620 620 619 616 615 615 615 615 616 615 614 614 614 614 613 612 613 612 612 613 611 610 609 610 609 610 527
491 628 625 623 621 619 617 618 617 616 617 615 613 612 612 612 612 613 612 611 612 612 611 611 609 610 610 610 610 609 607 607 607 607 608 530
492 628 627 626 624 622 620 620 619 619 619 617 614 614 613 614 614 614 614 613 613 613 613 612 611 612 611 611 611 609 608 608 608 608 609 534
458 342 605 623 621 619 617 617 616 616 616 614 612 611 611 611 611 611 611 611 611 611 611 610 609 610 609 610 610 608 607 607 607 607 607 538
458 354 612 625 623 621 619 619 618 617 617 616 613 613 612 613 612 613 613 613 612 613 613 612 610 612 611 611 612 609 608 608 608 608 608 544
489 626 625 623 622 619 618 617 617 616 616 615 612 611 611 612 611 612 612 612 612 612 612 611 610 611 610 610 610 609 607 608 608 607 608 534
491 630 626 624 622 620 618 619 618 617 617 616 613 613 612 613 612 613 613 613 613 613 613 612 611 612 611 611 611 609 608 608 608 607 608 529
490 628 625 623 621 619 617 617 617 616 616 615 612 611 611 612 611 612 613 612 612 612 612 611 610 611 610 610 610 609 607 607 608 607 608 527
489 627 624 622 620 618 616 617 616 615 615 614 611 610 611 611 610 611 612 612 611 611 612 610 609 610 610 610 610 608 607 607 607 617 619 522
487 626 622 620 618 616 615 615 615 614 614 612 610 609 609 610 609 610 612 611 611 611 611 610 609 610 610 610 610 608 607 607 608 607 608 531
418 625 622 620 618 616 615 615 615 614 614 613 610 609 609 610 609 611 612 611 611 612 612 610 610 610 610 611 610 609 608 608 608 608 607 466
47 476 568 568 567 565 563 564 563 562 563 562 559 558 558 559 558 559 594 591 589 589 588 589 587 587 585 584 584 584 582 580 580 573 521 103>;
	synaptics,pt05_gap_x_b = /bits/ 16 <
494 41 26 26 26 26 26 26 26 26 26 27 26 26 27 27 27 39 27 27 27 27 27 27 27 27 27 27 27 27 27 27 27 39 180
72 20 20 20 20 20 20 20 20 20 20 20 20 20 20 20 20 20 20 20 20 20 20 20 20 20 20 20 20 20 20 20 20 20 48
54 20 20 20 20 20 20 20 20 20 20 20 20 20 20 20 20 20 20 20 20 20 20 20 20 20 20 20 20 20 20 20 20 20 39
54 20 20 20 20 20 20 20 20 20 20 20 20 20 20 20 20 20 20 20 20 20 20 20 20 20 20 20 20 20 20 20 20 20 40
53 20 20 20 20 20 20 20 20 20 20 20 20 20 20 20 20 20 20 20 20 20 20 20 20 20 20 20 20 20 20 20 20 20 39
53 20 20 20 20 20 20 20 20 20 20 20 20 20 20 20 20 20 20 20 20 20 20 20 20 20 20 20 20 20 20 20 20 20 38
53 20 20 20 20 20 20 20 20 20 20 20 20 20 20 20 20 20 20 20 20 20 20 20 20 20 20 20 20 20 20 20 20 20 38
51 103 20 20 20 20 20 20 20 20 20 20 20 20 20 20 20 20 20 20 20 20 20 20 20 20 20 20 20 20 20 20 20 20 37
48 98 20 20 20 20 20 20 20 20 20 20 20 20 20 20 20 20 20 20 20 20 20 20 20 20 20 20 20 20 20 20 20 20 36
54 20 20 20 20 20 20 20 20 20 20 20 20 20 20 20 20 20 20 20 20 20 20 20 20 20 20 20 20 20 20 20 20 20 38
54 20 20 20 20 20 20 20 20 20 20 20 20 20 20 20 20 20 20 20 20 20 20 20 20 20 20 20 20 20 20 20 20 20 39
54 20 20 20 20 20 20 20 20 20 20 20 20 20 20 20 20 20 20 20 20 20 20 20 20 20 20 20 20 20 20 20 20 20 39
54 20 20 20 20 20 20 20 20 20 20 20 20 20 20 20 20 20 20 20 20 20 20 20 20 20 20 20 20 20 20 20 20 20 41
54 20 20 20 20 20 20 20 20 20 20 20 20 20 20 20 20 20 20 20 20 20 20 20 20 20 20 20 20 20 20 20 20 20 38
75 20 20 20 20 20 20 20 20 20 20 20 20 20 20 20 20 20 20 20 20 20 20 20 20 20 20 20 20 20 20 20 20 20 49
1124 45 26 26 26 26 26 26 26 26 26 26 26 26 26 26 26 32 26 26 26 26 26 26 26 26 26 26 26 26 26 26 27 35 173>;
	synaptics,pt05_gap_y_b = /bits/ 16 <
419 42 32 32 32 32 32 32 32 31 31 31 31 31 31 31 31 31 38 38 38 38 38 38 38 38 38 38 38 38 38 38 38 38 55 569
40 20 20 20 20 20 20 20 20 20 20 20 20 20 20 20 20 20 20 20 20 20 20 20 20 20 20 20 20 20 20 20 20 20 20 37
32 20 20 20 20 20 20 20 20 20 20 20 20 20 20 20 20 20 20 20 20 20 20 20 20 20 20 20 20 20 20 20 20 20 20 28
31 20 20 20 20 20 20 20 20 20 20 20 20 20 20 20 20 20 20 20 20 20 20 20 20 20 20 20 20 20 20 20 20 20 20 28
31 20 20 20 20 20 20 20 20 20 20 20 20 20 20 20 20 20 20 20 20 20 20 20 20 20 20 20 20 20 20 20 20 20 20 27
30 20 20 20 20 20 20 20 20 20 20 20 20 20 20 20 20 20 20 20 20 20 20 20 20 20 20 20 20 20 20 20 20 20 20 27
33 71 20 20 20 20 20 20 20 20 20 20 20 20 20 20 20 20 20 20 20 20 20 20 20 20 20 20 20 20 20 20 20 20 20 27
30 33 20 20 20 20 20 20 20 20 20 20 20 20 20 20 20 20 20 20 20 20 20 20 20 20 20 20 20 20 20 20 20 20 20 27
33 103 20 20 20 20 20 20 20 20 20 20 20 20 20 20 20 20 20 20 20 20 20 20 20 20 20 20 20 20 20 20 20 20 20 27
29 20 20 20 20 20 20 20 20 20 20 20 20 20 20 20 20 20 20 20 20 20 20 20 20 20 20 20 20 20 20 20 20 20 20 27
29 20 20 20 20 20 20 20 20 20 20 20 20 20 20 20 20 20 20 20 20 20 20 20 20 20 20 20 20 20 20 20 20 20 20 27
28 20 20 20 20 20 20 20 20 20 20 20 20 20 20 20 20 20 20 20 20 20 20 20 20 20 20 20 20 20 20 20 20 20 20 27
28 20 20 20 20 20 20 20 20 20 20 20 20 20 20 20 20 20 20 20 20 20 20 20 20 20 20 20 20 20 20 20 20 20 20 27
40 20 20 20 20 20 20 20 20 20 20 20 20 20 20 20 20 20 20 20 20 20 20 20 20 20 20 20 20 20 20 20 20 20 20 38
185 49 34 34 34 34 34 34 34 34 34 34 34 34 34 34 34 34 29 29 29 29 29 29 29 29 30 30 30 30 30 30 30 31 40 171>;

	synaptics,pt0a_high_b = /bits/ 16 <
40 40 40 40 40 40 40 40 40 40 40 40 40 40 40 40 40 40 40 40 40 40 40 40 40 40 40 40 40 40 40 40 40 40 40 40
40 40 40 40 40 40 40 40 40 40 40 40 40 40 40 40 40 40 40 40 40 40 40 40 40 40 40 40 40 40 40 40 40 40 40 40
40 40 40 40 40 40 40 40 40 40 40 40 40 40 40 40 40 40 40 40 40 40 40 40 40 40 40 40 40 40 40 40 40 40 40 40
40 40 40 40 40 40 40 40 40 40 40 40 40 40 40 40 40 40 40 40 40 40 40 40 40 40 40 40 40 40 40 40 40 40 40 40
40 40 40 40 40 40 40 40 40 40 40 40 40 40 40 40 40 40 40 40 40 40 40 40 40 40 40 40 40 40 40 40 40 40 40 40
40 40 40 40 40 40 40 40 40 40 40 40 40 40 40 40 40 40 40 40 40 40 40 40 40 40 40 40 40 40 40 40 40 40 40 40
40 40 40 40 40 40 40 40 40 40 40 40 40 40 40 40 40 40 40 40 40 40 40 40 40 40 40 40 40 40 40 40 40 40 40 40
40 40 40 40 40 40 40 40 40 40 40 40 40 40 40 40 40 40 40 40 40 40 40 40 40 40 40 40 40 40 40 40 40 40 40 40
40 40 40 40 40 40 40 40 40 40 40 40 40 40 40 40 40 40 40 40 40 40 40 40 40 40 40 40 40 40 40 40 40 40 40 40
40 40 40 40 40 40 40 40 40 40 40 40 40 40 40 40 40 40 40 40 40 40 40 40 40 40 40 40 40 40 40 40 40 40 40 40
40 40 40 40 40 40 40 40 40 40 40 40 40 40 40 40 40 40 40 40 40 40 40 40 40 40 40 40 40 40 40 40 40 40 40 40
40 40 40 40 40 40 40 40 40 40 40 40 40 40 40 40 40 40 40 40 40 40 40 40 40 40 40 40 40 40 40 40 40 40 40 40
40 40 40 40 40 40 40 40 40 40 40 40 40 40 40 40 40 40 40 40 40 40 40 40 40 40 40 40 40 40 40 40 40 40 40 40
40 40 40 40 40 40 40 40 40 40 40 40 40 40 40 40 40 40 40 40 40 40 40 40 40 40 40 40 40 40 40 40 40 40 40 40
40 40 40 40 40 40 40 40 40 40 40 40 40 40 40 40 40 40 40 40 40 40 40 40 40 40 40 40 40 40 40 40 40 40 40 40
40 40 40 40 40 40 40 40 40 40 40 40 40 40 40 40 40 40 40 40 40 40 40 40 40 40 40 40 40 40 40 40 40 40 40 40>;
	synaptics,pt0a_low_b = /bits/ 16 <
(-40) (-40) (-40) (-40) (-40) (-40) (-40) (-40) (-40) (-40) (-40) (-40) (-40) (-40) (-40) (-40) (-40) (-40) (-40) (-40) (-40) (-40) (-40) (-40) (-40) (-40) (-40) (-40) (-40) (-40) (-40) (-40) (-40) (-40) (-40) (-40)
(-40) (-40) (-40) (-40) (-40) (-40) (-40) (-40) (-40) (-40) (-40) (-40) (-40) (-40) (-40) (-40) (-40) (-40) (-40) (-40) (-40) (-40) (-40) (-40) (-40) (-40) (-40) (-40) (-40) (-40) (-40) (-40) (-40) (-40) (-40) (-40)
(-40) (-40) (-40) (-40) (-40) (-40) (-40) (-40) (-40) (-40) (-40) (-40) (-40) (-40) (-40) (-40) (-40) (-40) (-40) (-40) (-40) (-40) (-40) (-40) (-40) (-40) (-40) (-40) (-40) (-40) (-40) (-40) (-40) (-40) (-40) (-40)
(-40) (-40) (-40) (-40) (-40) (-40) (-40) (-40) (-40) (-40) (-40) (-40) (-40) (-40) (-40) (-40) (-40) (-40) (-40) (-40) (-40) (-40) (-40) (-40) (-40) (-40) (-40) (-40) (-40) (-40) (-40) (-40) (-40) (-40) (-40) (-40)
(-40) (-40) (-40) (-40) (-40) (-40) (-40) (-40) (-40) (-40) (-40) (-40) (-40) (-40) (-40) (-40) (-40) (-40) (-40) (-40) (-40) (-40) (-40) (-40) (-40) (-40) (-40) (-40) (-40) (-40) (-40) (-40) (-40) (-40) (-40) (-40)
(-40) (-40) (-40) (-40) (-40) (-40) (-40) (-40) (-40) (-40) (-40) (-40) (-40) (-40) (-40) (-40) (-40) (-40) (-40) (-40) (-40) (-40) (-40) (-40) (-40) (-40) (-40) (-40) (-40) (-40) (-40) (-40) (-40) (-40) (-40) (-40)
(-40) (-40) (-40) (-40) (-40) (-40) (-40) (-40) (-40) (-40) (-40) (-40) (-40) (-40) (-40) (-40) (-40) (-40) (-40) (-40) (-40) (-40) (-40) (-40) (-40) (-40) (-40) (-40) (-40) (-40) (-40) (-40) (-40) (-40) (-40) (-40)
(-40) (-40) (-40) (-40) (-40) (-40) (-40) (-40) (-40) (-40) (-40) (-40) (-40) (-40) (-40) (-40) (-40) (-40) (-40) (-40) (-40) (-40) (-40) (-40) (-40) (-40) (-40) (-40) (-40) (-40) (-40) (-40) (-40) (-40) (-40) (-40)
(-40) (-40) (-40) (-40) (-40) (-40) (-40) (-40) (-40) (-40) (-40) (-40) (-40) (-40) (-40) (-40) (-40) (-40) (-40) (-40) (-40) (-40) (-40) (-40) (-40) (-40) (-40) (-40) (-40) (-40) (-40) (-40) (-40) (-40) (-40) (-40)
(-40) (-40) (-40) (-40) (-40) (-40) (-40) (-40) (-40) (-40) (-40) (-40) (-40) (-40) (-40) (-40) (-40) (-40) (-40) (-40) (-40) (-40) (-40) (-40) (-40) (-40) (-40) (-40) (-40) (-40) (-40) (-40) (-40) (-40) (-40) (-40)
(-40) (-40) (-40) (-40) (-40) (-40) (-40) (-40) (-40) (-40) (-40) (-40) (-40) (-40) (-40) (-40) (-40) (-40) (-40) (-40) (-40) (-40) (-40) (-40) (-40) (-40) (-40) (-40) (-40) (-40) (-40) (-40) (-40) (-40) (-40) (-40)
(-40) (-40) (-40) (-40) (-40) (-40) (-40) (-40) (-40) (-40) (-40) (-40) (-40) (-40) (-40) (-40) (-40) (-40) (-40) (-40) (-40) (-40) (-40) (-40) (-40) (-40) (-40) (-40) (-40) (-40) (-40) (-40) (-40) (-40) (-40) (-40)
(-40) (-40) (-40) (-40) (-40) (-40) (-40) (-40) (-40) (-40) (-40) (-40) (-40) (-40) (-40) (-40) (-40) (-40) (-40) (-40) (-40) (-40) (-40) (-40) (-40) (-40) (-40) (-40) (-40) (-40) (-40) (-40) (-40) (-40) (-40) (-40)
(-40) (-40) (-40) (-40) (-40) (-40) (-40) (-40) (-40) (-40) (-40) (-40) (-40) (-40) (-40) (-40) (-40) (-40) (-40) (-40) (-40) (-40) (-40) (-40) (-40) (-40) (-40) (-40) (-40) (-40) (-40) (-40) (-40) (-40) (-40) (-40)
(-40) (-40) (-40) (-40) (-40) (-40) (-40) (-40) (-40) (-40) (-40) (-40) (-40) (-40) (-40) (-40) (-40) (-40) (-40) (-40) (-40) (-40) (-40) (-40) (-40) (-40) (-40) (-40) (-40) (-40) (-40) (-40) (-40) (-40) (-40) (-40)
(-40) (-40) (-40) (-40) (-40) (-40) (-40) (-40) (-40) (-40) (-40) (-40) (-40) (-40) (-40) (-40) (-40) (-40) (-40) (-40) (-40) (-40) (-40) (-40) (-40) (-40) (-40) (-40) (-40) (-40) (-40) (-40) (-40) (-40) (-40) (-40)>;

	synaptics,pt10_high_b = /bits/ 16 <
30 30 30 30 30 30 30 30 30 30 30 30 30 30 30 30 30 30 30 30 30 30 30 30 30 30 30 30 30 30 30 30 30 30 30 30
30 30 30 30 30 30 30 30 30 30 30 30 30 30 30 30 30 30 30 30 30 30 30 30 30 30 30 30 30 30 30 30 30 30 30 30
30 30 30 30 30 30 30 30 30 30 30 30 30 30 30 30 30 30 30 30 30 30 30 30 30 30 30 30 30 30 30 30 30 30 30 30
30 30 30 30 30 30 30 30 30 30 30 30 30 30 30 30 30 30 30 30 30 30 30 30 30 30 30 30 30 30 30 30 30 30 30 30
30 30 30 30 30 30 30 30 30 30 30 30 30 30 30 30 30 30 30 30 30 30 30 30 30 30 30 30 30 30 30 30 30 30 30 30
30 30 30 30 30 30 30 30 30 30 30 30 30 30 30 30 30 30 30 30 30 30 30 30 30 30 30 30 30 30 30 30 30 30 30 30
30 30 30 30 30 30 30 30 30 30 30 30 30 30 30 30 30 30 30 30 30 30 30 30 30 30 30 30 30 30 30 30 30 30 30 30
30 30 30 30 30 30 30 30 30 30 30 30 30 30 30 30 30 30 30 30 30 30 30 30 30 30 30 30 30 30 30 30 30 30 30 30
30 30 30 30 30 30 30 30 30 30 30 30 30 30 30 30 30 30 30 30 30 30 30 30 30 30 30 30 30 30 30 30 30 30 30 30
30 30 30 30 30 30 30 30 30 30 30 30 30 30 30 30 30 30 30 30 30 30 30 30 30 30 30 30 30 30 30 30 30 30 30 30
30 30 30 30 30 30 30 30 30 30 30 30 30 30 30 30 30 30 30 30 30 30 30 30 30 30 30 30 30 30 30 30 30 30 30 30
30 30 30 30 30 30 30 30 30 30 30 30 30 30 30 30 30 30 30 30 30 30 30 30 30 30 30 30 30 30 30 30 30 30 30 30
30 30 30 30 30 30 30 30 30 30 30 30 30 30 30 30 30 30 30 30 30 30 30 30 30 30 30 30 30 30 30 30 30 30 30 30
30 30 30 30 30 30 30 30 30 30 30 30 30 30 30 30 30 30 30 30 30 30 30 30 30 30 30 30 30 30 30 30 30 30 30 30
30 30 30 30 30 30 30 30 30 30 30 30 30 30 30 30 30 30 30 30 30 30 30 30 30 30 30 30 30 30 30 30 30 30 30 30
30 30 30 30 30 30 30 30 30 30 30 30 30 30 30 30 30 30 30 30 30 30 30 30 30 30 30 30 30 30 30 30 30 30 30 30>;
	synaptics,pt10_low_b = /bits/ 16 <
0 0 0 0 0 0 0 0 0 0 0 0 0 0 0 0 0 0 0 0 0 0 0 0 0 0 0 0 0 0 0 0 0 0 0 0
0 0 0 0 0 0 0 0 0 0 0 0 0 0 0 0 0 0 0 0 0 0 0 0 0 0 0 0 0 0 0 0 0 0 0 0
0 0 0 0 0 0 0 0 0 0 0 0 0 0 0 0 0 0 0 0 0 0 0 0 0 0 0 0 0 0 0 0 0 0 0 0
0 0 0 0 0 0 0 0 0 0 0 0 0 0 0 0 0 0 0 0 0 0 0 0 0 0 0 0 0 0 0 0 0 0 0 0
0 0 0 0 0 0 0 0 0 0 0 0 0 0 0 0 0 0 0 0 0 0 0 0 0 0 0 0 0 0 0 0 0 0 0 0
0 0 0 0 0 0 0 0 0 0 0 0 0 0 0 0 0 0 0 0 0 0 0 0 0 0 0 0 0 0 0 0 0 0 0 0
0 0 0 0 0 0 0 0 0 0 0 0 0 0 0 0 0 0 0 0 0 0 0 0 0 0 0 0 0 0 0 0 0 0 0 0
0 0 0 0 0 0 0 0 0 0 0 0 0 0 0 0 0 0 0 0 0 0 0 0 0 0 0 0 0 0 0 0 0 0 0 0
0 0 0 0 0 0 0 0 0 0 0 0 0 0 0 0 0 0 0 0 0 0 0 0 0 0 0 0 0 0 0 0 0 0 0 0
0 0 0 0 0 0 0 0 0 0 0 0 0 0 0 0 0 0 0 0 0 0 0 0 0 0 0 0 0 0 0 0 0 0 0 0
0 0 0 0 0 0 0 0 0 0 0 0 0 0 0 0 0 0 0 0 0 0 0 0 0 0 0 0 0 0 0 0 0 0 0 0
0 0 0 0 0 0 0 0 0 0 0 0 0 0 0 0 0 0 0 0 0 0 0 0 0 0 0 0 0 0 0 0 0 0 0 0
0 0 0 0 0 0 0 0 0 0 0 0 0 0 0 0 0 0 0 0 0 0 0 0 0 0 0 0 0 0 0 0 0 0 0 0
0 0 0 0 0 0 0 0 0 0 0 0 0 0 0 0 0 0 0 0 0 0 0 0 0 0 0 0 0 0 0 0 0 0 0 0
0 0 0 0 0 0 0 0 0 0 0 0 0 0 0 0 0 0 0 0 0 0 0 0 0 0 0 0 0 0 0 0 0 0 0 0
0 0 0 0 0 0 0 0 0 0 0 0 0 0 0 0 0 0 0 0 0 0 0 0 0 0 0 0 0 0 0 0 0 0 0 0>;
	synaptics,pt10_gap_x_b = /bits/ 16 <
30 30 30 30 30 30 30 30 30 30 30 30 30 30 30 30 30 30 30 30 30 30 30 30 30 30 30 30 30 30 30 30 30 30 30
30 30 30 30 30 30 30 30 30 30 30 30 30 30 30 30 30 30 30 30 30 30 30 30 30 30 30 30 30 30 30 30 30 30 30
30 30 30 30 30 30 30 30 30 30 30 30 30 30 30 30 30 30 30 30 30 30 30 30 30 30 30 30 30 30 30 30 30 30 30
30 30 30 30 30 30 30 30 30 30 30 30 30 30 30 30 30 30 30 30 30 30 30 30 30 30 30 30 30 30 30 30 30 30 30
30 30 30 30 30 30 30 30 30 30 30 30 30 30 30 30 30 30 30 30 30 30 30 30 30 30 30 30 30 30 30 30 30 30 30
30 30 30 30 30 30 30 30 30 30 30 30 30 30 30 30 30 30 30 30 30 30 30 30 30 30 30 30 30 30 30 30 30 30 30
30 30 30 30 30 30 30 30 30 30 30 30 30 30 30 30 30 30 30 30 30 30 30 30 30 30 30 30 30 30 30 30 30 30 30
30 30 30 30 30 30 30 30 30 30 30 30 30 30 30 30 30 30 30 30 30 30 30 30 30 30 30 30 30 30 30 30 30 30 30
30 30 30 30 30 30 30 30 30 30 30 30 30 30 30 30 30 30 30 30 30 30 30 30 30 30 30 30 30 30 30 30 30 30 30
30 30 30 30 30 30 30 30 30 30 30 30 30 30 30 30 30 30 30 30 30 30 30 30 30 30 30 30 30 30 30 30 30 30 30
30 30 30 30 30 30 30 30 30 30 30 30 30 30 30 30 30 30 30 30 30 30 30 30 30 30 30 30 30 30 30 30 30 30 30
30 30 30 30 30 30 30 30 30 30 30 30 30 30 30 30 30 30 30 30 30 30 30 30 30 30 30 30 30 30 30 30 30 30 30
30 30 30 30 30 30 30 30 30 30 30 30 30 30 30 30 30 30 30 30 30 30 30 30 30 30 30 30 30 30 30 30 30 30 30
30 30 30 30 30 30 30 30 30 30 30 30 30 30 30 30 30 30 30 30 30 30 30 30 30 30 30 30 30 30 30 30 30 30 30
30 30 30 30 30 30 30 30 30 30 30 30 30 30 30 30 30 30 30 30 30 30 30 30 30 30 30 30 30 30 30 30 30 30 30
30 30 30 30 30 30 30 30 30 30 30 30 30 30 30 30 30 30 30 30 30 30 30 30 30 30 30 30 30 30 30 30 30 30 30>;
	synaptics,pt10_gap_y_b = /bits/ 16 <
30 30 30 30 30 30 30 30 30 30 30 30 30 30 30 30 30 30 30 30 30 30 30 30 30 30 30 30 30 30 30 30 30 30 30 30
30 30 30 30 30 30 30 30 30 30 30 30 30 30 30 30 30 30 30 30 30 30 30 30 30 30 30 30 30 30 30 30 30 30 30 30
30 30 30 30 30 30 30 30 30 30 30 30 30 30 30 30 30 30 30 30 30 30 30 30 30 30 30 30 30 30 30 30 30 30 30 30
30 30 30 30 30 30 30 30 30 30 30 30 30 30 30 30 30 30 30 30 30 30 30 30 30 30 30 30 30 30 30 30 30 30 30 30
30 30 30 30 30 30 30 30 30 30 30 30 30 30 30 30 30 30 30 30 30 30 30 30 30 30 30 30 30 30 30 30 30 30 30 30
30 30 30 30 30 30 30 30 30 30 30 30 30 30 30 30 30 30 30 30 30 30 30 30 30 30 30 30 30 30 30 30 30 30 30 30
30 30 30 30 30 30 30 30 30 30 30 30 30 30 30 30 30 30 30 30 30 30 30 30 30 30 30 30 30 30 30 30 30 30 30 30
30 30 30 30 30 30 30 30 30 30 30 30 30 30 30 30 30 30 30 30 30 30 30 30 30 30 30 30 30 30 30 30 30 30 30 30
30 30 30 30 30 30 30 30 30 30 30 30 30 30 30 30 30 30 30 30 30 30 30 30 30 30 30 30 30 30 30 30 30 30 30 30
30 30 30 30 30 30 30 30 30 30 30 30 30 30 30 30 30 30 30 30 30 30 30 30 30 30 30 30 30 30 30 30 30 30 30 30
30 30 30 30 30 30 30 30 30 30 30 30 30 30 30 30 30 30 30 30 30 30 30 30 30 30 30 30 30 30 30 30 30 30 30 30
30 30 30 30 30 30 30 30 30 30 30 30 30 30 30 30 30 30 30 30 30 30 30 30 30 30 30 30 30 30 30 30 30 30 30 30
30 30 30 30 30 30 30 30 30 30 30 30 30 30 30 30 30 30 30 30 30 30 30 30 30 30 30 30 30 30 30 30 30 30 30 30
30 30 30 30 30 30 30 30 30 30 30 30 30 30 30 30 30 30 30 30 30 30 30 30 30 30 30 30 30 30 30 30 30 30 30 30
30 30 30 30 30 30 30 30 30 30 30 30 30 30 30 30 30 30 30 30 30 30 30 30 30 30 30 30 30 30 30 30 30 30 30 30>;

	synaptics,pt11_high_b = /bits/ 16 <
170 170 170 170 170 170 170 170 170 170 170 170 170 170 170 170 170 170 170 170 170 170 170 170 170 170 170 170 170 170 170 170 170 170 170 170
170 170 170 170 170 170 170 170 170 170 170 170 170 170 170 170 170 170 170 170 170 170 170 170 170 170 170 170 170 170 170 170 170 170 170 170
170 170 170 170 170 170 170 170 170 170 170 170 170 170 170 170 170 170 170 170 170 170 170 170 170 170 170 170 170 170 170 170 170 170 170 170
170 170 170 170 170 170 170 170 170 170 170 170 170 170 170 170 170 170 170 170 170 170 170 170 170 170 170 170 170 170 170 170 170 170 170 170
170 170 170 170 170 170 170 170 170 170 170 170 170 170 170 170 170 170 170 170 170 170 170 170 170 170 170 170 170 170 170 170 170 170 170 170
170 170 170 170 170 170 170 170 170 170 170 170 170 170 170 170 170 170 170 170 170 170 170 170 170 170 170 170 170 170 170 170 170 170 170 170
170 170 170 170 170 170 170 170 170 170 170 170 170 170 170 170 170 170 170 170 170 170 170 170 170 170 170 170 170 170 170 170 170 170 170 170
170 170 170 170 170 170 170 170 170 170 170 170 170 170 170 170 170 170 170 170 170 170 170 170 170 170 170 170 170 170 170 170 170 170 170 170
170 170 170 170 170 170 170 170 170 170 170 170 170 170 170 170 170 170 170 170 170 170 170 170 170 170 170 170 170 170 170 170 170 170 170 170
170 170 170 170 170 170 170 170 170 170 170 170 170 170 170 170 170 170 170 170 170 170 170 170 170 170 170 170 170 170 170 170 170 170 170 170
170 170 170 170 170 170 170 170 170 170 170 170 170 170 170 170 170 170 170 170 170 170 170 170 170 170 170 170 170 170 170 170 170 170 170 170
170 170 170 170 170 170 170 170 170 170 170 170 170 170 170 170 170 170 170 170 170 170 170 170 170 170 170 170 170 170 170 170 170 170 170 170
170 170 170 170 170 170 170 170 170 170 170 170 170 170 170 170 170 170 170 170 170 170 170 170 170 170 170 170 170 170 170 170 170 170 170 170
170 170 170 170 170 170 170 170 170 170 170 170 170 170 170 170 170 170 170 170 170 170 170 170 170 170 170 170 170 170 170 170 170 170 170 170
170 170 170 170 170 170 170 170 170 170 170 170 170 170 170 170 170 170 170 170 170 170 170 170 170 170 170 170 170 170 170 170 170 170 170 170
170 170 170 170 170 170 170 170 170 170 170 170 170 170 170 170 170 170 170 170 170 170 170 170 170 170 170 170 170 170 170 170 170 170 170 170>;
	synaptics,pt11_low_b = /bits/ 16 <
70 70 70 70 70 70 70 70 70 70 70 70 70 70 70 70 70 70 70 70 70 70 70 70 70 70 70 70 70 70 70 70 70 70 70 70
70 70 70 70 70 70 70 70 70 70 70 70 70 70 70 70 70 70 70 70 70 70 70 70 70 70 70 70 70 70 70 70 70 70 70 70
70 70 70 70 70 70 70 70 70 70 70 70 70 70 70 70 70 70 70 70 70 70 70 70 70 70 70 70 70 70 70 70 70 70 70 70
70 70 70 70 70 70 70 70 70 70 70 70 70 70 70 70 70 70 70 70 70 70 70 70 70 70 70 70 70 70 70 70 70 70 70 70
70 70 70 70 70 70 70 70 70 70 70 70 70 70 70 70 70 70 70 70 70 70 70 70 70 70 70 70 70 70 70 70 70 70 70 70
70 70 70 70 70 70 70 70 70 70 70 70 70 70 70 70 70 70 70 70 70 70 70 70 70 70 70 70 70 70 70 70 70 70 70 70
70 70 70 70 70 70 70 70 70 70 70 70 70 70 70 70 70 70 70 70 70 70 70 70 70 70 70 70 70 70 70 70 70 70 70 70
70 70 70 70 70 70 70 70 70 70 70 70 70 70 70 70 70 70 70 70 70 70 70 70 70 70 70 70 70 70 70 70 70 70 70 70
70 70 70 70 70 70 70 70 70 70 70 70 70 70 70 70 70 70 70 70 70 70 70 70 70 70 70 70 70 70 70 70 70 70 70 70
70 70 70 70 70 70 70 70 70 70 70 70 70 70 70 70 70 70 70 70 70 70 70 70 70 70 70 70 70 70 70 70 70 70 70 70
70 70 70 70 70 70 70 70 70 70 70 70 70 70 70 70 70 70 70 70 70 70 70 70 70 70 70 70 70 70 70 70 70 70 70 70
70 70 70 70 70 70 70 70 70 70 70 70 70 70 70 70 70 70 70 70 70 70 70 70 70 70 70 70 70 70 70 70 70 70 70 70
70 70 70 70 70 70 70 70 70 70 70 70 70 70 70 70 70 70 70 70 70 70 70 70 70 70 70 70 70 70 70 70 70 70 70 70
70 70 70 70 70 70 70 70 70 70 70 70 70 70 70 70 70 70 70 70 70 70 70 70 70 70 70 70 70 70 70 70 70 70 70 70
70 70 70 70 70 70 70 70 70 70 70 70 70 70 70 70 70 70 70 70 70 70 70 70 70 70 70 70 70 70 70 70 70 70 70 70
70 70 70 70 70 70 70 70 70 70 70 70 70 70 70 70 70 70 70 70 70 70 70 70 70 70 70 70 70 70 70 70 70 70 70 70>;

	synaptics,pt12_high_b = <
225952 235938 237828 236698 236233 236406 236239 235755 235359 235917 235772 235463 235632 235928 235594 235331 235246 234995 227300 226845 226511 225333 225737 225964 225248 225308 225286 224731 224289 224065 224267 224054 223767 223584 221847 204124 496166 504928 505701 505608 505836 505764 506258 506159 497653 496946 496358 496156 496407 496540 495195 486821>;
	synaptics,pt12_low_b = <
135571 141562 142696 142018 141739 141843 141743 141452 141215 141549 141462 141277 141379 141556 141356 141198 141147 140996 136379 136106 135906 135199 135441 135578 135148 135184 135171 134838 134573 134438 134559 134432 134259 134150 133107 122473 297699 302956 303420 303364 303501 303458 303754 303695 298591 298167 297814 297693 297843 297923 297116 292092>;

	synaptics,pt16_high_b = /bits/ 16 <
307 898 1040 1039 1035 1031 1026 1025 1023 1020 1018 1016 1011 1010 1015 1017 1024 1042 908 908 907 910 909 907 908 908 907 906 908 905 903 903 903 900 782 217
716 1041 1037 1034 1030 1027 1025 1025 1025 1022 1023 1023 1017 1016 1019 1017 1016 1018 1014 1014 1012 1015 1014 1012 1013 1013 1012 1010 1013 1010 1008 1007 1008 1007 1005 785
818 1039 1032 1029 1026 1022 1021 1020 1020 1018 1020 1018 1013 1012 1014 1013 1011 1013 1011 1010 1008 1011 1011 1009 1009 1009 1008 1006 1009 1006 1004 1003 1004 1004 1004 871
824 1046 1042 1036 1033 1029 1027 1027 1027 1025 1026 1025 1019 1018 1020 1019 1017 1018 1019 1018 1016 1019 1019 1017 1017 1017 1016 1015 1018 1015 1012 1012 1013 1013 1013 874
825 1048 1067 1038 1034 1031 1029 1029 1029 1027 1027 1026 1021 1020 1023 1020 1019 1020 1020 1020 1018 1021 1020 1018 1019 1018 1018 1016 1019 1016 1014 1013 1014 1013 1014 884
823 1044 1037 1034 1031 1027 1025 1025 1025 1023 1024 1023 1018 1016 1019 1017 1015 1015 1017 1016 1014 1017 1016 1014 1015 1014 1014 1012 1014 1012 1009 1009 1009 1009 1010 887
825 1044 1041 1040 1036 1032 1030 1029 1029 1027 1028 1027 1022 1020 1022 1021 1020 1020 1021 1020 1019 1021 1020 1019 1019 1019 1018 1016 1019 1016 1013 1013 1014 1013 1014 896
848 630 1008 1039 1034 1030 1028 1028 1028 1026 1026 1025 1020 1018 1021 1019 1017 1018 1020 1019 1017 1020 1019 1017 1018 1018 1017 1016 1018 1015 1013 1012 1013 1013 1013 904
847 651 1017 1040 1035 1031 1029 1029 1028 1026 1027 1026 1021 1019 1021 1020 1018 1019 1021 1020 1019 1021 1021 1019 1019 1019 1018 1017 1020 1016 1014 1014 1014 1014 1015 913
826 1048 1045 1043 1039 1035 1033 1033 1032 1030 1031 1030 1024 1023 1025 1023 1022 1022 1025 1024 1023 1025 1025 1023 1023 1023 1022 1021 1023 1020 1018 1018 1018 1018 1018 901
828 1051 1045 1042 1039 1035 1033 1033 1033 1030 1031 1030 1025 1023 1025 1024 1023 1023 1026 1025 1024 1026 1026 1024 1024 1025 1023 1022 1024 1021 1019 1018 1019 1018 1019 893
826 1049 1042 1040 1036 1033 1031 1031 1031 1028 1029 1028 1023 1021 1024 1022 1021 1021 1024 1024 1022 1025 1024 1023 1023 1022 1022 1020 1023 1019 1017 1017 1017 1017 1017 889
821 1044 1037 1035 1031 1027 1026 1026 1025 1023 1024 1024 1018 1016 1019 1017 1016 1016 1020 1020 1017 1020 1019 1018 1018 1018 1017 1015 1018 1015 1012 1012 1012 1029 1032 878
814 1037 1030 1027 1023 1020 1018 1018 1018 1016 1017 1016 1011 1009 1012 1010 1008 1009 1014 1013 1012 1015 1014 1012 1013 1013 1013 1010 1013 1010 1008 1008 1009 1009 1009 888
704 1040 1035 1032 1029 1025 1024 1024 1024 1021 1023 1022 1016 1015 1017 1015 1014 1016 1020 1019 1018 1020 1020 1018 1019 1019 1018 1017 1019 1016 1014 1014 1015 1014 1013 785
156 795 946 946 944 941 939 939 940 937 938 938 933 931 934 932 931 932 990 987 983 983 981 983 982 980 978 975 975 975 972 970 969 958 871 315>;

	synaptics,pt16_low_b = /bits/ 16 <
105 538 623 622 620 618 615 614 613 611 610 609 606 605 608 609 614 624 544 544 543 545 545 544 544 544 543 543 544 542 541 541 541 539 468 74
429 624 621 619 617 615 614 614 614 612 613 613 610 609 610 610 609 610 608 607 606 608 608 607 607 607 606 605 607 605 604 603 604 604 602 470
490 623 619 617 615 613 612 611 611 610 611 610 607 606 608 607 606 607 606 605 604 606 606 604 605 605 604 603 605 603 602 601 602 602 602 522
494 627 625 621 619 617 616 616 615 614 615 614 611 610 611 611 610 610 611 610 609 611 610 609 610 610 609 608 610 608 607 606 607 607 607 524
494 628 639 622 620 618 617 617 616 615 616 615 612 611 613 611 611 611 611 611 610 612 611 610 610 610 610 609 610 609 607 607 607 607 608 530
493 625 621 620 618 615 614 614 614 613 613 613 610 609 610 609 608 608 609 609 608 609 609 608 608 608 607 606 608 606 605 605 605 605 605 532
494 626 624 623 621 618 617 617 617 615 616 615 612 611 613 612 611 611 612 611 610 612 611 610 611 610 610 609 610 609 607 607 607 607 608 537
462 343 604 622 620 617 616 616 616 615 615 614 611 610 612 611 610 610 611 611 609 611 611 610 610 610 609 609 610 608 607 607 607 607 607 541
461 354 610 623 620 618 617 616 616 615 615 615 612 611 612 611 610 610 612 611 610 612 612 611 611 611 610 609 611 609 608 607 608 608 608 547
495 628 626 625 622 620 619 619 619 617 618 617 614 613 614 613 612 613 614 614 613 614 614 613 613 613 613 612 613 611 610 610 610 610 610 540
496 630 626 625 622 620 619 619 619 617 618 617 614 613 614 613 613 613 615 614 613 615 615 614 614 614 613 612 614 612 611 610 610 610 611 535
495 629 625 623 621 619 618 618 618 616 617 616 613 612 613 612 612 612 614 613 613 614 614 613 613 613 612 611 613 611 610 609 609 609 610 532
492 626 622 620 618 616 615 615 614 613 614 613 610 609 610 610 609 609 611 611 610 611 611 610 610 610 609 608 610 608 607 606 607 617 618 526
488 621 617 615 613 611 610 610 610 609 609 609 606 605 606 605 604 605 608 607 606 608 608 606 607 607 607 605 607 605 604 604 604 604 605 532
422 623 620 619 616 614 613 613 613 612 613 612 609 608 610 608 608 609 611 611 610 611 611 610 610 610 610 610 611 609 608 607 608 608 607 470
53 476 567 567 565 564 563 563 563 562 562 562 559 558 559 558 558 558 593 591 589 589 588 589 588 587 586 584 584 584 582 581 580 574 522 108>;

	synaptics,pt1a_low_b = <
10000 10000 10000 10000 10000 10000 10000 10000 10000 10000 10000 10000 10000 10000 10000 10000 10000 10000 10000 10000 10000 10000 10000 10000 10000 10000 10000 10000 10000 10000 10000 10000 10000 10000 10000 10000 10000 10000 10000 10000 10000 10000 10000 10000 10000 10000 10000 10000 10000 10000 10000 10000>;

synaptics,pt05_high_b_ical = /bits/ 16 <
421 1301 1509 1505 1501 1494 1488 1485 1482 1479 1475 1472 1463 1463 1466 1473 1485 1511 1315 1314 1312 1314 1312 1311 1308 1311 1310 1310 1312 1305 1302 1304 1304 1298 1127 300
1028 1311 1308 1304 1299 1295 1293 1293 1291 1290 1290 1288 1281 1280 1280 1281 1281 1285 1278 1276 1276 1276 1276 1274 1273 1274 1273 1274 1275 1270 1269 1268 1269 1265 1265 1124
1173 1309 1249 1246 1242 1238 1235 1235 1235 1234 1234 1230 1225 1224 1224 1225 1224 1228 1223 1220 1222 1222 1222 1220 1218 1219 1219 1219 1220 1217 1214 1213 1214 1213 1266 1254
1180 1314 1258 1250 1247 1243 1240 1240 1240 1238 1237 1235 1229 1228 1228 1230 1228 1229 1228 1226 1226 1226 1226 1224 1222 1224 1224 1223 1224 1220 1218 1218 1218 1217 1270 1249
1185 1319 1290 1255 1252 1247 1244 1244 1243 1242 1242 1238 1232 1232 1231 1232 1231 1232 1232 1230 1230 1230 1230 1228 1226 1226 1226 1225 1226 1223 1220 1219 1220 1219 1271 1264
1179 1310 1252 1248 1244 1240 1236 1237 1236 1235 1235 1232 1226 1225 1225 1226 1225 1226 1225 1224 1225 1225 1224 1223 1220 1223 1222 1220 1222 1219 1217 1217 1217 1216 1269 1271
1180 1310 1255 1254 1249 1244 1241 1241 1241 1238 1238 1236 1230 1229 1229 1230 1229 1230 1230 1228 1228 1229 1228 1225 1224 1225 1224 1224 1224 1220 1218 1218 1218 1218 1270 1281
1169 873 1293 1248 1244 1240 1236 1235 1234 1234 1234 1230 1225 1224 1223 1224 1223 1224 1224 1224 1223 1223 1224 1222 1219 1222 1220 1220 1222 1218 1216 1216 1216 1214 1268 1289
1170 905 1307 1253 1248 1243 1240 1240 1238 1236 1236 1234 1228 1226 1226 1228 1226 1228 1229 1226 1226 1226 1228 1225 1222 1225 1224 1223 1225 1220 1218 1218 1218 1217 1269 1304
1174 1306 1252 1248 1244 1240 1237 1236 1236 1234 1234 1231 1225 1224 1223 1225 1223 1225 1226 1225 1225 1225 1225 1223 1222 1224 1223 1222 1222 1219 1217 1217 1218 1216 1269 1282
1179 1314 1253 1250 1246 1242 1238 1238 1237 1236 1236 1234 1228 1226 1226 1228 1225 1228 1229 1228 1226 1228 1228 1225 1223 1225 1224 1224 1223 1220 1218 1218 1218 1217 1269 1269
1176 1311 1250 1247 1243 1240 1236 1236 1235 1235 1234 1231 1225 1224 1224 1225 1224 1225 1226 1225 1225 1226 1226 1224 1222 1224 1222 1222 1222 1219 1217 1217 1217 1216 1268 1264
1173 1309 1249 1244 1242 1237 1235 1235 1235 1232 1232 1230 1224 1223 1223 1224 1223 1224 1226 1225 1224 1224 1225 1223 1220 1223 1222 1222 1222 1218 1216 1216 1216 1235 1291 1254
1169 1306 1246 1242 1238 1234 1231 1231 1231 1229 1230 1226 1220 1219 1219 1222 1220 1222 1225 1224 1224 1224 1224 1222 1219 1222 1222 1220 1222 1218 1216 1216 1217 1216 1268 1274
1003 1303 1298 1294 1290 1285 1283 1284 1283 1281 1281 1279 1273 1271 1270 1273 1271 1274 1278 1275 1275 1276 1276 1274 1271 1274 1273 1274 1274 1270 1268 1268 1269 1268 1266 1118
197 1143 1363 1361 1360 1354 1351 1353 1351 1350 1350 1347 1343 1340 1340 1340 1340 1341 1425 1417 1415 1412 1410 1412 1407 1409 1404 1402 1400 1400 1396 1393 1392 1374 1251 424>;
	synaptics,pt05_low_b_ical = /bits/ 16 <
20 108 126 125 125 125 124 124 124 123 123 123 122 122 122 123 124 126 110 110 109 110 109 109 109 109 109 109 109 109 109 109 109 108 94 14
86 126 125 125 125 124 124 124 124 124 124 123 123 123 123 123 123 123 122 122 122 122 122 122 122 122 122 122 122 122 122 121 122 121 121 94
98 125 125 124 124 124 123 123 123 123 123 123 122 122 122 122 122 123 122 122 122 122 122 122 122 122 122 122 122 121 121 121 121 121 121 104
98 126 126 125 125 124 124 124 124 124 124 123 123 123 123 123 123 123 123 122 122 122 122 122 122 122 122 122 122 122 122 122 122 122 122 104
99 126 129 125 125 125 124 124 124 124 124 124 123 123 123 123 123 123 123 123 123 123 123 123 122 123 122 122 123 122 122 122 122 122 122 105
98 126 125 125 124 124 123 124 123 123 123 123 123 122 122 122 122 123 122 122 122 122 122 122 122 122 122 122 122 122 121 121 121 121 122 106
98 126 125 125 125 124 124 124 124 124 124 123 123 123 123 123 123 123 123 123 123 123 123 122 122 122 122 122 122 122 122 122 122 122 122 107
92 68 121 125 124 124 123 123 123 123 123 123 122 122 122 122 122 122 122 122 122 122 122 122 122 122 122 122 122 122 121 121 121 121 121 108
92 71 122 125 125 124 124 124 124 123 123 123 123 123 122 123 122 123 123 123 122 123 123 122 122 122 122 122 122 122 122 122 122 122 122 109
98 125 125 125 124 124 124 123 123 123 123 123 122 122 122 122 122 122 122 122 122 122 122 122 122 122 122 122 122 122 121 122 122 121 122 107
98 126 125 125 124 124 124 124 124 123 123 123 123 123 122 123 122 123 123 123 123 123 123 122 122 122 122 122 122 122 122 122 122 121 122 106
98 126 125 125 124 124 123 123 123 123 123 123 122 122 122 122 122 122 123 122 122 122 122 122 122 122 122 122 122 122 121 121 122 121 122 105
98 125 125 124 124 124 123 123 123 123 123 123 122 122 122 122 122 122 122 122 122 122 122 122 122 122 122 122 122 122 121 121 121 123 124 104
97 125 124 124 124 123 123 123 123 123 123 122 122 122 122 122 122 122 122 122 122 122 122 122 122 122 122 122 122 122 121 121 122 121 122 106
84 125 124 124 124 123 123 123 123 123 123 123 122 122 122 122 122 122 122 122 122 122 122 122 122 122 122 122 122 122 122 122 122 122 121 93
9 95 114 114 113 113 113 113 113 112 113 112 112 112 112 112 112 112 119 118 118 118 118 118 117 117 117 117 117 117 116 116 116 115 104 21>;
	synaptics,pt05_gap_x_b_ical = /bits/ 16 <
494 400 400 400 400 400 400 400 400 400 400 400 400 400 400 400 400 400 400 400 400 400 400 400 400 400 400 400 400 400 400 400 400 400 180
400 400 400 400 400 400 400 400 400 400 400 400 400 400 400 400 400 400 400 400 400 400 400 400 400 400 400 400 400 400 400 400 400 400 400
400 400 400 400 400 400 400 400 400 400 400 400 400 400 400 400 400 400 400 400 400 400 400 400 400 400 400 400 400 400 400 400 400 400 400
400 400 400 400 400 400 400 400 400 400 400 400 400 400 400 400 400 400 400 400 400 400 400 400 400 400 400 400 400 400 400 400 400 400 400
400 400 400 400 400 400 400 400 400 400 400 400 400 400 400 400 400 400 400 400 400 400 400 400 400 400 400 400 400 400 400 400 400 400 400
400 400 400 400 400 400 400 400 400 400 400 400 400 400 400 400 400 400 400 400 400 400 400 400 400 400 400 400 400 400 400 400 400 400 400
400 400 400 400 400 400 400 400 400 400 400 400 400 400 400 400 400 400 400 400 400 400 400 400 400 400 400 400 400 400 400 400 400 400 400
400 400 400 400 400 400 400 400 400 400 400 400 400 400 400 400 400 400 400 400 400 400 400 400 400 400 400 400 400 400 400 400 400 400 400
400 400 400 400 400 400 400 400 400 400 400 400 400 400 400 400 400 400 400 400 400 400 400 400 400 400 400 400 400 400 400 400 400 400 400
400 400 400 400 400 400 400 400 400 400 400 400 400 400 400 400 400 400 400 400 400 400 400 400 400 400 400 400 400 400 400 400 400 400 400
400 400 400 400 400 400 400 400 400 400 400 400 400 400 400 400 400 400 400 400 400 400 400 400 400 400 400 400 400 400 400 400 400 400 400
400 400 400 400 400 400 400 400 400 400 400 400 400 400 400 400 400 400 400 400 400 400 400 400 400 400 400 400 400 400 400 400 400 400 400
400 400 400 400 400 400 400 400 400 400 400 400 400 400 400 400 400 400 400 400 400 400 400 400 400 400 400 400 400 400 400 400 400 400 400
400 400 400 400 400 400 400 400 400 400 400 400 400 400 400 400 400 400 400 400 400 400 400 400 400 400 400 400 400 400 400 400 400 400 400
400 400 400 400 400 400 400 400 400 400 400 400 400 400 400 400 400 400 400 400 400 400 400 400 400 400 400 400 400 400 400 400 400 400 400
1124 400 400 400 400 400 400 400 400 400 400 400 400 400 400 400 400 400 400 400 400 400 400 400 400 400 400 400 400 400 400 400 400 400 173>;
	synaptics,pt05_gap_y_b_ical = /bits/ 16 <
419 400 400 400 400 400 400 400 400 400 400 400 400 400 400 400 400 400 400 400 400 400 400 400 400 400 400 400 400 400 400 400 400 400 400 569
400 400 400 400 400 400 400 400 400 400 400 400 400 400 400 400 400 400 400 400 400 400 400 400 400 400 400 400 400 400 400 400 400 400 400 400
400 400 400 400 400 400 400 400 400 400 400 400 400 400 400 400 400 400 400 400 400 400 400 400 400 400 400 400 400 400 400 400 400 400 400 400
400 400 400 400 400 400 400 400 400 400 400 400 400 400 400 400 400 400 400 400 400 400 400 400 400 400 400 400 400 400 400 400 400 400 400 400
400 400 400 400 400 400 400 400 400 400 400 400 400 400 400 400 400 400 400 400 400 400 400 400 400 400 400 400 400 400 400 400 400 400 400 400
400 400 400 400 400 400 400 400 400 400 400 400 400 400 400 400 400 400 400 400 400 400 400 400 400 400 400 400 400 400 400 400 400 400 400 400
400 400 400 400 400 400 400 400 400 400 400 400 400 400 400 400 400 400 400 400 400 400 400 400 400 400 400 400 400 400 400 400 400 400 400 400
400 400 400 400 400 400 400 400 400 400 400 400 400 400 400 400 400 400 400 400 400 400 400 400 400 400 400 400 400 400 400 400 400 400 400 400
400 400 400 400 400 400 400 400 400 400 400 400 400 400 400 400 400 400 400 400 400 400 400 400 400 400 400 400 400 400 400 400 400 400 400 400
400 400 400 400 400 400 400 400 400 400 400 400 400 400 400 400 400 400 400 400 400 400 400 400 400 400 400 400 400 400 400 400 400 400 400 400
400 400 400 400 400 400 400 400 400 400 400 400 400 400 400 400 400 400 400 400 400 400 400 400 400 400 400 400 400 400 400 400 400 400 400 400
400 400 400 400 400 400 400 400 400 400 400 400 400 400 400 400 400 400 400 400 400 400 400 400 400 400 400 400 400 400 400 400 400 400 400 400
400 400 400 400 400 400 400 400 400 400 400 400 400 400 400 400 400 400 400 400 400 400 400 400 400 400 400 400 400 400 400 400 400 400 400 400
400 400 400 400 400 400 400 400 400 400 400 400 400 400 400 400 400 400 400 400 400 400 400 400 400 400 400 400 400 400 400 400 400 400 400 400
185 400 400 400 400 400 400 400 400 400 400 400 400 400 400 400 400 400 400 400 400 400 400 400 400 400 400 400 400 400 400 400 400 400 400 171>;

	synaptics,pt12_high_b_ical = <
 271142 283126 285394 284038 283480 283687 283487 282906 282431 283100 282926 282556 282758 283114 282713 282397 282295 281994 272760 272214 271813 270400 270884 271157 270298 270370 270343 269677 269147 268878 269120 268865 268520 268301 266216 244949 595399 605914 606841 606730 607003 606917 607510 607391 597184 596335 595630 595387 595688 595848 594234 584185>;
	synaptics,pt12_low_b_ical = <
108457 113250 114157 113614 113391 113474 113394 113162 112972 113239 113170 113022 113103 113245 113085 112958 112918 112797 109103 108885 108725 108159 108353 108462 108118 108147 108137 107870 107658 107550 107647 107546 107407 107320 106486 97978 238159 242365 242736 242691 242801 242766 243003 242956 238873 238534 238251 238154 238274 238338 237693 233674>;

};
