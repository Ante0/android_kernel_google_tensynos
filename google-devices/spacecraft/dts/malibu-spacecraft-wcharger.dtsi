// SPDX-License-Identifier: GPL-2.0-only
/*
 * Wireless charger device tree for Spacecraft
 *
 * Copyright 2025 Google LLC
 *
 */

#include "google-base/malibu-wcharger.dtsi"

&google_cpm {
	google,no-init-wlc-ta-vol;
};

&google_wlc {
	google,project_id = /bits/ 8 <0x07>;
	google,wlc-bootloader = "CPS4041_BL.bin";
	google,wlc-firmware = "CPS4041_A0_07.bin"; /* use 07 FW */
	vdden-gpio = <AP2QI_CLOAK_EN(GPIO_ACTIVE_HIGH)>; /* ENVDD, AP2QI_ENVDD */
};
