// SPDX-License-Identifier: GPL-2.0-only
/*
 * cubs device tree source
 *
 * Copyright 2025 Google LLC
 */

/dts-v1/;
/plugin/;

/* define board-specific  GPIO macros before other devicetrees */
#include "malibu-cubs-evt-pinctrl.dtsi"
#include "malibu-dabears-common.dtsi"
#include "malibu-dabears-evt-pinctrl.dtsi"
#include "malibu-dabears-sbbm.dtsi"
#include "malibu-cubs-lsio.dtsi"
#include "malibu-cubs-common.dtsi"
#include "malibu-cubs-camera-pmic.dtsi"
#include "malibu-cubs-camera.dtsi"
#include "malibu-spacecraft-wingboard-charging.dtsi"

/ {
	board_id = <0x80603>;
	board_rev = <0x01010f>;
	fragment@boardbase {
		target-path = "/";
		__overlay__ {
			model = "CUBS EVT 1.1 Wingboard based on MALIBU";
			compatible = "google,malibu-cubs", "google,malibu";
		};
	};
};

