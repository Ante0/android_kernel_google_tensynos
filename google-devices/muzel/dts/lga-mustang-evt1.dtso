// SPDX-License-Identifier: GPL-2.0-only
/*
 * mustang device tree source
 *
 * Copyright 2024 Google LLC
 */

/dts-v1/;
/plugin/;

#include "lga-mustang-evt1-pinctrl.dtsi"
#include "lga-muzel-common.dtsi"
#include "lga-mustang-common.dtsi"
#include "lga-mustang-camera.dtsi"
#include "lga-mustang-evt1-charging.dtsi"

/ {
	board_id = <0x70503>;
	board_rev = <0x010000>;
	fragment@boardbase {
		target-path = "/";
		__overlay__ {
			model = "MUSTANG EVT 1.0 based on LGA";
			compatible = "google,lga-mustang", "google,lga";
		};
	};
};

