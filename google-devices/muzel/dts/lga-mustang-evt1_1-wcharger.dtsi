// SPDX-License-Identifier: GPL-2.0-only
/*
 * Wireless charger device tree additiona for Mustang EVT1.1+
 *
 * Copyright 2024 Google LLC
 *
 */

&google_wlc {
	google,qi22_en_gpio_active = <1>;
	google,qi22_en_gpio_value = <1>;

	bpp_mdis_pwr = <5000000 4908600 4817200 4725800 4634400 4543000 4451600 4360200 4268800
			4177400 4086000 3994600 3903200 3811800 3720400 3629000 3537600 3446200
			3354800 3263400 3172000 3080600 2989200 2897800 2806400 2715000>;
	mpp_mdis_pwr = <15000000 14543440 14086880 13630320 13173760 12717200 12260640 11804080
			11347520 10890960 10434400  9977840  9521280  9064720  8608160  8151600
			 7695040  7238480  6781920  6325360  5868800  5412240  4955680  4499120
			 4042560  3586000>;
};
