// SPDX-License-Identifier: GPL-2.0-only
/*
 * frankel audio device tree source
 *
 * Copyright 2024 Google LLC
 */

&aoc {
	aoc-board-cfg = "FL5";
	aoc-board-id = <0x70303>;
	aoc-board-rev = <0x10000>;
	prevent-fw-load = <0x0>;
};
