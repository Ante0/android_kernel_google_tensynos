// SPDX-License-Identifier: GPL-2.0-only
/*
 * Battery charging for evt+
 *
 * Copyright 2025 Google LLC
 *
 */
&google_cpm {
	// thermal budgets
	google,mdis-thermal-mitigation =
	<3710000 3571000 3443000 3297000 3162000 3040000 2918000 2810000 2703000
	 2598000 2493000 2330000 2200000 2080000 1968000 1865000 1770000 1684000
	 1595000 1506000 1444000 1382000 1351000 1320000 1273000 1225000>;
	// PD+main-charger, WLC+main-charger
	google,mdis-out0-limits =
	<4000000 3880000 3760000 3640000 3520000 3400000 3280000 3160000 3040000
	 2920000 2800000 2680000 2560000 2440000 2320000 2200000 2080000 1960000
	 1840000 1720000 1600000 1480000 1360000 1240000 1120000 1000000
	 1100000 1100000 1100000 1100000 1100000 1100000 1100000 1100000 1100000
	 1100000 1100000 1100000 1050000 1000000 950000  900000  850000  800000
	 750000  700000  650000  600000  550000  500000  450000  400000>;
	// PPS_CP+pca94xx-mains, // WLC_CP+pca94xx-mains
	google,mdis-out1-limits =
	<5648000 5502000 5356000 5210000 5064000 4918000 4772000 4627000 4481000
	 4335000 4189000 4043000 3897000 3751000 3605000 3459000 3313000 3167000
	 3021000 2876000 2730000 2584000 2438000 2292000 2146000 2000000
	 4800000 4600000 4400000 4200000 4000000 3800000 3600000 3400000 3200000
	 3000000 2800000 2600000 2400000 2200000 2000000 1800000 1600000 1400000
	 1200000 1000000 900000  800000  700000  600000  500000  400000>;
};

&max77779_chg {
	max77779,wlc-inlim-cv;
};

