// SPDX-License-Identifier: GPL-2.0-only
/*
 * deepspace + tesseract device tree source
 *
 * Copyright 2024 Google LLC
 */

/dts-v1/;
/plugin/;

#define BATTERY_EEPROM_1K

/* Use deepspace GPIO configs. */
#include "lga-deepspace-pinctrl.dtsi"
#include "google-base/platform/lga-platform-common.dtsi"
#include "lga-deepspace-common.dtsi"
#include "lga-deepspace-tesseract-wcharger.dtsi"
#include "lga-deepspace-charging.dtsi"

/ {
	board_id = <0x70101>;
	board_rev = <0x010002>;
	fragment@boardbase {
		target-path = "/";
		__overlay__ {
			model = "Deepspace board + Tesseract based on LGA";
			compatible = "google,lga-deepspace", "google,lga";
		};
	};
};
