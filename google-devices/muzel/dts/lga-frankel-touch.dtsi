// SPDX-License-Identifier: GPL-2.0-only
/*
 * Google LGA touch device tree source.
 *
 * Copyright 2024 Google Inc.
 *
 */

#include <dt-bindings/gpio/gpio.h>

&spitouch {
	status = "ok";

	compatible = "focaltech,ts";
	reg = <0>;
	spi-max-frequency = <20000000>;
	rx-sample-delay-ns = <25>;

	focaltech,irq-gpio = <TS0_2_AOC_INT_L_1V2(GPIO_ACTIVE_LOW)>;
	focaltech,reset-gpio = <PMICS2TS0_RESET_L_1V2(GPIO_ACTIVE_LOW)>;
	focaltech,max-touch-number = <10>;
	focaltech,display-coords = <0 0 10799 24239>;
	focaltech,rx_ch_num = <36>;
	focaltech,tx_ch_num = <16>;

	focaltech,mm2px= /bits/ 8 <17>;

	goog,panel_map = <&google_gs_flea 0>, <&google_gs_fleb 1>;
	goog,firmware_names = "focaltech_ts_fw.bin", "focaltech_ts_fw_b.bin";
	goog,test_limits_names = "focaltech_testconf.ini", "focaltech_testconf_b.ini";

	goog,touch_offload_ids = /bits/ 8 <'f' 'l' '5' '0' 'f' 'l' '5' '1'>;
	goog,display-resolution = /bits/ 16 <1080 2424>;
	goog,channel-num = /bits/ 16 <16 36>;
	goog,offload-caps-data-types = /bits/ 16 <0x1F>;
	goog,offload-caps-scan-types = /bits/ 16 <0xC0>;
	goog,offload-caps-context-channel-types = /bits/ 16 <0x0100>;
	goog,offload-caps-coord-filter;
	goog,v4l2-enabled;
	goog,offload-enabled;
	goog,touch-sim-enabled;

	goog,lptw-suppress-coords-enabled;
	goog,lptw-tracking-area = <390 690 1629 1929>;
	goog,init-mf-mode = <4>;
	goog,coord-filter-enabled;
	goog,timestamp-correction-enabled;
};
