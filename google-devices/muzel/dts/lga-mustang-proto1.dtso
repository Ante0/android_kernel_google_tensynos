// SPDX-License-Identifier: GPL-2.0-only
/*
 * mustang device tree source
 *
 * Copyright 2024 Google LLC
 */

/dts-v1/;
/plugin/;

#define MUZEL_PROTO_WLC
#define BATTERY_EEPROM_1K

#include "lga-mustang-proto-pinctrl.dtsi"
#include "lga-muzel-common.dtsi"
#include "lga-mustang-common.dtsi"
#include "lga-mustang-camera-proto.dtsi"
#include "lga-mustang-proto1-charging.dtsi"
#include "lga-muzel-ntc-thermal-proto.dtsi"

/ {
	board_id = <0x70502>;
	board_rev = <0x010000>;
	fragment@boardbase {
		target-path = "/";
		__overlay__ {
			model = "MUSTANG Proto 1.0 based on LGA";
			compatible = "google,lga-mustang", "google,lga";
		};
	};
};

