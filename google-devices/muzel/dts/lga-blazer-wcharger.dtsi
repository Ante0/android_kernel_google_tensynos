// SPDX-License-Identifier: GPL-2.0-only
/*
 * Wireless charger device tree for Blazer
 *
 * Copyright 2024 Google LLC
 *
 */

#include "lga-muzel-wcharger.dtsi"

&google_wlc {
	google,project_id = /bits/ 8 <0x01>;
	google,wlc-bootloader = "CPS4041_BL.bin";
	google,wlc-firmware = "CPS4041_A0_01.bin";

	bpp_mdis_pwr = <5000000 4906720 4813440 4720160 4626880 4533600 4440320 4347040 4253760
			4160480 4067200 3973920 3880640 3787360 3694080 3600800 3507520 3414240
			3320960 3227680 3134400 3041120 2947840 2854560 2761280 2668000>;
	mpp_mdis_pwr = <15000000 14542320 14084640 13626960 13169280 12711600 12253920 11796240
			11338560 10880880 10423200  9965520  9507840  9050160  8592480  8134800
			 7677120  7219440  6761760  6304080  5846400  5388720  4931040  4473360
			 4015680  3558000>;
	google,wlc_mod_soc = <75>;
};
