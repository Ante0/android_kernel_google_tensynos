// SPDX-License-Identifier: GPL-2.0-only
/*
 * blazer device tree source
 *
 * Copyright 2024 Google LLC
 */

/dts-v1/;
/plugin/;

#define MUZEL_PROTO_WLC
#define BATTERY_EEPROM_1K

#include "lga-blazer-proto-pinctrl.dtsi"
#include "lga-muzel-common.dtsi"
#include "lga-blazer-common.dtsi"
#include "lga-blazer-camera-proto1.dtsi"
#include "lga-blazer-proto1-charging.dtsi"
#include "lga-muzel-ntc-thermal-proto.dtsi"

/ {
	board_id = <0x70402>;
	board_rev = <0x010000>;
	fragment@boardbase {
		target-path = "/";
		__overlay__ {
			model = "BLAZER Proto 1.0 based on LGA";
			compatible = "google,lga-blazer", "google,lga";
		};
	};
};

