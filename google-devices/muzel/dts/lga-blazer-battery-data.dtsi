// SPDX-License-Identifier: GPL-2.0-only
/*
 * Battery device tree entries
 *
 * Copyright 2024 Google LLC
 *
 */

max77779,config {

	/* BZ5_ATL_3749_001_G1.ini.txt, b/377554837#comment2 */
	max77779,atl-1k {
		max77779,batt-id-kohm = <1>;
		max77779,model-version = <2>;
		max77779,force-reset-model-data;
		max77779,fg-model = /bits/ 16 <
			0x9700 0xae90 0xb750 0xb900 0xba70 0xbc10 0xbd70 0xbea0
			0xbfe0 0xc150 0xc2a0 0xc620 0xc9c0 0xd0a0 0xd760 0xde70
			0x0060 0x0180 0x1300 0x09c0 0x0ee0 0x1230 0x1300 0x1220
			0x0fe0 0x0ed0 0x05c0 0x0890 0x06d0 0x06f0 0x06b0 0x06b0
		>;
		max77779,fg-params = /bits/ 16 <
			/* 0x00C0 */	0xc1b0	/* nnvcfg0 */
			/* 0x00B6 */	0x083b	/* nrelaxcfg */
			/* 0x009F */	0x660e	/* nLearnCFG */
			/* 0x000C */	0x4207	/* Config */
			/* 0x00AB */	0x0081	/* Config2 */
			/* 0x00BC */	0x5f00	/* nFullSOCThr */
			/* 0x00A9 */	0x07bb	/* nfullcaprep */
			/* 0x00B3 */	0x07bb	/* ndesigncap */
			/* 0x0046 */	0x0C80	/* dPacc */
			/* 0x00A5 */	0x07bb	/* nfullcapnom */
			/* 0x00C6 */	0xa55a	/* nVEmpty */
			/* 0x00A0 */	0x2d0e	/* nQRTable00 */
			/* 0x00A1 */	0x1383	/* nQRTable10 */
			/* 0x00A2 */	0x0683	/* nQRTable20 */
			/* 0x00A3 */	0x0383	/* nQRTable30 */
			/* 0x00A6 */	0x06f0	/* nRCOMP0 */
			/* 0x00A7 */	0x1802	/* nTempCo */
			/* 0x009C */	0x0266	/* nichgterm */
			/* 0x00B2 */	0x3870	/* nmisccfg */
			/* 0x009E */	0x0400	/* nModelCfg */
			/* 0x00CA */	0xc8ff	/* nThermCfg */
			/* 0x009D */	0xCEA4	/* nFilterCfg */
		>;
		max77779,fg_n_regval = /bits/ 16 <
			0xB7 0x2240	/* nConvgCfg */
			0xC9 0xC8FF	/* nThermCfg2 Register */
		>;
		max77779,fg-aafv = /bits/ 32 <
			  0   95  0xf  0x0266
			 20   90  0xf  0x0133
			 40   85  0xf  0x0133
			 60   80  0xf  0x0133
			 80   75  0xf  0x0133
			100   70  0xf  0x0133
		>;
	};

	/* BZ5_LWN_3750_001_G1.ini.txt, b/377555057#comment2 */
	max77779,lwn-4k {
		max77779,batt-id-kohm = <4>;
		max77779,model-version = <2>;
		max77779,force-reset-model-data;
		max77779,fg-model = /bits/ 16 <
			0x9610 0xaf40 0xb760 0xb8d0 0xbac0 0xbc20 0xbd80 0xbfc0
			0xc190 0xc690 0xca30 0xcd60 0xd0e0 0xd4b0 0xd840 0xdf80
			0x0050 0x0190 0x1060 0x0c70 0x10f0 0x0dd0 0x1360 0x0fc0
			0x0900 0x06e0 0x0780 0x06f0 0x05f0 0x0660 0x0780 0x0780
		>;
		max77779,fg-params = /bits/ 16 <
			/* 0x00C0 */	0xc1b0	/* nnvcfg0 */
			/* 0x00B6 */	0x083b	/* nrelaxcfg */
			/* 0x009F */	0x660e	/* nLearnCFG */
			/* 0x000C */	0x4207	/* Config */
			/* 0x00AB */	0x0081	/* Config2 */
			/* 0x00BC */	0x5f00	/* nFullSOCThr */
			/* 0x00A9 */	0x07b8	/* nfullcaprep */
			/* 0x00B3 */	0x07b8	/* ndesigncap */
			/* 0x0046 */	0x0C80	/* dPacc */
			/* 0x00A5 */	0x07b8	/* nfullcapnom */
			/* 0x00C6 */	0xa55a	/* nVEmpty */
			/* 0x00A0 */	0x1614	/* nQRTable00 */
			/* 0x00A1 */	0x0b8a	/* nQRTable10 */
			/* 0x00A2 */	0x0680	/* nQRTable20 */
			/* 0x00A3 */	0x0580	/* nQRTable30 */
			/* 0x00A6 */	0x0640	/* nRCOMP0 */
			/* 0x00A7 */	0x2401	/* nTempCo */
			/* 0x009C */	0x0266	/* nichgterm */
			/* 0x00B2 */	0x3870	/* nmisccfg */
			/* 0x009E */	0x0400	/* nModelCfg */
			/* 0x00CA */	0xc8ff	/* nThermCfg */
			/* 0x009D */	0xCEA4	/* nFilterCfg */
		>;
		max77779,fg_n_regval = /bits/ 16 <
			0xB7 0x2240	/* nConvgCfg */
			0xC9 0xC8FF	/* nThermCfg2 Register */
		>;
		max77779,fg-aafv = /bits/ 32 <
			  0   95  0xf  0x0266
			 20   90  0xf  0x0133
			 40   85  0xf  0x0133
			 60   80  0xf  0x0133
			 80   75  0xf  0x0133
			100   70  0xf  0x0133
		>;
	};
};
