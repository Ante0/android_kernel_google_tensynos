// SPDX-License-Identifier: GPL-2.0-only
/*
 * Battery device tree entries specific to Deepspace
 *
 * Copyright 2024 Google LLC
 *
 */

#include "google-base/platform/lga-platform-battery.dtsi"

&google_battery {
	google,chg-battery-capacity = <4942>;

	google,chg-cv-limits = <4200000 4250000 4300000 4350000 4480000>;
	google,chg-temp-limits = <0 100 200 420 460 480 550>;
	google,chg-cc-limits = <
		 50   30   30    0   0
		100  100  100   50  50
		150  150  150  150  50
		150  150   50   50  50
		 50   50   50    0   0
		 30    0    0    0   0
	>;

	google,chg-topoff-limits = <250 250 250 500 500 500>;

	google,ttf-temp-idx= <2>;
	google,ttf-adapter = <4500>;
	google,ttf-soc-table =  <52 72 85 89 93  95  97  100>;
	google,ttf-elap-table = <24 47 65 82 121 170 222 116>;
	google,ttf-tier-table = <0 51 76>;
	google,ttf-report-max-ratio = <0>;
};

&max77779_fg {
	maxim,fg-data {
		#include "google-base/platform/lga-komodo-battery-data.dtsi"
	};
};
