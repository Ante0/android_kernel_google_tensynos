// SPDX-License-Identifier: GPL-2.0-only
/*
 * frankel device tree source
 *
 * Copyright 2024 Google LLC
 */

/dts-v1/;
/plugin/;

#include "lga-frankel-evt1-pinctrl.dtsi"
#include "lga-muzel-common.dtsi"
#include "lga-frankel-common.dtsi"
#include "lga-frankel-evt1-charging.dtsi"

/ {
	board_id = <0x70303>;
	board_rev = <0x010000>;
	fragment@boardbase {
		target-path = "/";
		__overlay__ {
			model = "FRANKEL EVT 1.0 based on LGA";
			compatible = "google,lga-frankel", "google,lga";
		};
	};
};

