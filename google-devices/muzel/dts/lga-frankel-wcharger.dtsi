// SPDX-License-Identifier: GPL-2.0-only
/*
 * Wireless charger device tree for Frankel
 *
 * Copyright 2024 Google LLC
 *
 */

#include "lga-muzel-wcharger.dtsi"

&google_wlc {
	google,project_id = /bits/ 8 <0x02>;
	google,wlc-bootloader = "CPS4041_BL.bin";
	google,wlc-firmware = "CPS4041_A0_02.bin";

	bpp_mdis_pwr = <5000000 4900760 4801520 4702280 4603040 4503800 4404560 4305320 4206080
			4106840 4007600 3908360 3809120 3709880 3610640 3511400 3412160 3312920
			3213680 3114440 3015200 2915960 2816720 2717480 2618240 2519000>;
	mpp_mdis_pwr = <15000000 14542520 14085040 13627560 13170080 12712600 12255120 11797640
			11340160 10882680 10425200  9967720  9510240  9052760  8595280  8137800
			 7680320  7222840  6765360  6307880  5850400  5392920  4935440  4477960
			 4020480  3563000>;
	google,wlc_mod_soc = <75>;
};
