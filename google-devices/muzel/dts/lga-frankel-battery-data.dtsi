// SPDX-License-Identifier: GPL-2.0-only
/*
 * Battery device tree entries
 *
 * Copyright 2024 Google LLC
 *
 */

max77779,config {
	/* FL5-ATL_3754_001_G1.txt, b/377550406#comment1 */

	max77779,atl-1k {
		max77779,batt-id-kohm = <1>;
		max77779,model-version = <3>;
		max77779,force-reset-model-data;
		max77779,fg-model = /bits/ 16 <
			0x9600 0xad10 0xb6f0 0xb890 0xba30 0xbbc0 0xbd60 0xbec0
			0xc030 0xc1e0 0xc600 0xca10 0xce20 0xd230 0xd8c0 0xdf00
			0x0040 0x0170 0x0fe0 0x0c20 0x0f80 0x0d20 0x1830 0x1210
			0x0ef0 0x07a0 0x07b0 0x0710 0x06d0 0x0790 0x0580 0x0580
		>;
		max77779,fg-params = /bits/ 16 <
			/* 0x00C0 */	0xc1b0	/* nNVCfg0 */
			/* 0x00B6 */	0x083b	/* RelaxCFG */
			/* 0x009F */	0x660e	/* nLearnCFG */
			/* 0x000C */	0x4207	/* Config */
			/* 0x00AB */	0x0081	/* Config2 */
			/* 0x00BC */	0x5f00	/* nFullSOCthr */
			/* 0x00A9 */	0x07e5	/* nFullCAPRep */
			/* 0x00B3 */	0x07e5	/* nDesignCap */
			/* 0x0046 */	0x0C80	/* dPacc */
			/* 0x00A5 */	0x07e5	/* nFullCAPNom */
			/* 0x00C6 */	0xa55a	/* nV_empty */
			/* 0x00A0 */	0x260d	/* nQRTable00 */
			/* 0x00A1 */	0x1383	/* nQRTable10 */
			/* 0x00A2 */	0x0a02	/* nQRTable20 */
			/* 0x00A3 */	0x0802	/* nQRTable30 */
			/* 0x00A6 */	0x05a0	/* nRCOMP0 */
			/* 0x00A7 */	0x2002	/* nTempCo */
			/* 0x009C */	0x0276	/* nIChgTerm */
			/* 0x00B2 */	0x3870	/* nMiscCFG */
			/* 0x009E */	0x0400	/* nModelCfg */
			/* 0x00CA */	0xC8FF	/* nThermCfg */
			/* 0x009D */	0xCEA4	/* nFilterCfg */
		>;
		max77779,fg_n_regval = /bits/ 16 <
			0xB7 0x2240	/* nConvgCfg */
			0xC9 0xC8FF	/* nThermCfg2 Register */
		>;
		max77779,fg-aafv = /bits/ 32 <
			  0   95  0xf  0x0276
			 20   90  0xf  0x013b
			 40   85  0xf  0x013b
			 60   80  0xf  0x013b
			 80   75  0xf  0x013b
			100   70  0xf  0x013b
		>;
	};

	/* FL5_LWN_3755_001_G1.txt, b/377555304#comment1 */
	max77779,lwn-4k {
		max77779,batt-id-kohm = <4>;
		max77779,model-version = <2>;
		max77779,force-reset-model-data;
		max77779,fg-model = /bits/ 16 <
			0x9600 0xacd0 0xb6e0 0xb8d0 0xbc20 0xbe20 0xc000 0xc0f0
			0xc250 0xc630 0xc9c0 0xd0b0 0xd330 0xd500 0xd910 0xdf80
			0x0040 0x0180 0x0d50 0x0cf0 0x1150 0x1170 0x1480 0x0d40
			0x0790 0x0730 0x06f0 0x0680 0x05f0 0x06f0 0x0710 0x0710
		>;
		max77779,fg-params = /bits/ 16 <
			/* 0x00C0 */	0xc1b0	/* nNVCfg0 */
			/* 0x00B6 */	0x083b	/* RelaxCFG */
			/* 0x009F */	0x660e	/* nLearnCFG */
			/* 0x000C */	0x4207	/* Config */
			/* 0x00AB */	0x0081	/* Config2 */
			/* 0x00BC */	0x5f00	/* nFullSOCthr */
			/* 0x00A9 */	0x07f4	/* nFullCAPRep */
			/* 0x00B3 */	0x07f4	/* nDesignCap */
			/* 0x0046 */	0x0C80	/* dPacc */
			/* 0x00A5 */	0x07f4	/* nFullCAPNom */
			/* 0x00C6 */	0xa55a	/* nV_empty */
			/* 0x00A0 */	0x1a10	/* nQRTable00 */
			/* 0x00A1 */	0x0f0b	/* nQRTable10 */
			/* 0x00A2 */	0x0a04	/* nQRTable20 */
			/* 0x00A3 */	0x0685	/* nQRTable30 */
			/* 0x00A6 */	0x04d0	/* nRCOMP0 */
			/* 0x00A7 */	0x1402	/* nTempCo */
			/* 0x009C */	0x0276	/* nIChgTerm */
			/* 0x00B2 */	0x3870	/* nMiscCFG */
			/* 0x009E */	0x0400	/* nModelCfg */
			/* 0x00CA */	0xC8FF	/* nThermCfg */
			/* 0x009D */	0xCEA4	/* nFilterCfg */
		>;
		max77779,fg_n_regval = /bits/ 16 <
			0xB7 0x2240	/* nConvgCfg */
			0xC9 0xC8FF	/* nThermCfg2 Register */
		>;
		max77779,fg-aafv = /bits/ 32 <
			  0   95  0xf  0x0276
			 20   90  0xf  0x013b
			 40   85  0xf  0x013b
			 60   80  0xf  0x013b
			 80   75  0xf  0x013b
			100   70  0xf  0x013b
		>;
	};
};
