// SPDX-License-Identifier: GPL-2.0-only
/*
 * frankel device tree source
 *
 * Copyright 2024 Google LLC
 */

/dts-v1/;
/plugin/;

#include "lga-frankel-proto-pinctrl.dtsi"
#include "lga-muzel-common.dtsi"
#include "lga-frankel-common.dtsi"
#include "lga-frankel-proto0-battery.dtsi"

/ {
	board_id = <0x70302>;
	board_rev = <0x000000>;
	fragment@boardbase {
		target-path = "/";
		__overlay__ {
			model = "FRANKEL Proto 0 based on LGA";
			compatible = "google,lga-frankel", "google,lga";
		};
	};
};

