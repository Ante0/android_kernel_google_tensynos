// SPDX-License-Identifier: GPL-2.0-only
/*
 * Muzel touch device tree source
 *
 * Copyright 2024 Google LLC
 */

#include "google-base/platform/lga-platform-touch.dtsi"

&spitouch {
	goog,tbn-enabled;
	goog,tbn-protection-enabled;
	vdd-supply = <&ldo_27s_reg>;
	avdd-supply = <&ldo_26s_reg>;
};
