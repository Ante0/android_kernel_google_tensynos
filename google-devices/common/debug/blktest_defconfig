## google-devices/common/debug/blktest_defconfig
```kconfig
CONFIG_BLK_DEV_NULL_BLK=y
CONFIG_SCSI_DEBUG=y
CONFIG_FAULT_INJECTION=y
CONFIG_BLK_DEV_NULL_BLK_FAULT_INJECTION=y
CONFIG_BLK_DEV_IO_TRACE=y
```

## google-devices/common/debug/debug_api_defconfig
```kconfig
CONFIG_DMA_API_DEBUG=y
CONFIG_DEBUG_SHIRQ=y
CONFIG_DEBUG_OBJECTS=y
CONFIG_DEBUG_OBJECTS_FREE=y
CONFIG_DEBUG_OBJECTS_TIMERS=y
CONFIG_DEBUG_KOBJECT=y
CONFIG_DEBUG_KOBJECT_RELEASE=y
CONFIG_DEBUG_LIST=y
CONFIG_DEBUG_PLIST=y
CONFIG_DEBUG_NOTIFIERS=y
CONFIG_DEBUG_CREDENTIALS=y
# CONFIG_SHADOW_CALL_STACK is not set
```

## google-devices/common/debug/debug_locking_defconfig
```kconfig
CONFIG_SOFTLOCKUP_DETECTOR=y
CONFIG_BOOTPARAM_SOFTLOCKUP_PANIC=y
# TODO(qsliu): Not available on 6.1 on arm64 platform. Enable them on 6.6.
# CONFIG_HARDLOCKUP_DETECTOR=y
# CONFIG_BOOTPARAM_HARDLOCKUP_PANIC=y
CONFIG_DETECT_HUNG_TASK=y
CONFIG_BOOTPARAM_HUNG_TASK_PANIC=y
CONFIG_WQ_WATCHDOG=y
CONFIG_DEBUG_PREEMPT=y
CONFIG_PROVE_LOCKING=y
CONFIG_LOCK_STAT=y
CONFIG_DEBUG_RT_MUTEXES=y
CONFIG_DEBUG_SPINLOCK=y
CONFIG_DEBUG_MUTEXES=y
CONFIG_DEBUG_LOCK_ALLOC=y
CONFIG_DEBUG_ATOMIC_SLEEP=y
CONFIG_DEVMEM=y
# CONFIG_SHADOW_CALL_STACK is not set
```

## google-devices/common/debug/debug_memory_defconfig
```kconfig
CONFIG_SOFTLOCKUP_DETECTOR=y
CONFIG_BOOTPARAM_SOFTLOCKUP_PANIC=y
# TODO(qsliu): Not available on 6.1 on arm64 platform. Enable them on 6.6.
# CONFIG_HARDLOCKUP_DETECTOR=y
# CONFIG_BOOTPARAM_HARDLOCKUP_PANIC=y
CONFIG_DETECT_HUNG_TASK=y
CONFIG_BOOTPARAM_HUNG_TASK_PANIC=y
CONFIG_WQ_WATCHDOG=y
CONFIG_RCU_EQS_DEBUG=y
CONFIG_LOCK_STAT=y
CONFIG_DEVMEM=y
CONFIG_DEBUG_OBJECTS=y
CONFIG_DEBUG_OBJECTS_FREE=y
CONFIG_DEBUG_OBJECTS_TIMERS=y
CONFIG_DEBUG_OBJECTS_WORK=y
CONFIG_DEBUG_OBJECTS_RCU_HEAD=y
CONFIG_DEBUG_OBJECTS_PERCPU_COUNTER=y
CONFIG_DEBUG_VM=y
CONFIG_DEBUG_VM_RB=y
CONFIG_DEBUG_MEMORY_INIT=y
CONFIG_DEBUG_STACK_USAGE=y
CONFIG_DEBUG_PAGEALLOC=y
CONFIG_DEBUG_PAGEALLOC_ENABLE_DEFAULT=y
CONFIG_SCHED_STACK_END_CHECK=y
CONFIG_SLUB_DEBUG=y
CONFIG_PAGE_OWNER=y
CONFIG_PAGE_POISONING=y
CONFIG_DEBUG_RT_MUTEXES=y
CONFIG_DEBUG_SPINLOCK=y
CONFIG_DEBUG_MUTEXES=y
CONFIG_DEBUG_PREEMPT=y
CONFIG_DEBUG_ATOMIC_SLEEP=y
CONFIG_DEBUG_LIST=y
# CONFIG_SHADOW_CALL_STACK is not set
```

## google-devices/common/debug/khwasan_defconfig
```kconfig
CONFIG_KASAN=y
# CONFIG_KASAN_SW_TAGS is not set
CONFIG_KASAN_HW_TAGS=y
CONFIG_KCOV=y
CONFIG_DEBUG_INFO=y
CONFIG_FRAME_WARN=0
```

## google-devices/common/etm/etm_defconfig
```kconfig
# CONFIG_MODULE_SIG_ALL is not set
CONFIG_CORESIGHT=m
CONFIG_CORESIGHT_LINK_AND_SINK_TMC=m
CONFIG_CORESIGHT_SOURCE_ETM4X=m
```

## google-devices/muzel/Kconfig.ext.muzel
```kconfig
# SPDX-License-Identifier: GPL-2.0-only

# soc level Kconfigs are at private/devices/google/lga/Kconfig.ext.lga

source "$(KCONFIG_EXT_MODULES_PREFIX)private/google-modules/fingerprint/qcom/qfs4008/Kconfig"

source "$(KCONFIG_EXT_MODULES_PREFIX)private/google-modules/misc/h2omg/Kconfig"

source "$(KCONFIG_EXT_MODULES_PREFIX)private/google-modules/radio/samsung/s5400/Kconfig"
```

## google-devices/rango/Kconfig.ext.rango
```kconfig
# SPDX-License-Identifier: GPL-2.0-only

# soc level Kconfigs are at private/devices/google/lga/Kconfig.ext.lga

source "$(KCONFIG_EXT_MODULES_PREFIX)private/google-modules/radio/samsung/s5400/Kconfig"

source "$(KCONFIG_EXT_MODULES_PREFIX)private/google-modules/touch/fts/fst2/Kconfig"
```

## google-devices/raviole/Kconfig.ext.raviole
```kconfig
# SPDX-License-Identifier: GPL-2.0

source "$(KCONFIG_EXT_MODULES_PREFIX)private/google-modules/radio/samsung/s5300/Kconfig"

source "$(KCONFIG_EXT_MODULES_PREFIX)private/google-modules/touch/common/Kconfig"

source "$(KCONFIG_EXT_MODULES_PREFIX)private/google-modules/touch/fts/ftm5_legacy/Kconfig"

source "$(KCONFIG_EXT_MODULES_PREFIX)private/google-modules/touch/sec/Kconfig"
```

## google-devices/tangorpro/Kconfig.ext.tangorpro
```kconfig
# SPDX-License-Identifier: GPL-2.0-only

source "$(KCONFIG_EXT_MODULES_PREFIX)private/google-modules/touch/common/Kconfig"
```

## google-devices/tangorpro/pogo/Kconfig
```kconfig
# SPDX-License-Identifier: GPL-2.0-only
#
# Copyright (C) 2022, Google LLC

config POGO_TRANSPORT
	tristate "Pogo transport management driver"
	depends on TYPEC_MAX77759
	select GOOGLE_LOGBUFFER
	help
	  Pogo transport management driver
```

## google-devices/tangorpro/tangorpro_defconfig
```kconfig
# In-tree kernel configs. Note that these configs are only applied to
# non-GKI modules. Make sure they're compatible with GKI.
CONFIG_REGULATOR_RT4801=m
CONFIG_REGULATOR_TPS65132=m
CONFIG_BACKLIGHT_LP855X=m
CONFIG_LEDS_PWM=m

# private/google-modules/touch/common/Kconfig
CONFIG_TOUCHSCREEN_HEATMAP=m
CONFIG_TOUCHSCREEN_TBN=m
CONFIG_TOUCHSCREEN_OFFLOAD=m
CONFIG_GOOG_TOUCH_INTERFACE=m
CONFIG_GOOG_USI_STYLUS=m
```

## google-modules/amplifiers/cs35l43/Kconfig
```kconfig
# SPDX-License-Identifier: GPL-2.0-only
# Helper to resolve issues with configs that have SPI enabled but I2C
# modular, meaning we can't build the codec driver in with I2C support.
# We use an ordered list of conditional defaults to pick the appropriate
# setting - SPI can't be modular so that case doesn't need to be covered.

config CONFIG_FW_CS_DSP
	tristate
	default n

config SND_SOC_CS35L43
	tristate "Cirrus Logic CS35L43 CODEC"

config SND_SOC_CS35L43_I2C
	tristate "Cirrus Logic CS35L43 CODEC (I2C)"
	depends on I2C
	select REGMAP_I2C
	select SND_SOC_CS35L43

config SND_SOC_CS35L43_SPI
	tristate "Cirrus Logic CS35L43 CODEC (SPI)"
	depends on SPI_MASTER
	select REGMAP_SPI
	select SND_SOC_CS35L43
```

## google-modules/amplifiers/tas256x/defconfig
```kconfig
CONFIG_SND_SOC_TAS256X=m
CONFIG_TAS256X_CODEC=y
CONFIG_TAS256X_MISC=y
CONFIG_TAS256X_REGMAP=y
```

## google-modules/display/common/gs_panel/Documentation/devicetree/bindings/display/gs-drm-connector.yaml
```yaml
# SPDX-License-Identifier: GPL-2.0-only
%YAML 1.2
---
$id: http://devicetree.org/schemas/display/gs-drm-connector.yaml#
$schema: http://devicetree.org/meta-schemas/core.yaml#

title: Google Silicon Display Panel Connector Driver (Generic)

maintainers:
  - Taylor Nelms <tknelms@google.com>

description:
  This document describes device tree properties for Google Silicon's display
  panel connector driver framework.

properties:
  compatible:
    $ref: /schemas/dtcore.yaml#/properties/compatible
    const: google,drm_connector

  port:
    $ref: /schemas/graph.yaml#/properties/port
    description: Logically connects connector to encoder dsi host

  google,device-index:
    description:
      In multi-panel scenarios, this index is used to distinguish the primary
      display connector from the secondary display connector. If not present,
      is assumed to be the primary panel connector.
    enum:
      - 0 # Primary
      - 1 # Secondary

  "#address-cells":
    const: 1
  "#size-cells":
    const: 0

patternProperties:
  "^panel.*$":
    $ref: gs-panel.yaml
    description:
      Any number of possible panels may be assigned as children of the connector.
      When resolving panel choice, their "label" properties will be used to
      disambiguate and select the correct panel driver.
      In cases where the panels are named/addressed as "@0", "@1", "@2", etc, require
      both the properties "#address-cells" and "#size-cells"

required:
  - compatible
  - port

examples:
  - |
    gs_connector: gs-drm-connector {
              compatible = "google,drm_connector";
              label = "gs-drm-connector";

              google,device-index = <0>;

              #address-cells = <1>;
              #size-cells = <0>;

              port {
                      /* input */
                      dsim0_connector_in: endpoint {
                              remote-endpoint = <&dsi0_connector_out>;
                      };
              };

              /* panels will go here */
              google_gs_hk3: panel@0 {
                      compatible = "google,gs-hk3";
                      label = "google-hk3";
                      channel = <0>;
                      touch = <&spitouch>;

                      /* reset, power */
                      reset-gpios = <&gpp0 0 GPIO_ACTIVE_HIGH>;
                      vci-supply = <&m_ldo14_reg>;
                      vddi-supply = <&s_bucka_reg>;
                      vddd-supply = <&disp_vddd>;
                      vddd-gpios = <&gpp21 5 GPIO_ACTIVE_HIGH>;
              };

              panel@1 {
                      compatible = "google,panel-gs-simple";
                      label = "panel-gs-simple";
                      channel = <0>;

                      /* reset, power */
                      reset-gpios = <&gpp0 0 GPIO_ACTIVE_HIGH>;
              };
      };
```

## google-modules/display/interfaces/synopsys/dwc_dptx/Kconfig
```kconfig
config DWC_DPTX
	tristate "DP TX: control DP Tx driver"
	select DRM_DISPLAY_HELPER
	select DRM_DISPLAY_DP_HELPER
	select DRM_DISPLAY_HDCP_HELPER
	help
	  Choose y to include the dptx driver. Driver controls the main DP Tx
	  functionalities.

config DWC_DPTX_PCI
	tristate "DP TX: PCI interface"
	depends on DWC_DPTX
	help
	  Choose y to include the dptx pci interface. This driver controls the
	  PCI interface for the DP Tx driver.

config DWC_DPTX_AUDIO
	bool "DP TX: Audio"
	depends on DWC_DPTX
	depends on EXTCON
	help
	  Choose y to enable DP Audio support.
	  This driver controls the DP Audio support for the DP Tx driver.
	  Depends on DWC_DPTX driver.
	  Depends on EXTCON to notify audio device connection.

config DWC_DPTX_HDCP
	bool "DP TX: HDCP"
	depends on DWC_DPTX
	default y if TZ_PROT
	help
	  Enable HDCP support for the DisplayPort transmitter driver.
	  This option allows the driver to handle High-bandwidth Digital
	  Content Protection, enabling the transmission of protected content
	  over the DP interface. It defaults to enabled when TrustZone
	  protection (TZ_PROT) is active.
```

## google-modules/display/vsi-drm/Documentation/devicetree/bindings/display/verisilicon/vs-drm.txt
```
Device-Tree bindings for VeriSilicon DRM master device

VeriSilicon DRM master device is a virtual device needed to list all
display controller or other display interface nodes that comprise the
graphics subsystem.

Required properties:
- compatible: value should be "verisilicon,display-subsystem".

- ports: Should contain a list of phandles pointing to display interface ports
  of display controller devices

Example 1:

display-subsystem: display-subsystem-dc8200 {
	compatible = "verisilicon,display-subsystem";
	ports = <&dc_out_dpi0 &dc_out_dpi1>;
};

Example 2:

display_subsystem: display-subsystem-dc9400 {
	compatible = "verisilicon,display-subsystem";
	ports = <&dc_out_0 &dc_out_1 &dc_out_2 &dc_out_3 &dc_out_4>;
};
```

## google-modules/display/vsi-drm/Documentation/devicetree/bindings/display/verisilicon/vs-dsi2h.yaml
```yaml
# SPDX-License-Identifier: (GPL-2.0-only OR BSD-2-Clause)
%YAML 1.2
---
$id: http://devicetree.org/schemas/display/verisilicon/dw-cdphy.yaml#
$schema: http://devicetree.org/meta-schemas/core.yaml#

title: Synopsys DSI2 host controller connected to VSI DPU.

description: |
  This document defines device tree properties for the Synopsys DSI2 host
  controller connected to VSI DPU.

properties:
  compatible:
    const: verisilicon,dc9x00-mipi-dsi2h

  reg:
    maxItems: 1

  verisilicon,mux-id:
    maxItems: 1
    description: DPU out path for this dsi host controller

  interrupts:
    description: report dsi events or errors

  phys:
    minItems: 1

  phy-names:
    items:
      - const: dw-mipi-cdphy

  max_data_lanes:
    description: total lanes
    minItem: 1

  is_cphy:
    type: boolean
    description: false for dphy true for cphy

  clk_type:
    minItem: 1
    description: 0 for continuous clock, 1 for non-continuous clock

  mode_ctrl:
    minItem: 1
    description: 0 idle, 1 auto calculation, 2 command, 3 video, 4 data stream

  auto_calc_en:
    description: enable auto timing calculation.

  ppi_width:
    minItem: 1
    description: 0: 8 bits, 1: 16 bits, 2: 32 bits

  high_speed:
    type: boolean
    description: enable high speed

  bta:
    type: boolean
    description: enable bta

  eotp:
    type: boolean
    description: enable end of transmission packet.

  tear_effect:
    type: boolean
    description: |
      enable to allow controller to receive accurate timing information
      from the command mode displays.

  scrambling:
    type: boolean
    description: enable data scrambling to mitigate EM interferences on the transmissions.

  vid_mode_type:
    description: |
      0 non-burst with sync pulses, 1 no-burst with sync events, 2 burst mode.

  hs_en:
    description: |
      array of switches to forces the link to be kept in HS by sending blanking packets
      in specified modes
    items:
      - description: vfp
      - description: vbp
      - description: vsa
      - description: hfp
      - description: hbp
      - description: hsa

  datarate:
    description: phy data rate in Mbps.

  lp2hs_time:
    description: |
      phy LP to HS transition time in fixed point number (13 integral
      bits and 16 fractional bits)

  hs2lp_time:
    description: |
      phy HS to LP transition time in fixed point number (13 integral
      bits and 16 fractioinal bits)

  sys_clk:
    description: APB clk in KHz.

  ipi_clk:
    description: IPI clk in KHz

  phy_clk:
    description: Phy clk in KHz

  ports:
    $ref: /schemas/graph.yaml#/properties/ports

    properties:
      port@0:
        $ref: /schemas/graph.yaml#/properties/port
        description: Input node to receive pixel data.

      port@1:
        $ref: /schemas/graph.yaml#/properties/port
        description: DSI output node to panel.

  dynamic_hs_clk_en:
    description: enable dynamic hs_clk (datarate) switch.

required:
  - compatible
  - reg
  - verisilicon,mux-id
  - phys
  - phy-names
  - clk_type
  - mode_ctrl
  - datarate
  - sys_clk
  - phy_clk
  - ipi_clk
  - ports

example:
  - |
    dsi2h0: dsi2host@3d8000 {
        compatible = "verisilicon,dc9x00-mipi-dsi2h";
        reg = <0x3d8000 0x0800>; /* DWC MIPI DSI2 HOST */

        verisilicon,mux-id = <0>
        phys = <&dw_mipi_cdphy_g301 0>;
        phy-names = "dw-mipi-cdphy";
        /* 0: continuous clock, 1: non-continuous clock */
        clk_type = <1>;
        /* 0: idel, 1: auto calculation, 2: command, 3: video, 4: data stream */
        mode_ctrl = <3>;
        hs_en = <1 1 1 0 1 1>;
        /* Mbps */
        datarate = <960>;
        sys_clk = <960>;
        phy_clk = <960>;
        ipi_clk = <96>;
        ports {
            #address-cells = <1>;
            #size-cells = <0>;
            /* input */
            port@0 {
                reg = <0>;
                dsi_in: endpoint {
                    remote-endpoint = <&dc_port0_dsi_out>;
                };
            };
            /* output */
            port@1 {
                reg = <1>;
                dsi_out: endpoint {
                    remote-endpoint = <&panel0_dsi_in>;
                };
            };
        };
    };
```
