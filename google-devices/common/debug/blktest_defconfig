## google-modules/display/vsi-drm/Documentation/devicetree/bindings/display/verisilicon/vs_dp_enc.yaml
```yaml
# SPDX-License-Identifier: (GPL-2.0-only OR BSD-2-Clause)
%YAML 1.2
---
$schema: http://devicetree.org/meta-schemas/core.yaml#

title: Verisilicon DisplayPort Encoder

description: |
  This document defines the device tree bindings for the Verisilicon
  DisplayPort encoder.

properties:
  compatible:
    const: verisilicon,dp-encoder

  verisilicon,mux-id:
    type: int
    description: DPU output path for DisplayPort.

  ports:
    $ref: /schemas/graph.yaml#/properties/ports
    description:
      Port node for the DisplayPort encoder. Requires two ports:
      - port@0: Input node.
      - port@1: DP encoder output node to DP driver.

  power-domains:
    description:
      Power domain the device belongs to. Used for runtime power
      management.

required:
  - compatible
  - verisilicon,mux-id
  - power-domains
  - ports

examples:
  - |
   dp_encoder: dp-encoder {
        compatible = "verisilicon,dp-encoder";
        verisilicon,mux-id = <0>;
        power-domains = <&dp_powerdomain>;

        ports {
            #address-cells = <1>;
            #size-cells = <0>;
            /* input */
            port@0 {
                reg = <0>;
                dp_port0_in: endpoint {
                    remote-endpoint = <&dc_dp_out>;
                };
            };

            /* output */
            port@1 {
                reg = <1>;
                dp_port1_out: endpoint {
                    remote-endpoint = <&dpdriver_in>;
                };
            };
        };
    };
```

## google-modules/display/vsi-drm/bridge/synopsys/dsi2host/Kconfig
```kconfig
# SPDX-License-Identifier: GPL-2.0
config DRM_DW_MIPI_DSI2H
	tristate "Synopsys Designware MIPI DSI2 Host Controller"
	select DRM_MIPI_DSI
	select DRM_PANEL_BRIDGE
	select REGMAP_MMIO
	help
	  Support for the DesignWare DSI2 Host controller.
```

## google-modules/display/vsi-drm/phy/synopsys/Kconfig
```kconfig
# SPDX-License-Identifier: GPL-2.0

config DRM_DW_MIPI_CDPHY
	tristate "DesignWare MIPI CDPHY"
	select GENERIC_PHY
	select GENERIC_PHY_MIPI_DPHY
	help
	 Enables support for Synopsys MIPI CD-PHY Tx driver.
```

## google-modules/fingerprint/goodix/gf3626/Kconfig
```kconfig
# SPDX-License-Identifier: GPL-2.0

config GOODIX_FINGERPRINT_GF3626
	tristate "generic goodix fingerprint driver"
	default n
	help
	add support for goodix fingerprint driver.
```

## google-modules/gpu/mali_pixel/Kconfig
```kconfig
# SPDX-License-Identifier: GPL-2.0
#
# (C) COPYRIGHT 2019-2020 ARM Limited. All rights reserved.
#
# This program is free software and is provided to you under the terms of the
# GNU General Public License version 2 as published by the Free Software
# Foundation, and any use by you of this program is subject to the terms
# of such GNU license.
#
# This program is distributed in the hope that it will be useful,
# but WITHOUT ANY WARRANTY; without even the implied warranty of
# MERCHANTABILITY or FITNESS FOR A PARTICULAR PURPOSE. See the
# GNU General Public License for more details.
#
# You should have received a copy of the GNU General Public License
# along with this program; if not, you can access it online at
# http://www.gnu.org/licenses/gpl-2.0.html.
#
#

config MALI_MEMORY_GROUP_MANAGER
	bool "MALI_MEMORY_GROUP_MANAGER"
	help
	  This option enables an example implementation of a memory group manager
	  for allocation and release of pages for memory pools managed by Mali GPU
	  device drivers.

config MALI_MEMORY_GROUP_MANAGER_DEBUG_FS
	depends on MALI_MEMORY_GROUP_MANAGER && DEBUG_FS
	bool "Enable Mali memory group manager debugfs nodes"
	default n
	help
	  Enables support for memory group manager debugfs nodes

config MALI_PRIORITY_CONTROL_MANAGER
	bool "MALI_PRIORITY_CONTROL_MANAGER"
	help
	  This option enables an implementation of a priority control manager
	  for determining the target GPU scheduling priority of a process.

config MALI_PROTECTED_MEMORY_ALLOCATOR
	bool "MALI_PROTECTED_MEMORY_ALLOCATOR"
	help
	  This option enables an implementation of a protected memory allocator
	  for allocation and release of pages of protected memory for use by
	  Mali GPU device drivers.

config MALI_PIXEL_STATS
	bool "mali pixel stats"
	depends on PIXEL_STAT
	help
	  mali pixel stats

config MALI_PIXEL_GPU_SLC
	bool "mali pixel gpu slc"
	help
	  mali pixel gpu slc

config MALI_PIXEL_GPU_SLC_ACPM_SIGNAL
	bool "mali pixel gpu slc acpm signal"
	depends on MALI_PIXEL_GPU_SLC && CONFIG_SOC_ZUMA
	default y
	help
	  mali pixel gpu slc acpm signal
```

## google-modules/iif/Kconfig
```kconfig
# SPDX-License-Identifier: GPL-2.0-only

config IIF
	tristate "IIF framework"
	help
		This driver supports the Inter-IP fence framework. Say Y if you want to include this
		driver in the kernel.
```
