// SPDX-License-Identifier: GPL-2.0-only
/*
 * Usecases specific to Stallion Platform
 *
 * Copyright 2024 Google LLC
 *
 */

/* system use cases */
&max77779_chg {
	/* external boost */
	max77779,bst-on-gpio = <&s2mpg15_gpio 4 GPIO_ACTIVE_HIGH>;  /* EXT_BST_EN */
	max77779,extbst-mode-gpio = <&s2mpg15_gpio 9 GPIO_ACTIVE_HIGH>; /* EXT_BST_MODE */
	max77779,extbst-ctl-gpio = <&max77759_tcpc_gpio 0 GPIO_ACTIVE_HIGH>; /* OTG_PWR_EN */
	post-init-providers = <&max77759_tcpc_gpio>;

	max77779,chrg-byp-en;

	/* for OTG related usecase*/
	max77779,rx-to-rx-otg-en; /* support RX -> RX+OTG */
	max77779,ext-otg-only; /* use external OTG only */
	max77779,wcin-inlim-headroom = <40000>;
	max77779,ext-rx-otg; /* support external boost for RX and OTG */
};
