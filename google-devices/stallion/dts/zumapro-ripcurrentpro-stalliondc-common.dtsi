// SPDX-License-Identifier: GPL-2.0-only
/*
 * ripcurrentpro + Stallion DC board device tree source
 *
 * Copyright 2024 Google LLC
 */


#include "zumapro/zumapro-board-common.dtsi"
#include "zumapro/zumapro-ripcurrentpro-bcl-sapwood.dtsi"
#include "zuma/zuma-ripcurrent-camera-pmic.dtsi"
#include "zuma/zuma-ripcurrent-camera.dtsi"
#include "zumapro/zumapro-ripcurrentpro-usb.dtsi"

#include "zuma-ripcurrentpro-stallion-battery.dtsi"
#include "zuma/zuma-typec.dtsi"
#include "zuma/zuma-ripcurrent-gsa-gsc.dtsi"

#include "zuma-ripcurrentpro-stalliondc-battery.dtsi"
#include "zuma-ripcurrentpro-stalliondc-charging.dtsi"
#include "zuma-ripcurrentpro-stalliondc-typec.dtsi"
#include "zuma-ripcurrentpro-stalliondc-usecases.dtsi"
#include "zuma-ripcurrentpro-stalliondc-wcharger.dtsi"
