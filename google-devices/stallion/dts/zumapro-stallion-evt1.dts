// SPDX-License-Identifier: GPL-2.0-only
/*
 * Stallion board device tree source
 *
 * Copyright 2024 Google LLC
 */

/dts-v1/;
/plugin/;

#include "zumapro-stallion-common.dtsi"
#include "zuma/zuma-cp-s5400-phone-gnss.dtsi"
#include "zuma-stallion-gnss-samsung.dtsi"
#include "zuma/max777xx-fwupdate.dtsi"

/ {
	board_id = <0x61303>;
	board_rev = <0x010000>;
	fragment@boardbase {
		target-path = "/";
		__overlay__ {
			model = "ZUMA PRO STALLION EVT 1.0 on ZUMA PRO";
			compatible = "google,ZUMA PRO STALLION", "google,ZUMA PRO";
		};
	};
};
