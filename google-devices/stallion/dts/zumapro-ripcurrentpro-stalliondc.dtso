// SPDX-License-Identifier: GPL-2.0-only
/*
 * ripcurrentpro + Stallion DC board device tree source
 *
 * Copyright 2024 Google LLC
 */

/dts-v1/;
/plugin/;

#include "zumapro-ripcurrentpro-stalliondc-common.dtsi"
#include "zumapro/zumapro-board-gps.dtsi"
#include "zuma/zuma-ripcurrent24-ultrasonic-udfps.dtsi"

/ {
	board_id = <0x60d01>;
	board_rev = <0x010005>;
	fragment@boardbase {
		target-path = "/";
		__overlay__ {
			model = "ZUMA PRO Ripcurrentpro Stallion charging daughtercard configuration based on ZUMA PRO";
			compatible = "google,ZUMA PRO Ripcurrentpro", "google,ZUMA PRO";
		};
	};
};
