// SPDX-License-Identifier: GPL-2.0-only
/*
 * Zuma24 board device tree source
 *
 * Copyright 2024 Google LLC
 */

#include "zumapro/zumapro-common.dtsi"
#include "zuma/gs101-faceauth-dma-heap.dtsi"

#include "zuma-stallion-battery-common.dtsi"
#include "zuma-stallion-camera-pmic.dtsi"
#include "zuma-stallion-charging-common.dtsi"
#include "zuma/zuma-ripcurrent-gsa-gsc.dtsi"
#include "zumapro/zumapro-board-cp-s5400-sit.dtsi"
#include "zumapro-stallion-cp-features.dtsi"
#include "zumapro-stallion-cp-s5400-thermal-zone.dtsi"
#include "zumapro/zumapro-board-bluetooth_wakectrl.dtsi"
#include "zuma-stallion-ese.dtsi"
#include "zuma-stallion-nfc.dtsi"
#include "zuma/zuma-board-ultrasonic-udfps.dtsi"
#include "zumapro-stallion-audio-common-tas2572.dtsi"
#include "zuma-stallion-common-touch.dtsi"
#include "zumapro/zumapro-board-pcie.dtsi"
#include "zumapro/zumapro-board-pcie-cp-s5400-a1.dtsi"
#include "zumapro-stallion-haptics.dtsi"
#include "zuma-stallion-thermal.dtsi"
#include "zuma-stallion-usb.dtsi"
#include "zuma-stallion-typec.dtsi"
#include "zumapro-stallion-bcl.dtsi"
#include "zumapro-stallion-usecases.dtsi"
#include "zumapro-stallion-sbbm.dtsi"

#include "zuma-stallion-battery.dtsi"
#include "zuma-stallion-charging.dtsi"
#include "zumapro-stallion-wcharger.dtsi"
#include "zumapro-stallion-audio.dtsi"
#include "zuma-stallion-camera.dtsi"
#include "zuma-stallion-display.dtsi"
#include "zumapro-stallion-udfps.dtsi"
#include "zuma-stallion-wlan.dtsi"
#include "zumapro-stallion-pmic.dtsi"
