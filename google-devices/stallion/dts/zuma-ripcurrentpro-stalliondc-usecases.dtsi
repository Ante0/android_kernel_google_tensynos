// SPDX-License-Identifier: GPL-2.0-only
/*
 * Usecases specific to the ripcurrentpro + Stallion DC platform
 *
 * Copyright 2024 Google LLC
 *
 */

/* system use cases */
&max77779_chg {
	max77779,bst-on-gpio = <&s2mpg14_gpio 4 GPIO_ACTIVE_HIGH>;  /* EXT_BST_EN */
	max77779,extbst-ctl-gpio = <&max77759_tcpc_gpio 0 GPIO_ACTIVE_HIGH>;
	post-init-providers = <&max77759_tcpc_gpio>;

	max77779,chrg-byp-en;

	/* for OTG related usecase*/
	max77779,rx-to-rx-otg-en; /* support RX -> RX+OTG */
	max77779,ext-otg-only; /* use external OTG only */
};
