// SPDX-License-Identifier: GPL-2.0-only
/*
 * Charging device tree entries for the Caimito platform
 *
 * Copyright 2024 Google LLC
 *
 */
#include "zuma/zuma-charging.dtsi"

&google_cpm {
	google,set-mdis-to-wlc;
	// thermal budgets
	google,mdis-thermal-mitigation =
	<3710000 3571000 3443000 3297000 3162000 3040000 2918000 2810000 2703000
	 2598000 2493000 2330000 2200000 2080000 1968000 1865000 1770000 1684000
	 1595000 1506000 1444000 1382000 1351000 1320000 1273000 1225000>;
	// PD+main-charger, WLC+main-charger
	google,mdis-out0-limits =
	<4000000 3880000 3760000 3640000 3520000 3400000 3280000 3160000 3040000
	 2920000 2800000 2680000 2560000 2440000 2320000 2200000 2080000 1960000
	 1840000 1720000 1600000 1480000 1360000 1240000 1120000 1000000
	 1100000 1100000 1100000 1100000 1100000 1100000 1100000 1100000 1100000
	 1100000 1100000 1100000 1050000 1000000 950000  900000  850000  800000
	 750000  700000  650000  600000  550000  500000  450000  400000>;
	// PPS_CP+pca94xx-mains, // WLC_CP+pca94xx-mains
	google,mdis-out1-limits =
	<6000000 5840000 5680000 5520000 5360000 5200000 5040000 4880000 4720000
	 4560000 4400000 4240000 4080000 3920000 3760000 3600000 3440000 3280000
	 3120000 2960000 2800000 2640000 2480000 2320000 2160000 2000000
	 4800000 4600000 4400000 4200000 4000000 3800000 3600000 3400000 3200000
	 3000000 2800000 2600000 2400000 2200000 2000000 1800000 1600000 1400000
	 1200000 1000000 900000  800000  700000  600000  500000  400000>;
};


&max77779_chg {
	max77779,wlc-inlim-cv;
};

&google_charger {
	google,bd-resume-abs-temp = <300>;
	google,bd-trigger-temp = <400>;
};
