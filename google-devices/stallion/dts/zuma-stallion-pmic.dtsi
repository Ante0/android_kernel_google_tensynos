// SPDX-License-Identifier: GPL-2.0-only
/*
 * Stallion pmic device tree source
 *
 * Copyright 2024 Google LLC
 *
 */
&s_ldo16_reg {
	regulator-initial-mode = <SEC_OPMODE_OFF>;
	schematic-name = "L16S_SPARE";
	subsys-name = "Spare";
};

&s_ldo17_reg {
	regulator-initial-mode = <SEC_OPMODE_OFF>;
	schematic-name = "L17S_SPARE";
	subsys-name = "Spare";
};
