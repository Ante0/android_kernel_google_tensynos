// SPDX-License-Identifier: GPL-2.0-only
/*
 * Charging device tree entries specific to Stallion devices
 *
 * Copyright 2024 Google LLC
 *
 */

&hsi2c_10 {
	#address-cells = <1>;
	#size-cells = <0>;
	status = "okay";
	clock-frequency = <400000>;

	#include "zumapro-charge-pump-hl7132.dtsi"
};
