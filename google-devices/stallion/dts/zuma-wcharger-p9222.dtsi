// SPDX-License-Identifier: GPL-2.0-only
/*
 * Wireless Charger config for P9222.
 * Intended to be included into the approriate I2C bus.
 *
 * Copyright 2024 Google LLC
 */
p9222: p9222@61 {
	status = "disabled";
	compatible = "idt,p9222";
	reg = <0x61>;


	/* Support p9412 GPIO */
	idt,has_p9412_gpio;

	idt,has_rtx = <0>;

	google,power_mitigate_threshold = <90>;
	google,has-sw-ramp;
	google,epp_dcicl_default_ma = <750000>;
	google,bpp_iop_vout_mv = <5500>;
	google,bpp_ask_mod_fet = /bits/ 8 <0xC0>;
	google,bpp_freq109_icl_ma = <400000>;
	google,bpp_freq109_vout_mv = <5000>;


	pinctrl-names = "default";

	idt,max_vout_mv = <10000>;  /* max voltage in mV */

	p9xxx_gpio: p9xxx_gpio {
		gpio-controller;
		#gpio-cells = <2>;
		ngpios = <16>;
	};
};
