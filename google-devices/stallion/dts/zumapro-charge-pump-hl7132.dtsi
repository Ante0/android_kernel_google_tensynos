// SPDX-License-Identifier: GPL-2.0-only
/*
 * Charge Pump config for HL7132.
 * Intended to be included into the approriate I2C bus.
 *
 * Copyright 2024 Google LLC
 */

hl7132_dc: hl7132@5e {
	compatible = "hl,hl7132";
	reg = <0x5e>;

	hl7132,psy_name = "dc-mains";

	pinctrl-names = "default";

	hl7132,vbat_reg-voltage = <4600000>; /* 4.6V */

	hl7132,input-itopoff = <500000>; /* 500mA */
	hl7132,switching-frequency = <3>; /* 980KHz */

	hl7132,irq-gpio = <&max77779_sgpio 6 GPIO_ACTIVE_LOW>; /* HL7132 INTB */

	/* disable USBC NTC */
	hl7132,ntc-threshold = <0>; /* disabled */

	/* USBC thermal zone */
	google,usb-port-tz-name = "usbc-therm-adc";

	hl7132,google_cpm = <&google_cpm>;
};
