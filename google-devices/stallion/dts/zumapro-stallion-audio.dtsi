// SPDX-License-Identifier: GPL-2.0-only
/*
 * stallion audio device tree source
 *
 * Copyright 2025 Google LLC
 */

 &aoc {
    aoc-board-cfg = "STA5";
    aoc-board-id = <0x61302>;
    aoc-board-rev = <0x10000>;
    prevent-fw-load = <0x0>;
};
