// SPDX-License-Identifier: GPL-2.0-only
/*
 * Side fingerprint device tree source
 *
 * Copyright 2024 Google LLC
 */

&odm {
	goodixfp: goodixfp {
		status = "okay";
		compatible = "goodix,fingerprint";
		interrupt-parent = <&cpm_pinctrl>;
		interrupts = <XCPM_EINT_13 0 0>;
		spi-max-frequency = <1000000>;
		pinctrl-names = "default";
		pinctrl-0 = <&keyfps2aoc_ap_int_l>;
		fp-gpio-irq = <&cpm_pinctrl XCPM_EINT_13 GPIO_ACTIVE_LOW>;
		fp-gpio-reset = <&lsioe_pinctrl XLSIOE_CLI7_PIN2 GPIO_ACTIVE_LOW>;
		vdd_io-supply = <&ldo_25s_reg>;
		spi-gpio-provider = <&lsios_pinctrl>;
	};
};

/* update gpio-reserved-ranges property to exclude FPS SPI pins from pictrl driver */
&lsios_pinctrl {
	gpio-reserved-ranges = <15 4>, <54 1>;
};
