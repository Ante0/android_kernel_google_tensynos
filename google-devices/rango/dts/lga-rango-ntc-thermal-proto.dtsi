// SPDX-License-Identifier: GPL-2.0-only
/*
 * Thermal device tree source
 *
 * Copyright 2024 Google LLC
 */

&thermal_zones_laguna {
	usb_pwr_therm {
		status = "disabled";
	};

	charging_therm {
		status = "okay";
	};
};
