// SPDX-License-Identifier: GPL-2.0-only
/*
 * Battery device tree entries
 *
 * Copyright 2024 Google LLC
 *
 */

max77779,config {

	/* RG5B-ATL-3809-G1.ini.txt.overlay, b/390036580#comment4 */
	max77779,atl-1k {
		max77779,batt-id-kohm = <1>;
		max77779,model-version = <3>;
		max77779,force-reset-model-data;
		max77779,fg-model = /bits/ 16 <
			0x98e0 0xaf10 0xb810 0xb8d0 0xba20 0xbc50 0xbd40 0xbf00
			0xc0f0 0xc2e0 0xc630 0xc990 0xcec0 0xd390 0xd920 0xdee0
			0x0050 0x0180 0x1bb0 0x0d70 0x0d80 0x1930 0x1400 0x1160
			0x0ce0 0x0730 0x07f0 0x06f0 0x06a0 0x0690 0x06a0 0x06a0
		>;
		max77779,fg-params = /bits/ 16 <
			/* 0x00C0 */	0xc1b0	/* nnvcfg0 */
			/* 0x00B6 */	0x043b	/* nrelaxcfg */
			/* 0x009F */	0x660e	/* nLearnCFG */
			/* 0x000C */	0x4207	/* Config */
			/* 0x00AB */	0x0081	/* Config2 */
			/* 0x00BC */	0x5f00	/* nFullSOCThr */
			/* 0x00A9 */	0x0230	/* nfullcaprep */
			/* 0x00B3 */	0x0230	/* ndesigncap */
			/* 0x0046 */	0x0c80	/* dPacc */
			/* 0x00A5 */	0x0230	/* nfullcapnom */
			/* 0x00C6 */	0xa55a	/* nVEmpty */
			/* 0x00A0 */	0x3c00	/* nQRTable00 */
			/* 0x00A1 */	0x1a00	/* nQRTable10 */
			/* 0x00A2 */	0x0900	/* nQRTable20 */
			/* 0x00A3 */	0x0680	/* nQRTable30 */
			/* 0x00A6 */	0x0480	/* nRCOMP0 */
			/* 0x00A7 */	0x1e02	/* nTempCo */
			/* 0x009C */	0x00b4	/* nichgterm */
			/* 0x00B2 */	0x3870	/* nmisccfg */
			/* 0x009E */	0x0400	/* nModelCfg */
			/* 0x00CA */	0xc8ff	/* nThermCfg */
			/* 0x009D */	0xcea7	/* nFilterCfg */
		>;
		max77779,fg_regval = /bits/ 16 <
			0x3A 0x1002	/* SOCHold */
			0x1F 0xA95A	/* VEmpty */
		>;
		max77779,fg_n_regval = /bits/ 16 <
			0xB7 0x2241	/* nConvgCfg */
			0xC8 0xC8FF	/* nThermCfg3 */
			0xC9 0xC8FF	/* nThermCfg2 */
		>;
		max77779,fg-aafv = /bits/ 32 <
			  0   95  0xf  0x00b4
			 20   90  0xf  0x005a
			 40   85  0xf  0x005a
			 60   80  0xf  0x005a
			 80   75  0xf  0x005a
			100   70  0xf  0x005a
		>;
	};

	/* B_COS_RC2_BC79_2mOhm_3520_1_090523_20240401.model.ini.txt, b/332397741#comment3 */
	max77779,cos-2k {
		max77779,batt-id-kohm = <2>;
		max77779,model-version = <1>;
		max77779,force-reset-model-data;
		max77779,fg-model = /bits/ 16 <
			0xa500 0xb6d0 0xbac0 0xbc20 0xbd10 0xbee0 0xc0e0 0xc310
			0xc560 0xc7e0 0xca10 0xce00 0xd130 0xd4e0 0xd980 0xdf40
			0x0170 0x0780 0x1800 0x1610 0x0e80 0x10b0 0x0c90 0x0890
			0x06c0 0x06c0 0x06e0 0x0690 0x06e0 0x06a0 0x0810 0x0810
		>;
		max77779,fg-params = /bits/ 16 <
			/* 0x00C0 */	0xc1b0	/* nNVCfg0 */
			/* 0x00B6 */	0x043b	/* RelaxCFG */
			/* 0x009F */	0x260e	/* nLearnCFG */
			/* 0x000C */	0x4207	/* Config */
			/* 0x00AB */	0x0080	/* Config2 */
			/* 0x00BC */	0x5f00	/* nFullSOCthr */
			/* 0x00A9 */	0x01e2	/* nFullCAPRep */
			/* 0x00B3 */	0x01e2	/* nDesignCap */
			/* 0x0046 */	0x0c80	/* dPacc */
			/* 0x00A5 */	0x01e2	/* nFullCAPNom */
			/* 0x00C6 */	0xa55a	/* nV_empty */
			/* 0x00A0 */	0x3205	/* nQRTable00 */
			/* 0x00A1 */	0x1782	/* nQRTable10 */
			/* 0x00A2 */	0x0a00	/* nQRTable20 */
			/* 0x00A3 */	0x0880	/* nQRTable30 */
			/* 0x00A6 */	0x04d0	/* nRCOMP0 */
			/* 0x00A7 */	0x1c02	/* nTempCo */
			/* 0x009C */	0x0097	/* nIChgTerm */
			/* 0x00B2 */	0x3870	/* nMiscCFG */
			/* 0x009E */	0x0400	/* nModelCfg */
			/* 0x00CA */	0xC8FF	/* nThermCfg */
			/* 0x009D */	0xCEB5	/* nFilterCfg */
		>;
		max77779,fg_regval = /bits/ 16 <
			0x1F 0xA95A	/* VEmpty */
		>;
		max77779,fg_n_regval = /bits/ 16 <
			0xC9 0xC8FF    /* nThermCfg2 Register */
		>;
		max77779,fg-aafv = /bits/ 32 <
			  0   95  0xf  0x0097
			 20   90  0xf  0x004c
			 40   85  0xf  0x004c
			 60   80  0xf  0x004c
			 80   75  0xf  0x004c
			100   70  0xf  0x004c
		>;
	};

	/* RG5B-LWN-3807-G1.ini.txt.overlay, b/390036850#comment3 */
	max77779,lwn-4k {
		max77779,batt-id-kohm = <4>;
		max77779,model-version = <4>;
		max77779,force-reset-model-data;
		max77779,fg-model = /bits/ 16 <
			0x99f0 0xaee0 0xb6a0 0xb890 0xbaf0 0xbd40 0xbf60 0xc280
			0xc670 0xc9c0 0xcdd0 0xd100 0xd500 0xd950 0xdc20 0xdff0
			0x0060 0x01b0 0x0900 0x0d30 0x10f0 0x12d0 0x0f10 0x07d0
			0x06e0 0x06c0 0x06e0 0x05f0 0x06b0 0x08d0 0x0680 0x0680
		>;
		max77779,fg-params = /bits/ 16 <
			/* 0x00C0 */	0xc1b0	/* nnvcfg0 */
			/* 0x00B6 */	0x043b	/* nrelaxcfg */
			/* 0x009F */	0x660e	/* nLearnCFG */
			/* 0x000C */	0x4207	/* Config */
			/* 0x00AB */	0x0081	/* Config2 */
			/* 0x00BC */	0x5f00	/* nFullSOCThr */
			/* 0x00A9 */	0x0230	/* nfullcaprep */
			/* 0x00B3 */	0x0230	/* ndesigncap */
			/* 0x0046 */	0x0c80	/* dPacc */
			/* 0x00A5 */	0x0230	/* nfullcapnom */
			/* 0x00C6 */	0xa55a	/* nVEmpty */
			/* 0x00A0 */	0x208a	/* nQRTable00 */
			/* 0x00A1 */	0x1188	/* nQRTable10 */
			/* 0x00A2 */	0x0a00	/* nQRTable20 */
			/* 0x00A3 */	0x0700	/* nQRTable30 */
			/* 0x00A6 */	0x0440	/* nRCOMP0 */
			/* 0x00A7 */	0x1302	/* nTempCo */
			/* 0x009C */	0x00c5	/* nichgterm */
			/* 0x00B2 */	0x3870	/* nmisccfg */
			/* 0x009E */	0x0400	/* nModelCfg */
			/* 0x00CA */	0xc8ff	/* nThermCfg */
			/* 0x009D */	0xcea7	/* nFilterCfg */
		>;
		max77779,fg_regval = /bits/ 16 <
			0x3A 0x1002	/* SOCHold */
			0x1F 0xA95A	/* VEmpty */
		>;
		max77779,fg_n_regval = /bits/ 16 <
			0xB7 0x2240	/* nConvgCfg */
			0xC8 0xC8FF	/* nThermCfg3 */
			0xC9 0xC8FF	/* nThermCfg2 */
		>;
		max77779,fg-aafv = /bits/ 32 <
			  0   95  0xf  0x00c5
			 20   90  0xf  0x0063
			 40   85  0xf  0x0063
			 60   80  0xf  0x0063
			 80   75  0xf  0x0063
			100   70  0xf  0x0063
		>;
	};
};
