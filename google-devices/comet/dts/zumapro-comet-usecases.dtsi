// SPDX-License-Identifier: GPL-2.0-only
/*
 * Usecases specific to Comet platforms
 *
 * Copyright 2024 Google LLC
 *
 */

/* system use cases */
&max77779_chg {
	max77779,chrg-byp-en;

	/* external boost */
	max77779,bst-on-gpios = <&s2mpg15_gpio 4 GPIO_ACTIVE_HIGH>;  /* EXT_BST_EN */
	max77779,extbst-ctl-gpios = <&max77759_tcpc_gpio 0 GPIO_ACTIVE_HIGH>; /* OTG_PWR_EN */
	max77779,extbst-mode-gpios = <&s2mpg15_gpio 9 GPIO_ACTIVE_HIGH>; /* EXT_BST_MODE */
	post-init-providers = <&max77759_tcpc_gpio>;

	/* for OTG related usecase*/
	max77779,rx-to-rx-otg-en; /* support RX -> RX+OTG */
	max77779,ext-otg-only; /* use external OTG only */
	max77779,wlc_notify_charge_disable;
};
