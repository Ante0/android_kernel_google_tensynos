// SPDX-License-Identifier: GPL-2.0-only
/*
 * Tangorpro device tree source
 *
 * Copyright 2022 Google,LLC
 */

/dts-v1/;
/plugin/;

#include "gs201-tangorpro-common.dtsi"

/ {
	board_id = <0x30706>;
	board_rev = <0x10000>;
	fragment@boardbase {
		target-path="/";
		__overlay__ {
			model = "GS201 TANGORPRO MP based on GS201";
			compatible = "google,GS201 TANGORPRO", "google,GS201";
		};
	};
};

&serial_0 {
	status = "okay";
};
