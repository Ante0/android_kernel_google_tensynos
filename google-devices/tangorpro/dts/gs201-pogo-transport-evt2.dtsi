// SPDX-License-Identifier: GPL-2.0-only
/*
 * Google GS201 Pogo transport for Tangorpro EVT2
 *
 * Copyright (c) 2022 Google, LLC
 *
 */
#include <dt-bindings/gpio/gpio.h>

/ {
	fragment@pogo_transport {
		target-path = "/";
		__overlay__ {

			google_pogo: google,pogo {
				/delete-property/ pogo-acc-capable;
				pogo-acc-hall-only;
				legacy-event-driven;
			};
		};
	};
};
