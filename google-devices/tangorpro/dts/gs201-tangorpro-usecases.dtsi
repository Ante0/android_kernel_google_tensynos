// SPDX-License-Identifier: GPL-2.0-only
/*
 * Battery device tree entries specific to tangorpro
 *
 * Copyright (c) 2022 Google, LLC
 *
 */

/* system use cases */
&max77759_chg {
	/* external boost */
	max77759,bst-on = <&max777x9_gpio 4 GPIO_ACTIVE_HIGH>; /* MW: OTG_BOOST_EN */
	max77759,extbst-ctl = <&max77759_tcpc_gpio 0 GPIO_ACTIVE_HIGH>;
	max77759,extbst-mode = <&s2mpg12_gpio 4 GPIO_ACTIVE_HIGH>;

	/* for OTG related usecase*/
	max77759,rx-to-rx-otg-en; /* support RX -> RX+OTG */
	max77759,ext-otg-only; /* use external OTG only */

	/* S2MPG12X01 -> GPIO_2 -> POGO_OVP_EN_L */
	max77759,pogo-ovp-en = <&s2mpg12_gpio 2 GPIO_ACTIVE_LOW>;
	/* APC GPIOs -> XAPC_GPIO1 -> POGO_VOUT_SW_EN */
	max77759,pogo-vout-sw-en = <&gpp0 2 GPIO_ACTIVE_LOW>;

	/* The high/low bound of vbatt for FCCM mode */
	max77759,otg-fccm-vbatt-upperbd = <4500>;
	max77759,otg-fccm-vbatt-lowerbd = <4450>;
};
