// SPDX-License-Identifier: GPL-2.0
/*
 * Tangorpro device tree source
 *
 * Copyright (c) 2022 Google, LLC
 *              https://www.google.com
*/

#include "gs201/gs201-ravenclaw-uwb.dtsi"

&spi_16 {
        dw3xxx_prod@0 {
                min_clamp = <800>;
        };
};

