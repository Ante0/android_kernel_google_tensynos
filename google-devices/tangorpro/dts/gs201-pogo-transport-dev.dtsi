// SPDX-License-Identifier: GPL-2.0-only
/*
 * Google GS201 Pogo transport for Tangorpro DEV
 *
 * Copyright (c) 2022 Google, LLC
 *
 */
#include <dt-bindings/gpio/gpio.h>

/ {
	fragment@pogo_transport {
		target-path = "/";
		__overlay__ {

			google_pogo: google,pogo {
				/delete-property/ pogo-acc-capable;
				/delete-property/ usb-hub-supply;
				/delete-property/ acc-detect-supply;

				legacy-event-driven;
			};
		};
	};
};


