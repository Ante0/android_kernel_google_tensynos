// SPDX-License-Identifier: GPL-2.0-only
/*
 * Google WLAN for tangorpro
 *
 * Copyright 2022 Google LLC
 */

&pcie_1 {   /* pcie ch1 used for the connection with WiFi */
        max-link-speed = <LINK_SPEED_GEN1>;
};
