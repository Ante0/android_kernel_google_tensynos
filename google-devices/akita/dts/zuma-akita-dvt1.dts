// SPDX-License-Identifier: GPL-2.0-only
/*
 * Akita board device tree source
 *
 * Copyright 2023 Google LLC
 */

/dts-v1/;
/plugin/;

#include "zuma-akita-common.dtsi"
#include "zuma/zuma-cp-s5300-gnss.dtsi"
#include "zuma-akita-gnss-samsung.dtsi"

/ {
	board_id = <0x40404>;
	board_rev = <0x010000>;
	fragment@boardbase {
		target-path = "/";
		__overlay__ {
			model = "ZUMA AKITA Dvt 1.0 board based on ZUMA";
			compatible = "google,ZUMA AKITA", "google,ZUMA";
		};
	};
};
