// SPDX-License-Identifier: GPL-2.0-only
/*
 * DMA heap device tree entries specific to akita.
 *
 * Copyright 2023 Google,LLC
 *
 */

&farawimg {
	size = <0x05000000>; /* 80MB */
};

&faceauth_dsp {
	size = <0x01400000>; /* 20MB */
};
