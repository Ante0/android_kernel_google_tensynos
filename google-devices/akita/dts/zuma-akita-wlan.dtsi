// SPDX-License-Identifier: GPL-2.0-only
/*
 * WLAN device tree for akita.
 *
 * Copyright 2022 Google LLC
 *
 */

&pcie_1 {       /* pcie ch1 used for the connection with WiFi */
	max-link-speed = <LINK_SPEED_GEN2>;
	use-msi = "true";
};
