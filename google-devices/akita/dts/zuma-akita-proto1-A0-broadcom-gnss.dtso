// SPDX-License-Identifier: GPL-2.0-only
/*
 * Akita board device tree source
 *
 * Copyright 2022 Google LLC
 */

/dts-v1/;
/plugin/;

#include "zuma-akita-common.dtsi"
#include "zuma/zuma-board-gps.dtsi"

/ {
	board_id = <0x40402>;
	board_rev = <0x010000>;
	fragment@boardbase {
		target-path = "/";
		__overlay__ {
			model = "ZUMA AKITA Proto 1.0 Broadcom GNSS board based on ZUMA A0";
			compatible = "google,ZUMA AKITA", "google,ZUMA";
		};
	};
};
