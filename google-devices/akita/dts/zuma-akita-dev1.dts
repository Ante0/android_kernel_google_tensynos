// SPDX-License-Identifier: GPL-2.0-only
/*
 * Akita board device tree source
 *
 * Copyright 2022 Google LLC
 */

/dts-v1/;
/plugin/;

#include "zuma-akita-common-dev1.dtsi"
#include "zuma/zuma-board-gps.dtsi"

/ {
	board_id = <0x40401>;
	board_rev = <0x010000>;
	fragment@boardbase {
		target-path = "/";
		__overlay__ {
			model = "ZUMA AKITA DEV 1.0 board based on ZUMA";
			compatible = "google,ZUMA AKITA", "google,ZUMA";
		};
	};
};
