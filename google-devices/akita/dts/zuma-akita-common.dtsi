// SPDX-License-Identifier: GPL-2.0-only
/*
 * Akita board device tree source
 *
 * Copyright 2022 Google LLC
 */

#include "zuma-akita-board.dtsi"

#include "zuma-akita-aoc.dtsi"
#include "zuma-akita-audio.dtsi"
#include "zuma-akita-camera.dtsi"
#include "zuma-akita-display.dtsi"
#include "zuma-akita-haptics.dtsi"
#include "zuma-akita-touch.dtsi"
#include "zuma-akita-thermal.dtsi"
#include "zuma-akita-bluetooth.dtsi"
#include "zuma-akita-pmic.dtsi"
#include "zuma-akita-pcie.dtsi"
#include "zuma-akita-bcl.dtsi"
#include "zuma-akita-cp-features.dtsi"

