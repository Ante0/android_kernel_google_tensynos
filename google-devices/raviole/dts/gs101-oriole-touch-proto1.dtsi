// SPDX-License-Identifier: GPL-2.0-only
/*
 * Google Oriole touch device tree source
 *
 * Copyright 2020 Google LLC.
 */

&ts_spi_cs_active {
	samsung,pins = "gpp23-3";
	samsung,pin-function = <EXYNOS_PIN_FUNC_OUTPUT>;
	samsung,pin-pud = <EXYNOS_PIN_PULL_NONE>;
	samsung,pin-drv = <GS101_PIN_DRV_2_5_MA>;
};

&spitouch {
	status = "ok";
	compatible = "st,fts";
	spi-max-frequency = <10000000>;

	pinctrl-names = "pmx_ts_active", "pmx_ts_suspend";

	st,irq-gpio = <&gpa9 0 0>;
	st,reset-gpio = <&gpp26 0 0>;
	/* Left and right grip rejection area. Unit: pixels */
	st,grip_area = /bits/ 8 <15>;
	st,dchip_id = /bits/ 8 <0x36 0x48>;
	st,panel_map = <&samsung_s6e3fc3 0>;
	st,max-coords = <1079 2399>;
	st,udfps-coords = <540 1769>;
	st,touch_offload_id = /bits/ 8 <'0' '0' 'o' '6'>;
	st,firmware_names = "ftm5_fw_o6.ftb";
	st,limits_names = "stm_fts_production_limits_o6.csv";


	controller-data {
		samsung,spi-feedback-delay = <1>;
		samsung,spi-chip-select-mode = <0>;
		cs-clock-delay = <2>;
	};
};

