// SPDX-License-Identifier: GPL-2.0 OR BSD-3-Clause
/*
 * Copyright 2024 Google LLC.
 */

/dts-v1/;

#include "malibu-base.dtsi"
#include "malibu-chosen-a0.dtsi"
#include "malibu-a0-cpu.dtsi"
#include "malibu-a0-ufs.dtsi"

/ {
	/* soc revision info */
	soc_compatible {
		A0 {
			description = "MBU A0";
			product_id = <0x6>;
			major = <0x0>;
			minor = <0x0>;
			pkg_mode = <0x0>;
		};
	};

};
