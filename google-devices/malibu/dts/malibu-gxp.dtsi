// SPDX-License-Identifier: GPL-2.0-only
/*
 * Device tree source for Malibu DSP.
 *
 * Copyright 2025 Google LLC
 */

#include <dt-bindings/interrupt-controller/mbu-gic.h>

/ {
	sswrp_aur: sswrp_aur@38000000 {
		compatible = "simple-bus";
		#address-cells = <1>;
		#size-cells = <1>;
		ranges = <0x0 0x0 0x38000000 0xaf1000>;

		gxp: gxp@8a0000 {
			compatible = "google,gxp-mbu";
			#dma-address-cells = <1>;
			#dma-size-cells = <1>;
			gcip-dma-window = <0x02000000 0xC0000000>; /* GCIP IOMMU attribute. */
			gcip-reserved-map = <0x80000000 0x1000>;
			reg = <0x8a0000 0x240000
				0x4C0000 0x001000
				0x4E3000 0x001000
				0x440000 0x001000
				0x441000 0x001000
				0x442000 0x001000
				0x000000 0x040000>;
			reg-names = "aur", "core0_mba", "core1_mba", "mcu0_kmba", "mcu0_umba",
				    "iif_mailbox", "lpm";
			iommus = <&aurdsp_smmu 0>;
			pasid-num-bits = <4>;
			power-domains = <&sswrp_aurdsp_pd>;
			pmu-aur-status = <0x0eb400c0>;
			tpu-device = <&edgetpu>;
			gxp-tpu-mbx-offset = <0x0 0x5c000>; /* TPU mbx #46 */
			gxp-fw-region = <&gxp_fw_reserved>;
			gxp-secure-data-region = <&gxp_secure_data_reserved>;
			gxp-mcu-fw-region = <&gxp_mcu_fw_reserved>;
			gxp-memory-per-core = <0 512>;
			interrupts =
				<GIC_SPI SSWRP_AURORA_AURDSP_AP_INTR_DSP_AP_CORE_0_MBA_IRQ_0
				IRQ_TYPE_LEVEL_HIGH 0>,
				<GIC_SPI SSWRP_AURORA_AURDSP_AP_INTR_DSP_AP_CORE_1_MBA_IRQ_0
				IRQ_TYPE_LEVEL_HIGH 0>,
				<GIC_SPI SSWRP_AURORA_AURDSP_AP_INTR_NS_DSP_AP_VM_MCU_MBA_IRQ_0
				IRQ_TYPE_LEVEL_HIGH 0>,
				<GIC_SPI SSWRP_AURORA_AURDSP_AP_INTR_NS_DSP_AP_VM_MCU_MBA_IRQ_3
				IRQ_TYPE_LEVEL_HIGH 0>,
				<GIC_SPI SSWRP_AURORA_AURDSP_AP_INTR_DSP_AP_WDOG_BITE_IRQ
				IRQ_TYPE_LEVEL_HIGH 0>;
			gsa-device = <&gsa>;
			iif-device = <&iif>;
			/* TODO(b/422110249): Update power values */
			gcip-dvfs-table-size = <16 2>; /*<row col>*/
			gcip-dvfs-table = <
			/*    freq(kHz) power(mW) */
				1190400 299 /*  0 */
				1036800 272 /*  1 */
				 883200 236 /*  2 */
				 768000 205 /*  3 */
				 729600 180 /*  4 */
				 691200 170 /*  5 */
				 652800 146 /*  6 */
				 614400 127 /*  7 */
				 576000 107 /*  8 */
				 499200  96 /*  9 */
				 460800  75 /* 10 */
				 384000  63 /* 11 */
				 345600  48 /* 12 */
				 300000  34 /* 13 */
				 115200  27 /* 14 */
				  38400  12 /* 15 */
			>;
		};
		gxp_cooling: gxp-cooling {
			#cooling-cells = <2>;
		};
	};
};
