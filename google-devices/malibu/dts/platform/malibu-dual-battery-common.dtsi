// SPDX-License-Identifier: GPL-2.0-only
/*
 * Battery device tree entries specific to dual battery
 *
 * Copyright 2025 Google LLC
 *
 */

#include <dt-bindings/interrupt-controller/irq.h>

/ {
	fragment@battery {
		target-path = "/";
		__overlay__ {

			google_battery: google,battery {
				status = "okay";
				compatible = "google,battery";
				google,fg-psy-name = "dualbatt";
				google,chg-battery-capacity = <4658>;

				/* charge table */
				google,chg-temp-limits = <0 100 200 300 420 460 480 550>;
				google,chg-cv-limits = <
					4100000 4200000 4250000 4300000 4350000 4530000>;
				google,chg-cc-limits = <
					 30  30  10  10   0   0
					 50  50  30  30  30  30
					120 120 120 120 120  50
					120 120 120 120 120  50
					120 120 120 120 120  50
					 50  50  50   0   0   0
					 30   0   0   0   0   0
				>;
				google,chg-topoff-limits = <233 233 233 466 1397 233 233>;
			};

			google_dual_batt_gauge: google,dual_batt_gauge {
				status = "okay";
				compatible = "google,dual_batt_gauge";
				google,first-fg-psy-name = "maxfg_base";
				google,second-fg-psy-name = "maxfg_secondary";
				google,vfloat-offset-max-idx = <1>;
				google,cc-balance-ratio = <80>; /* 80% */
				google,psy-type-unknown;
				google,chg-base-battery-capacity = <1221>;
				google,chg-sec-battery-capacity = <3437>;

				google,chg-pack-cc-limits = <
					 30  30  10  10   0   0
					 50  50  30  30  30  30
					130 130 130 130 130  50
					130 130 130 130 130  50
					130 130 130 130 130  50
					 50  50  50   0   0   0
					 30   0   0   0   0   0
				>;
			};

		};
	};
};
