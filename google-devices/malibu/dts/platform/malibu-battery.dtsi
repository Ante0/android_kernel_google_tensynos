// SPDX-License-Identifier: GPL-2.0-only
/*
 * Battery device tree entries specific to Malibu
 *
 * Copyright 2025 Google LLC
 *
 */
/ {
	fragment@battery {
		target-path = "/";
		__overlay__ {

			google_battery: google,battery {
				compatible = "google,battery";
				google,fg-psy-name = "max77779fg";

				/* charge table */
				google,chg-temp-limits = <0 100 200 420 460 480 550>;
				google,chg-cv-limits = <4200000 4300000 4450000>;
				google,chg-cc-limits = <
					30  10   0
					50  30  30
					100  70  50
					80  50  50
					50  50   0
					30   0   0
				>;

				google,ttf-temp-idx= <2>;
				google,ttf-adapter = <1800>;
				google,ttf-soc-table =  <49 59 72 78 93 95  98 100>;
				google,ttf-elap-table = <45 52 56 67 78 91 104 120>;
				google,ttf-tier-table = <0 71 78>;

				/* IRDrop Compensation */
				google,fv-uv-resolution = <10000>;
				/* NOTE: high value for DC charging */
				google,fv-uv-margin-dpct = <1025>;
				/* tier switch */
				google,cv-range-accuracy = <20000>;
				google,cv-otv-margin = <12000>;
				google,cv-debounce-cnt = <3>;
				google,cv-tier-ov-cnt = <10>;
				google,cv-tier-switch-cnt = <3>;

				/* rest charging */
				google,chg-rest-rate = <15>;
				google,chg-rest-soc = <80>;
				/* Enable TRICKLE-DEFEND V2 */
				google,bd-trickle-enable;
				google,bd-trickle-version = <2>;
				google,bd-trickle-cnt-threshold = <0>;
				google,bd-trickle-rate = <6>;
				/* Battery virtual sensor */
				google,batt-vs-tz-name = "batt_vs";

				/* record over temperature time */
				google,temp-record-thr = <300 350 400>;
				google,soc-record-thr = <90 90 95>;

				#thermal-sensor-cells = <0>;
				#cooling-cells = <2>;

				/* bhi */
				google,bhi-cycle-grace = <100>;
				google,bhi-algo-ver = <3>;

				google,eeprom-pairing;

				google,aafv-config = <1>;
				google,aafv-ref-cycles = <200 400 600 800 1000>;
				google,aafv-ref-offset = < 20  40  60  80  100>;

				google,aacc-chg-temp = <0 550>;
				google,aacc-chg-weights = < /* units: 1/1000 cycles */
					100 100 100 100 100 100 100 100 100 100
					  0   0   0   0   0   0   0   0   0   0
					  0   0   0   0   0   0   0   0   0   0
					  0   0   0   0   0   0   0   0   0   0
					  0   0   0   0   0   0   0   0   0   0
					  0   0   0   0   0   0   0   0   0   0
					  0   0   0   0   0   0   0   0   0   0
					  0   0   0   0   0   0   0   0   0   0
					  0   0   0   0   0   0   0   0   0   0
					  0   0   0   0   0   0   0   0   0   0
				>;
				google,aacc-td-chg-temp = <0 550>;
				google,aacc-td-chg-weights = < /* units: 1/1000 cycles */
					  0   0   0   0   0   0   0   0   0   0
					  0   0   0   0   0   0   0   0   0   0
					  0   0   0   0   0   0   0   0   0   0
					  0   0   0   0   0   0   0   0   0   0
					  0   0   0   0   0   0   0   0   0   0
					  0   0   0   0   0   0   0   0   0   0
					  0   0   0   0   0   0   0   0   0   0
					  0   0   0   0   0   0   0   0   0   0
					  0   0   0   0   0   0   0   0   0   0
					100 100 100 100 100 100 100 100 100 100
				>;

				/* 90% after 600 cycles, 80% after 1000 cycles */
				google,aacr-config = <1>;
				google,aacr-algo = <3>;
				google,aacr-cliff-capacity-rate = <80>;
				google,aacr-cycle-max = <1000>;
				google,aacr-ref-cycles = <599 600 1000>;
				google,aacr-ref-fade10 = <  0 100  100>;
			};

			google_bms {
				nvmem = <&pack_bee>;
				nvmem-names = "bms-pack-eeprom";
				/* pack eeprom is available only with P20+ batteries */
				google,bee-name = "bms-pack-eeprom";
#ifndef BATTERY_EEPROM_1K
				google,lotr-version = <2>;
#endif
			};

		};
	};
};
