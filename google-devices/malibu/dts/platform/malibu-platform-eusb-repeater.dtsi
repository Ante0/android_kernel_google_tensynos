// SPDX-License-Identifier: GPL-2.0-only
/*
 * MBU platform common - eUSB2 repeater devicetree config
 *
 * Copyright 2025 Google LLC.
 *
 */

&lsioe_i2c3 {
	#address-cells = <1>;
	#size-cells = <0>;
	eusb2_repeater: tiusb2e11@3E {
		status = "okay";
		compatible = "goog-eusb2-repeater";
		reg = <0x3E>;
		vdd33-supply = <&ldo_19m_reg>;
		vdd18-supply = <&buck_12s_reg>;
		vdd_reset-supply = <&ldo_12s_reg>;
		pinctrl-names = "default";
		pinctrl-0 = <&ap2eusb2_reset_l_1v2>;
		usb-role-switch;
	};
};
