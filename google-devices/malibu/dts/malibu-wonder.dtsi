// SPDX-License-Identifier: GPL-2.0-only OR BSD-3-Clause
/*
 * Device tree source for Wonder.
 *
 * Copyright 2025 Google LLC
 */

/ {
	wlan_node_brcm: wlan-device {
		compatible = "android,bcmdhd_wlan-wonder";
		status = "okay";
	};

	wlan_node_qcom: qcom,cnss-vendor-wlan-wonder {
		compatible = "qcom,cnss-vendor-wlan-wonder";
		status = "disable";
	};

	wonder_node: wonder-device {
		compatible = "google,wonder-drv-v1";
		wondertap-provider = <&wlan_node_brcm>;
		status = "okay";
	};
};

