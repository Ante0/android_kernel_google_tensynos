// SPDX-License-Identifier: GPL-2.0 OR BSD-3-Clause
/*
 * Copyright 2025 Google LLC.
 */

/dts-v1/;

#include "malibu-base.dtsi"
#include "malibu-chosen-b0.dtsi"
#include "malibu-b0-cpu.dtsi"
#include "malibu-b0-dpu.dtsi"
#include "malibu-b0-gpu.dtsi"
#include "malibu-b0-usb.dtsi"
#include "malibu-chip-info-b0.dtsi"

/ {
	/* soc revision info */
	soc_compatible {
		B0 {
			description = "MBU B0";
			product_id = <0x6>;
			major = <0x1>;
			minor = <0x0>;
			pkg_mode = <0x0>;
		};
	};

};
