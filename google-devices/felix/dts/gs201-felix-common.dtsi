// SPDX-License-Identifier: GPL-2.0-only
/*
 * Felix device tree source
 *
 * Copyright 2021-2022 Google,LLC
 */

#include "gs201/gs201-common.dtsi"
#include "gs201/gs201-cloudripper-battery.dtsi"
#include "gs201/gs201-cloudripper-bluetooth.dtsi"
#include "gs201/gs201-cloudripper-bcl.dtsi"
#include "gs201/gs201-pantah-charging.dtsi"
#include "gs201/gs201-cloudripper-cp-s5300-sit.dtsi"
#include "gs201/gs201-cloudripper-ese.dtsi"
#include "gs201/gs201-cloudripper-gsa-gsc.dtsi"
#include "gs201/gs201-cloudripper-wlan.dtsi"
#include "gs201/gs101-faceauth-dma-heap.dtsi"

#include "gs201/gs101-faceauth-dma-heap.dtsi"

#include "gs201-felix-wcharger.dtsi"

#include "gs201-felix-usecases.dtsi"
#include "gs201-felix-aoc.dtsi"
#include "gs201-felix-camera-pmic.dtsi"
#include "gs201-felix-camera.dtsi"
#include "gs201-felix-ldaf.dtsi"
#include "gs201-felix-display.dtsi"
#include "gs201-felix-hall-sensor.dtsi"
#include "gs201-felix-pmic.dtsi"
#include "gs201-felix-touch.dtsi"
#include "gs201-felix-outer-touch.dtsi"
#include "gs201-felix-thermal.dtsi"
#include "gs201-felix-audio.dtsi"
#include "gs201-felix-fingerprint.dtsi"
#include "gs201-felix-battery.dtsi"
#include "gs201-felix-charging.dtsi"
#include "gs201-felix-usb.dtsi"
#include "gs201-felix-nfc.dtsi"
#include "gs201-felix-uwb.dtsi"
#include "gs201-felix-sbbm.dtsi"