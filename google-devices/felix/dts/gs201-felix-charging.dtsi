// SPDX-License-Identifier: GPL-2.0-only
/*
 * Battery device tree entries specific to felix
 *
 * Copyright 2022 Google,LLC
 *
 */

&max77759_chg {
	google,max77759-thm2-monitor;
};

&google_charger {
	google,fv-max-uv = <4480000>;
	google,thermal-stats-lvl-map = <0 3 5 8>;
};

&google_cpm {
	// thermal budgets
	google,mdis-thermal-mitigation =
		<4122000 3623000 3308000 2824000 2524000 2241000
		 1864000 1635000 1319000  932000  632000  344000>;

	// source ONLINE selection criteria
	google,mdis-out-sel-online = <1 2>;
	// PD+main-charger, WLC+main-charger
	google,mdis-out0-limits =
		<4000000 3700000 3500000 3200000 3000000 2700000
		 2500000 2300000 2000000 1500000 1000000  500000
		 1100000 1100000  750000  750000  750000  750000
		  750000  650000  550000  450000  350000  250000>;
	// PPS_CP+pca94xx-mains, // No WLC_CP
	google,mdis-out1-limits =
		<5000000  5000000 4500000 4500000 4000000 4000000
		 3500000  3500000 3000000 2500000 2000000 1000000
		 5000000  5000000 4500000 4500000 4000000 4000000
		 3500000  3500000 3000000 2500000 2000000 1000000>;
};
