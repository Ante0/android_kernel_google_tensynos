// SPDX-License-Identifier: GPL-2.0-only
/*
 * AoC device tree source
 *
 * Copyright 2022 Google,LLC.
 */


&aoc_vsync_pins {
	samsung,pins = "gpp3-1", "gpp5-1", "gpp7-1", "gpp9-1", "gpp13-1";
	samsung,pin-function = <EXYNOS_PIN_FUNC_2>;
};

&aoc {
	sensor_mag-supply = <&m_ldo24_reg>;
	sensor_power_list = "sensor_mag", "sensor_1v8", "sensor_3v3";
};
