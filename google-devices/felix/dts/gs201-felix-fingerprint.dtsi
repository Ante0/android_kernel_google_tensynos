// SPDX-License-Identifier: GPL-2.0-only
/*
 * Google Passport-specific fingerprint device tree source
 *
 * Copyright 2022 Google, LLC.
 */

#include <dt-bindings/gpio/gpio.h>
#include <arm64/exynos/exynos-pinctrl.h>

&pinctrl_4 {
		fps_rst_power_down: fps_rst_power_down {
				samsung,pins ="gpp1-1";
				samsung,pin-function = <EXYNOS_PIN_FUNC_OUTPUT>;
				samsung,pin-con-pdn = <1>;
				samsung,pin-pud-pdn = <3>;
		};
};

&odm {
		fpc:fp_fpc1020 {
				staus = "ok";
				compatible = "fpc,fpc1020";
				interrupt-parent = <&gpa9>;
				interrupts = <2 0>;
				pinctrl-names = "rst,power_down";
				pinctrl-0 = <&fps_rst_power_down>;
				fpc,gpio_rst = <&gpp1 1 GPIO_ACTIVE_LOW>;
				fpc,gpio_irq = <&gpa9 2 GPIO_ACTIVE_HIGH>;
		};
};
