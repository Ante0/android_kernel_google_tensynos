// SPDX-License-Identifier: GPL-2.0-only
/*
 * Felix device tree source
 *
 * Copyright 2022 Google,LLC
 */

/dts-v1/;
/plugin/;

#include "gs201-felix-common.dtsi"

/ {
	board_id = <0x30603>;
	board_rev = <0x10000>;
	fragment@boardbase {
		target-path="/";
		__overlay__ {
			model = "GS201 FELIX EVT 1.0 based on GS201";
			compatible = "google,GS201 FELIX", "google,GS201";
		};
	};
};

&serial_0 {
	status = "okay";
};
