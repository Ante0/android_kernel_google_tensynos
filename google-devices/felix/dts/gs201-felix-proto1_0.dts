// SPDX-License-Identifier: GPL-2.0-only
/*
 * Felix device tree source
 *
 * Copyright 2022 Google,LLC
 */

/dts-v1/;
/plugin/;

#include "gs201-felix-common.dtsi"

/ {
	board_id = <0x30602>;
	board_rev = <0x10000>;
	fragment@boardbase {
		target-path="/";
		__overlay__ {
			model = "GS201 Felix PROTO 1.0 based on GS201";
			compatible = "google,GS201 FELIX", "google,GS201";
		};
	};
};

&serial_0 {
	status = "okay";
};

&devfreq_0 {
	freq_info = <421000 421000 421000 421000 1539000 1014000>;
	/* initial_freq, default_qos, suspend_freq, min_freq, max_freq, reboot_freq */
};
