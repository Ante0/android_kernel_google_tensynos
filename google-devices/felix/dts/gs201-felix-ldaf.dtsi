// SPDX-License-Identifier: GPL-2.0-only
/*
 * gs201 ldaf(Laser Detection Auto Focus) device tree source
 * Copyright 2021 Google LLC.
 *
 */

&stmvl53l1 {
	vio-voltage = <1875000>;

	/* Swap to use a regulator type for tof sensor's power source */
	/delete-property/ pwren-gpio;
	pwren-supply = <&pp2800_ldaf>;
};

