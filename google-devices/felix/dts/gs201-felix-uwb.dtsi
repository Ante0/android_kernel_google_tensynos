// SPDX-License-Identifier: GPL-2.0
/*
 * Google GS201 Board device tree source
 *
 * Copyright (c) 2021 Google, LLC
 *		https://www.google.com
*/

#include "gs201/gs201-ravenclaw-uwb.dtsi"

&spi_16 {
	dw3xxx_prod@0 {
		min_clamp = <820>;
	};
};

&spi16_bus {
	samsung,pin-drv = <GS101_PIN_DRV_2_5_MA>;
	samsung,pin-pud-pdn = <EXYNOS_PIN_PULL_NONE>;
};

&spi16_cs {
	samsung,pin-drv = <GS101_PIN_DRV_2_5_MA>;
};

