// SPDX-License-Identifier: GPL-2.0-only
/*
 * Felix device tree source
 *
 * Copyright 2021 Google,LLC
 */

/dts-v1/;
/plugin/;

#include "gs201-felix-common.dtsi"
#include "gs201-felix-battery-dev.dtsi"
#include "gs201-felix-touch-dev.dtsi"

/ {
	board_id = <0x30601>;
	board_rev = <0x10000>;
	fragment@boardbase {
		target-path="/";
		__overlay__ {
			model = "GS201 Felix DEV 1.0 based on GS201";
			compatible = "google,GS201 FELIX", "google,GS201";
		};
	};
};

&serial_0 {
	status = "okay";
};
