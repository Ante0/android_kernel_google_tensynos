// SPDX-License-Identifier: GPL-2.0-only
/*
 * Usecases specific to Tokay devices
 *
 * Copyright 2023 Google LLC
 *
 */

/* system use cases */
&max77779_chg {
	max77779,chrg-byp-en;
	max77779,rtx-ready-gpios = <&p9xxx_gpio 6 GPIO_ACTIVE_HIGH>;
	max77779,rtx-available-gpios = <&p9xxx_gpio 7 GPIO_ACTIVE_HIGH>;
	max77779,wlc_notify_charge_disable;
};
