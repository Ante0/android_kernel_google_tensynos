// SPDX-License-Identifier: GPL-2.0-only
/*
 * tegu audio device tree source
 *
 * Copyright 2023 Google LLC
 */

&aoc {
	aoc-board-cfg = "TG4";
	aoc-board-id = <0x60b02>;
	aoc-board-rev = <0x10000>;
	prevent-fw-load = <0x0>;
};

