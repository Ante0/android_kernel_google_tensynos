// SPDX-License-Identifier: GPL-2.0-only
/*
 * Battery device tree entries
 *
 * Copyright 2024 Google LLC
 *
 */

max77779,config {

	/* BC79_TG4_2mOhm_ATL_3636_RC2_Proxy.ini, b/346652087#comment1 */
	max77779,atl-1k {
		max77779,batt-id-kohm = <1>;
		max77779,model-version = <1>;
		max77779,force-reset-model-data;
		max77779,fg-model = /bits/ 16 <
			0x9620 0xad30 0xb8a0 0xb8e0 0xb920 0xbb30 0xbd70 0xbe40
			0xbf60 0xc020 0xc260 0xc6c0 0xca60 0xd150 0xd9a0 0xdf10
			0x0080 0x0170 0x3320 0x32e0 0x0e00 0x0f20 0x1540 0x0e10
			0x1b70 0x0cb0 0x0770 0x07c0 0x06b0 0x06d0 0x0690 0x0690
		>;
		max77779,fg-params = /bits/ 16 <
			/* 0x00C0 */	0xc1b0	/* nNVCfg0 */
			/* 0x00B6 */	0x083b	/* RelaxCFG */
			/* 0x009F */	0x660e	/* nLearnCFG */
			/* 0x000C */	0x4207	/* Config */
			/* 0x00AB */	0x0081	/* Config2 */
			/* 0x00BC */	0x5f00	/* nFullSOCthr */
			/* 0x00A9 */	0x07fc	/* nFullCAPRep */
			/* 0x00B3 */	0x07fc	/* nDesignCap */
			/* 0x0046 */	0x0C80	/* dPacc */
			/* 0x00A5 */	0x07fc	/* nFullCAPNom */
			/* 0x00C6 */	0xa55a	/* nV_empty */
			/* 0x00A0 */	0x3600	/* nQRTable00 */
			/* 0x00A1 */	0x1880	/* nQRTable10 */
			/* 0x00A2 */	0x0a01	/* nQRTable20 */
			/* 0x00A3 */	0x0784	/* nQRTable30 */
			/* 0x00A6 */	0x05d0	/* nRCOMP0 */
			/* 0x00A7 */	0x1c02	/* nTempCo */
			/* 0x009C */	0x0280	/* nIChgTerm */
			/* 0x00B2 */	0x3870	/* nMiscCFG */
			/* 0x009E */	0x0400	/* nModelCfg */
			/* 0x00CA */	0xC8FF	/* nThermCfg */
			/* 0x009D */	0xCEA4	/* nFilterCfg */
		>;
		max77779,fg_n_regval = /bits/ 16 <
			0xB7 0x2341	/* nConvgCfg */
		>;
		max77779,fg-aafv = /bits/ 32 <
			  0   95  0xf  0x0280
			 20   90  0xf  0x0140
			 40   85  0xf  0x0140
			 60   80  0xf  0x0140
			 80   75  0xf  0x0140
			100   70  0xf  0x0140
		>;
	};

	/* BC79_TG4_2mOhm_LWN_3678_RC2_Proxy.ini, b/347756907#comment1 */
	max77779,lwn-4k {
		max77779,batt-id-kohm = <4>;
		max77779,model-version = <1>;
		max77779,force-reset-model-data;
		max77779,fg-model = /bits/ 16 <
			0x91d0 0xa3a0 0xb590 0xb830 0xba40 0xbbb0 0xbd40 0xbfd0
			0xc2c0 0xc670 0xc960 0xcd40 0xd0f0 0xd640 0xdb70 0xdf10
			0x0040 0x00c0 0x0600 0x1010 0x1100 0x0f00 0x1400 0x0db0
			0x06c0 0x07f0 0x06c0 0x06a0 0x06e0 0x06f0 0x0540 0x0540
		>;
		max77779,fg-params = /bits/ 16 <
			/* 0x00C0 */	0xc1b0	/* nNVCfg0 */
			/* 0x00B6 */	0x083b	/* RelaxCFG */
			/* 0x009F */	0x660e	/* nLearnCFG */
			/* 0x000C */	0x4207	/* Config */
			/* 0x00AB */	0x0081	/* Config2 */
			/* 0x00BC */	0x5f00	/* nFullSOCthr */
			/* 0x00A9 */	0x0800	/* nFullCAPRep */
			/* 0x00B3 */	0x0800	/* nDesignCap */
			/* 0x0046 */	0x0C80	/* dPacc */
			/* 0x00A5 */	0x0800	/* nFullCAPNom */
			/* 0x00C6 */	0xa55a	/* nV_empty */
			/* 0x00A0 */	0x390a	/* nQRTable00 */
			/* 0x00A1 */	0x1d85	/* nQRTable10 */
			/* 0x00A2 */	0x1002	/* nQRTable20 */
			/* 0x00A3 */	0x0b02	/* nQRTable30 */
			/* 0x00A6 */	0x07b0	/* nRCOMP0 */
			/* 0x00A7 */	0x2202	/* nTempCo */
			/* 0x009C */	0x0280	/* nIChgTerm */
			/* 0x00B2 */	0x3870	/* nMiscCFG */
			/* 0x009E */	0x0400	/* nModelCfg */
			/* 0x00CA */	0xC8FF	/* nThermCfg */
			/* 0x009D */	0xCEA4	/* nFilterCfg */
		>;
		max77779,fg_n_regval = /bits/ 16 <
			0xB7 0x2341	/* nConvgCfg */
		>;
		max77779,fg-aafv = /bits/ 32 <
			  0   95  0xf  0x0280
			 20   90  0xf  0x0140
			 40   85  0xf  0x0140
			 60   80  0xf  0x0140
			 80   75  0xf  0x0140
			100   70  0xf  0x0140
		>;
	};
};
