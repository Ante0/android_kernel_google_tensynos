// SPDX-License-Identifier: GPL-2.0-only
/*
 * Charging device tree entries specific to Tegu devices
 *
 * Copyright 2023 Google LLC
 *
 */

&google_charger {
	google,chg-power-supply = "main-charger";
};

&google_cpm {
	status = "disabled";
};
