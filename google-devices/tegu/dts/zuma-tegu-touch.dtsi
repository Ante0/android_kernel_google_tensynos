// SPDX-License-Identifier: GPL-2.0-only
/*
 * Google Tegu touch device tree source
 *
 * Copyright 2023 Google LLC.
 *
 */

&spitouch {
	goog,panel_map = <&google_gs_tg4a 0>, <&google_gs_tg4b 1>, <&google_gs_tg4c 1>;
	goog,touch_offload_ids = /bits/ 8 <'t' 'g' '4' '0' 't' 'g' '4' '1'>;
	goog,display-resolution = /bits/ 16 <1080 2424>;
	goog,channel-num = /bits/ 16 <16 36>;
	goog,offload-caps-data-types = /bits/ 16 <0x1F>;
	goog,offload-caps-scan-types = /bits/ 16 <0xC0>;
	goog,offload-caps-context-channel-types = /bits/ 16 <0x0100>;
	goog,offload-caps-coord-filter;
	goog,lptw-tracking-area = <440 640 1655 1855>;

	synaptics,pixels-per-mm = <17>;

	synaptics,panel_map = <&google_gs_tg4a 0>, <&google_gs_tg4b 1>, <&google_gs_tg4c 1>;
	synaptics,firmware_names = "synaptics.img", "synaptics_b.img";
	synaptics,test_algo = <0 1>;

	synaptics,pt05_high_name = "synaptics,pt05_high", "synaptics,pt05_high_b";
	synaptics,pt05_low_name = "synaptics,pt05_low", "synaptics,pt05_low_b";
	synaptics,pt05_gap_x_name = "synaptics,pt05_gap_x", "synaptics,pt05_gap_x_b";
	synaptics,pt05_gap_y_name = "synaptics,pt05_gap_y", "synaptics,pt05_gap_y_b";
	synaptics,pt0a_high_name = "synaptics,pt0a_high", "synaptics,pt0a_high_b";
	synaptics,pt0a_low_name = "synaptics,pt0a_low", "synaptics,pt0a_low_b";
	synaptics,pt10_high_name = "synaptics,pt10_high", "synaptics,pt10_high_b";
	synaptics,pt10_low_name = "synaptics,pt10_low", "synaptics,pt10_low_b";
	synaptics,pt10_gap_x_name = "synaptics,pt10_gap_x", "synaptics,pt10_gap_x_b";
	synaptics,pt10_gap_y_name = "synaptics,pt10_gap_y", "synaptics,pt10_gap_y_b";
	synaptics,pt11_high_name = "synaptics,pt11_high", "synaptics,pt11_high_b";
	synaptics,pt11_low_name = "synaptics,pt11_low", "synaptics,pt11_low_b";
	synaptics,pt12_high_name = "synaptics,pt12_high", "synaptics,pt12_high_b";
	synaptics,pt12_low_name = "synaptics,pt12_low", "synaptics,pt12_low_b";
	synaptics,pt16_high_name = "synaptics,pt16_high", "synaptics,pt16_high_b";
	synaptics,pt16_low_name = "synaptics,pt16_low", "synaptics,pt16_low_b";
	synaptics,pt_tag_moisture_name = "synaptics,pt_tag_moisture", "synaptics,pt_tag_moisture_b";

	/* For tg4a*/
	synaptics,pt05_high = /bits/ 16 <
700 900 900 900 900 900 900 900 900 900 900 900 900 900 900 900 900 900 900 900 900 900 900 900 900 900 900 900 900 900 900 900 900 900 900 450
900 900 900 900 900 900 900 900 900 900 900 900 900 900 900 900 900 900 900 900 900 900 900 900 900 900 900 900 900 900 900 900 900 900 900 900
900 900 700 700 700 700 700 700 700 700 700 700 700 700 700 700 700 700 700 700 700 700 700 700 700 700 700 700 700 700 700 700 700 700 900 900
900 900 700 700 700 700 700 700 700 700 700 700 700 700 700 700 700 700 700 700 700 700 700 700 700 700 700 700 700 700 700 700 700 700 900 900
900 900 700 700 700 700 700 700 700 700 700 700 700 700 700 700 700 700 700 700 700 700 700 700 700 700 700 700 700 700 700 700 700 700 900 900
900 900 700 700 700 700 700 700 700 700 700 700 700 700 700 700 700 700 700 700 700 700 700 700 700 700 700 700 700 700 700 700 700 700 900 900
900 900 700 700 700 700 700 700 700 700 700 700 700 700 700 700 700 700 700 700 700 700 700 700 700 700 700 700 700 700 700 700 700 700 900 900
900 900 900 700 700 700 700 700 700 700 700 700 700 700 700 700 700 700 700 700 700 700 700 700 700 700 700 700 700 700 700 700 700 700 900 900
900 900 900 700 700 700 700 700 700 700 700 700 700 700 700 700 700 700 700 700 700 700 700 700 700 700 700 700 700 700 700 700 700 700 900 900
900 900 700 700 700 700 700 700 700 700 700 700 700 700 700 700 700 700 700 700 700 700 700 700 700 700 700 700 700 700 700 700 700 700 900 900
900 900 700 700 700 700 700 700 700 700 700 700 700 700 700 700 700 700 700 700 700 700 700 700 700 700 700 700 700 700 700 700 700 700 900 900
900 900 700 700 700 700 700 700 700 700 700 700 700 700 700 700 700 700 700 700 700 700 700 700 700 700 700 700 700 700 700 700 700 700 900 900
900 900 700 700 700 700 700 700 700 700 700 700 700 700 700 700 700 700 700 700 700 700 700 700 700 700 700 700 700 700 700 700 700 700 900 900
900 900 700 700 700 700 700 700 700 700 700 700 700 700 700 700 700 700 700 700 700 700 700 700 700 700 700 700 700 700 700 700 700 700 900 900
900 900 900 900 900 900 900 900 900 900 900 900 900 900 900 900 900 900 900 900 900 900 900 900 900 900 900 900 900 900 900 900 900 900 900 900
450 900 900 900 900 900 900 900 900 900 900 900 900 900 900 900 900 900 900 900 900 900 900 900 900 900 900 900 900 900 900 900 900 900 900 700>;

	synaptics,pt05_low = /bits/ 16 <
100 200 200 200 200 200 200 200 200 200 200 200 200 200 200 200 200 200 200 200 200 200 200 200 200 200 200 200 200 200 200 200 200 200 200 25
200 200 200 200 200 200 200 200 200 200 200 200 200 200 200 200 200 200 200 200 200 200 200 200 200 200 200 200 200 200 200 200 200 200 200 200
200 200 200 200 200 200 200 200 200 200 200 200 200 200 200 200 200 200 200 200 200 200 200 200 200 200 200 200 200 200 200 200 200 200 200 200
200 200 200 200 200 200 200 200 200 200 200 200 200 200 200 200 200 200 200 200 200 200 200 200 200 200 200 200 200 200 200 200 200 200 200 200
200 200 200 200 200 200 200 200 200 200 200 200 200 200 200 200 200 200 200 200 200 200 200 200 200 200 200 200 200 200 200 200 200 200 200 200
200 200 200 200 200 200 200 200 200 200 200 200 200 200 200 200 200 200 200 200 200 200 200 200 200 200 200 200 200 200 200 200 200 200 200 200
200 200 200 200 200 200 200 200 200 200 200 200 200 200 200 200 200 200 200 200 200 200 200 200 200 200 200 200 200 200 200 200 200 200 200 200
200 200 200 200 200 200 200 200 200 200 200 200 200 200 200 200 200 200 200 200 200 200 200 200 200 200 200 200 200 200 200 200 200 200 200 200
200 200 200 200 200 200 200 200 200 200 200 200 200 200 200 200 200 200 200 200 200 200 200 200 200 200 200 200 200 200 200 200 200 200 200 200
200 200 200 200 200 200 200 200 200 200 200 200 200 200 200 200 200 200 200 200 200 200 200 200 200 200 200 200 200 200 200 200 200 200 200 200
200 200 200 200 200 200 200 200 200 200 200 200 200 200 200 200 200 200 200 200 200 200 200 200 200 200 200 200 200 200 200 200 200 200 200 200
200 200 200 200 200 200 200 200 200 200 200 200 200 200 200 200 200 200 200 200 200 200 200 200 200 200 200 200 200 200 200 200 200 200 200 200
200 200 200 200 200 200 200 200 200 200 200 200 200 200 200 200 200 200 200 200 200 200 200 200 200 200 200 200 200 200 200 200 200 200 200 200
200 200 200 200 200 200 200 200 200 200 200 200 200 200 200 200 200 200 200 200 200 200 200 200 200 200 200 200 200 200 200 200 200 200 200 200
200 200 200 200 200 200 200 200 200 200 200 200 200 200 200 200 200 200 200 200 200 200 200 200 200 200 200 200 200 200 200 200 200 200 200 200
10 200 200 200 200 200 200 200 200 200 200 200 200 200 200 200 200 200 200 200 200 200 200 200 200 200 200 200 200 200 200 200 200 200 200 100>;
	synaptics,pt05_gap_x = /bits/ 16 <
115 80 65 65 65 65 65 65 65 65 65 65 65 65 65 65 65 65 65 65 65 65 65 65 65 65 65 65 65 65 65 65 65 65 125 125
95 65 62 62 62 62 62 62 62 62 62 62 62 62 62 62 62 62 62 62 62 62 62 62 62 62 62 62 62 62 62 62 62 62 95 95
65 65 62 62 62 62 62 62 62 62 62 62 62 62 62 62 62 62 62 62 62 62 62 62 62 62 62 62 62 62 62 62 62 62 80 65
65 65 62 62 62 62 62 62 62 62 62 62 62 62 62 62 62 62 62 62 62 62 62 62 62 62 62 62 62 62 62 62 62 62 80 65
65 65 62 62 62 62 62 62 62 62 62 62 62 62 62 62 62 62 62 62 62 62 62 62 62 62 62 62 62 62 62 62 62 62 80 65
65 65 62 62 62 62 62 62 62 62 62 62 62 62 62 62 62 62 62 62 62 62 62 62 62 62 62 62 62 62 62 62 62 62 80 65
65 80 62 62 62 62 62 62 62 62 62 62 62 62 62 62 62 62 62 62 62 62 62 62 62 62 62 62 62 62 62 62 62 62 80 65
80 80 62 62 62 62 62 62 62 62 62 62 62 62 62 62 62 62 62 62 62 62 62 62 62 62 62 62 62 62 62 62 62 62 80 65
80 80 62 62 62 62 62 62 62 62 62 62 62 62 62 62 62 62 62 62 62 62 62 62 62 62 62 62 62 62 62 62 62 62 80 65
65 65 62 62 62 62 62 62 62 62 62 62 62 62 62 62 62 62 62 62 62 62 62 62 62 62 62 62 62 62 62 62 62 62 80 65
65 65 62 62 62 62 62 62 62 62 62 62 62 62 62 62 62 62 62 62 62 62 62 62 62 62 62 62 62 62 62 62 62 62 80 65
65 65 62 62 62 62 62 62 62 62 62 62 62 62 62 62 62 62 62 62 62 62 62 62 62 62 62 62 62 62 62 62 62 62 80 65
65 65 62 62 62 62 62 62 62 62 62 62 62 62 62 62 62 62 62 62 62 62 62 62 62 62 62 62 62 62 62 62 62 62 80 65
80 65 62 62 62 62 62 62 62 62 62 62 62 62 62 62 62 62 62 62 62 62 62 62 62 62 62 62 62 62 62 62 62 62 80 80
128 80 65 65 65 65 65 65 65 65 65 65 65 65 65 65 65 65 65 65 65 65 65 65 65 65 65 65 65 65 65 65 65 65 80 95
128 80 62 62 62 62 62 62 62 62 62 62 62 62 62 62 62 62 62 62 62 62 62 62 62 62 62 62 62 62 62 62 62 80 95 65>;
	synaptics,pt05_gap_y = /bits/ 16 <
115 80 65 65 65 65 65 65 65 65 65 65 65 65 65 65 65 65 65 65 65 65 65 65 65 65 65 65 65 65 65 65 65 65 125 125
95 65 62 62 62 62 62 62 62 62 62 62 62 62 62 62 62 62 62 62 62 62 62 62 62 62 62 62 62 62 62 62 62 62 95 95
65 65 62 62 62 62 62 62 62 62 62 62 62 62 62 62 62 62 62 62 62 62 62 62 62 62 62 62 62 62 62 62 62 62 80 65
65 65 62 62 62 62 62 62 62 62 62 62 62 62 62 62 62 62 62 62 62 62 62 62 62 62 62 62 62 62 62 62 62 62 80 65
65 65 62 62 62 62 62 62 62 62 62 62 62 62 62 62 62 62 62 62 62 62 62 62 62 62 62 62 62 62 62 62 62 62 80 65
65 65 62 62 62 62 62 62 62 62 62 62 62 62 62 62 62 62 62 62 62 62 62 62 62 62 62 62 62 62 62 62 62 62 80 65
65 80 62 62 62 62 62 62 62 62 62 62 62 62 62 62 62 62 62 62 62 62 62 62 62 62 62 62 62 62 62 62 62 62 80 65
80 80 62 62 62 62 62 62 62 62 62 62 62 62 62 62 62 62 62 62 62 62 62 62 62 62 62 62 62 62 62 62 62 62 80 65
80 80 62 62 62 62 62 62 62 62 62 62 62 62 62 62 62 62 62 62 62 62 62 62 62 62 62 62 62 62 62 62 62 62 80 65
65 65 62 62 62 62 62 62 62 62 62 62 62 62 62 62 62 62 62 62 62 62 62 62 62 62 62 62 62 62 62 62 62 62 80 65
65 65 62 62 62 62 62 62 62 62 62 62 62 62 62 62 62 62 62 62 62 62 62 62 62 62 62 62 62 62 62 62 62 62 80 65
65 65 62 62 62 62 62 62 62 62 62 62 62 62 62 62 62 62 62 62 62 62 62 62 62 62 62 62 62 62 62 62 62 62 80 65
65 65 62 62 62 62 62 62 62 62 62 62 62 62 62 62 62 62 62 62 62 62 62 62 62 62 62 62 62 62 62 62 62 62 80 65
80 65 62 62 62 62 62 62 62 62 62 62 62 62 62 62 62 62 62 62 62 62 62 62 62 62 62 62 62 62 62 62 62 62 80 80
128 80 65 65 65 65 65 65 65 65 65 65 65 65 65 65 65 65 65 65 65 65 65 65 65 65 65 65 65 65 65 65 65 65 80 95
128 80 62 62 62 62 62 62 62 62 62 62 62 62 62 62 62 62 62 62 62 62 62 62 62 62 62 62 62 62 62 62 62 80 95 65>;

	synaptics,pt0a_high = /bits/ 16 <
40 40 40 40 40 40 40 40 40 40 40 40 40 40 40 40 40 40 40 40 40 40 40 40 40 40 40 40 40 40 40 40 40 40 40 40
40 40 40 40 40 40 40 40 40 40 40 40 40 40 40 40 40 40 40 40 40 40 40 40 40 40 40 40 40 40 40 40 40 40 40 40
40 40 40 40 40 40 40 40 40 40 40 40 40 40 40 40 40 40 40 40 40 40 40 40 40 40 40 40 40 40 40 40 40 40 40 40
40 40 40 40 40 40 40 40 40 40 40 40 40 40 40 40 40 40 40 40 40 40 40 40 40 40 40 40 40 40 40 40 40 40 40 40
40 40 40 40 40 40 40 40 40 40 40 40 40 40 40 40 40 40 40 40 40 40 40 40 40 40 40 40 40 40 40 40 40 40 40 40
40 40 40 40 40 40 40 40 40 40 40 40 40 40 40 40 40 40 40 40 40 40 40 40 40 40 40 40 40 40 40 40 40 40 40 40
40 40 40 40 40 40 40 40 40 40 40 40 40 40 40 40 40 40 40 40 40 40 40 40 40 40 40 40 40 40 40 40 40 40 40 40
40 40 40 40 40 40 40 40 40 40 40 40 40 40 40 40 40 40 40 40 40 40 40 40 40 40 40 40 40 40 40 40 40 40 40 40
40 40 40 40 40 40 40 40 40 40 40 40 40 40 40 40 40 40 40 40 40 40 40 40 40 40 40 40 40 40 40 40 40 40 40 40
40 40 40 40 40 40 40 40 40 40 40 40 40 40 40 40 40 40 40 40 40 40 40 40 40 40 40 40 40 40 40 40 40 40 40 40
40 40 40 40 40 40 40 40 40 40 40 40 40 40 40 40 40 40 40 40 40 40 40 40 40 40 40 40 40 40 40 40 40 40 40 40
40 40 40 40 40 40 40 40 40 40 40 40 40 40 40 40 40 40 40 40 40 40 40 40 40 40 40 40 40 40 40 40 40 40 40 40
40 40 40 40 40 40 40 40 40 40 40 40 40 40 40 40 40 40 40 40 40 40 40 40 40 40 40 40 40 40 40 40 40 40 40 40
40 40 40 40 40 40 40 40 40 40 40 40 40 40 40 40 40 40 40 40 40 40 40 40 40 40 40 40 40 40 40 40 40 40 40 40
40 40 40 40 40 40 40 40 40 40 40 40 40 40 40 40 40 40 40 40 40 40 40 40 40 40 40 40 40 40 40 40 40 40 40 40
40 40 40 40 40 40 40 40 40 40 40 40 40 40 40 40 40 40 40 40 40 40 40 40 40 40 40 40 40 40 40 40 40 40 40 40>;
	synaptics,pt0a_low = /bits/ 16 <
(-40) (-40) (-40) (-40) (-40) (-40) (-40) (-40) (-40) (-40) (-40) (-40) (-40) (-40) (-40) (-40) (-40) (-40) (-40) (-40) (-40) (-40) (-40) (-40) (-40) (-40) (-40) (-40) (-40) (-40) (-40) (-40) (-40) (-40) (-40) (-40)
(-40) (-40) (-40) (-40) (-40) (-40) (-40) (-40) (-40) (-40) (-40) (-40) (-40) (-40) (-40) (-40) (-40) (-40) (-40) (-40) (-40) (-40) (-40) (-40) (-40) (-40) (-40) (-40) (-40) (-40) (-40) (-40) (-40) (-40) (-40) (-40)
(-40) (-40) (-40) (-40) (-40) (-40) (-40) (-40) (-40) (-40) (-40) (-40) (-40) (-40) (-40) (-40) (-40) (-40) (-40) (-40) (-40) (-40) (-40) (-40) (-40) (-40) (-40) (-40) (-40) (-40) (-40) (-40) (-40) (-40) (-40) (-40)
(-40) (-40) (-40) (-40) (-40) (-40) (-40) (-40) (-40) (-40) (-40) (-40) (-40) (-40) (-40) (-40) (-40) (-40) (-40) (-40) (-40) (-40) (-40) (-40) (-40) (-40) (-40) (-40) (-40) (-40) (-40) (-40) (-40) (-40) (-40) (-40)
(-40) (-40) (-40) (-40) (-40) (-40) (-40) (-40) (-40) (-40) (-40) (-40) (-40) (-40) (-40) (-40) (-40) (-40) (-40) (-40) (-40) (-40) (-40) (-40) (-40) (-40) (-40) (-40) (-40) (-40) (-40) (-40) (-40) (-40) (-40) (-40)
(-40) (-40) (-40) (-40) (-40) (-40) (-40) (-40) (-40) (-40) (-40) (-40) (-40) (-40) (-40) (-40) (-40) (-40) (-40) (-40) (-40) (-40) (-40) (-40) (-40) (-40) (-40) (-40) (-40) (-40) (-40) (-40) (-40) (-40) (-40) (-40)
(-40) (-40) (-40) (-40) (-40) (-40) (-40) (-40) (-40) (-40) (-40) (-40) (-40) (-40) (-40) (-40) (-40) (-40) (-40) (-40) (-40) (-40) (-40) (-40) (-40) (-40) (-40) (-40) (-40) (-40) (-40) (-40) (-40) (-40) (-40) (-40)
(-40) (-40) (-40) (-40) (-40) (-40) (-40) (-40) (-40) (-40) (-40) (-40) (-40) (-40) (-40) (-40) (-40) (-40) (-40) (-40) (-40) (-40) (-40) (-40) (-40) (-40) (-40) (-40) (-40) (-40) (-40) (-40) (-40) (-40) (-40) (-40)
(-40) (-40) (-40) (-40) (-40) (-40) (-40) (-40) (-40) (-40) (-40) (-40) (-40) (-40) (-40) (-40) (-40) (-40) (-40) (-40) (-40) (-40) (-40) (-40) (-40) (-40) (-40) (-40) (-40) (-40) (-40) (-40) (-40) (-40) (-40) (-40)
(-40) (-40) (-40) (-40) (-40) (-40) (-40) (-40) (-40) (-40) (-40) (-40) (-40) (-40) (-40) (-40) (-40) (-40) (-40) (-40) (-40) (-40) (-40) (-40) (-40) (-40) (-40) (-40) (-40) (-40) (-40) (-40) (-40) (-40) (-40) (-40)
(-40) (-40) (-40) (-40) (-40) (-40) (-40) (-40) (-40) (-40) (-40) (-40) (-40) (-40) (-40) (-40) (-40) (-40) (-40) (-40) (-40) (-40) (-40) (-40) (-40) (-40) (-40) (-40) (-40) (-40) (-40) (-40) (-40) (-40) (-40) (-40)
(-40) (-40) (-40) (-40) (-40) (-40) (-40) (-40) (-40) (-40) (-40) (-40) (-40) (-40) (-40) (-40) (-40) (-40) (-40) (-40) (-40) (-40) (-40) (-40) (-40) (-40) (-40) (-40) (-40) (-40) (-40) (-40) (-40) (-40) (-40) (-40)
(-40) (-40) (-40) (-40) (-40) (-40) (-40) (-40) (-40) (-40) (-40) (-40) (-40) (-40) (-40) (-40) (-40) (-40) (-40) (-40) (-40) (-40) (-40) (-40) (-40) (-40) (-40) (-40) (-40) (-40) (-40) (-40) (-40) (-40) (-40) (-40)
(-40) (-40) (-40) (-40) (-40) (-40) (-40) (-40) (-40) (-40) (-40) (-40) (-40) (-40) (-40) (-40) (-40) (-40) (-40) (-40) (-40) (-40) (-40) (-40) (-40) (-40) (-40) (-40) (-40) (-40) (-40) (-40) (-40) (-40) (-40) (-40)
(-40) (-40) (-40) (-40) (-40) (-40) (-40) (-40) (-40) (-40) (-40) (-40) (-40) (-40) (-40) (-40) (-40) (-40) (-40) (-40) (-40) (-40) (-40) (-40) (-40) (-40) (-40) (-40) (-40) (-40) (-40) (-40) (-40) (-40) (-40) (-40)
(-40) (-40) (-40) (-40) (-40) (-40) (-40) (-40) (-40) (-40) (-40) (-40) (-40) (-40) (-40) (-40) (-40) (-40) (-40) (-40) (-40) (-40) (-40) (-40) (-40) (-40) (-40) (-40) (-40) (-40) (-40) (-40) (-40) (-40) (-40) (-40)>;

	synaptics,pt10_high =  /bits/ 16 <
45 45 45 45 45 45 45 45 45 45 45 45 45 45 45 45 45 45 45 45 45 45 45 45 45 45 45 45 45 45 45 45 45 45 45 45
45 45 45 45 45 45 45 45 45 45 45 45 45 45 45 45 45 45 45 45 45 45 45 45 45 45 45 45 45 45 45 45 45 45 45 45
45 45 45 45 45 45 45 45 45 45 45 45 45 45 45 45 45 45 45 45 45 45 45 45 45 45 45 45 45 45 45 45 45 45 45 45
45 45 45 45 45 45 45 45 45 45 45 45 45 45 45 45 45 45 45 45 45 45 45 45 45 45 45 45 45 45 45 45 45 45 45 45
45 45 45 45 45 45 45 45 45 45 45 45 45 45 45 45 45 45 45 45 45 45 45 45 45 45 45 45 45 45 45 45 45 45 45 45
45 45 45 45 45 45 45 45 45 45 45 45 45 45 45 45 45 45 45 45 45 45 45 45 45 45 45 45 45 45 45 45 45 45 45 45
45 45 45 45 45 45 45 45 45 45 45 45 45 45 45 45 45 45 45 45 45 45 45 45 45 45 45 45 45 45 45 45 45 45 45 45
45 45 45 45 45 45 45 45 45 45 45 45 45 45 45 45 45 45 45 45 45 45 45 45 45 45 45 45 45 45 45 45 45 45 45 45
45 45 45 45 45 45 45 45 45 45 45 45 45 45 45 45 45 45 45 45 45 45 45 45 45 45 45 45 45 45 45 45 45 45 45 45
45 45 45 45 45 45 45 45 45 45 45 45 45 45 45 45 45 45 45 45 45 45 45 45 45 45 45 45 45 45 45 45 45 45 45 45
45 45 45 45 45 45 45 45 45 45 45 45 45 45 45 45 45 45 45 45 45 45 45 45 45 45 45 45 45 45 45 45 45 45 45 45
45 45 45 45 45 45 45 45 45 45 45 45 45 45 45 45 45 45 45 45 45 45 45 45 45 45 45 45 45 45 45 45 45 45 45 45
45 45 45 45 45 45 45 45 45 45 45 45 45 45 45 45 45 45 45 45 45 45 45 45 45 45 45 45 45 45 45 45 45 45 45 45
45 45 45 45 45 45 45 45 45 45 45 45 45 45 45 45 45 45 45 45 45 45 45 45 45 45 45 45 45 45 45 45 45 45 45 45
45 45 45 45 45 45 45 45 45 45 45 45 45 45 45 45 45 45 45 45 45 45 45 45 45 45 45 45 45 45 45 45 45 45 45 45
45 45 45 45 45 45 45 45 45 45 45 45 45 45 45 45 45 45 45 45 45 45 45 45 45 45 45 45 45 45 45 45 45 45 45 45>;
	synaptics,pt10_low = /bits/ 16 <
0 0 0 0 0 0 0 0 0 0 0 0 0 0 0 0 0 0 0 0 0 0 0 0 0 0 0 0 0 0 0 0 0 0 0 0
0 0 0 0 0 0 0 0 0 0 0 0 0 0 0 0 0 0 0 0 0 0 0 0 0 0 0 0 0 0 0 0 0 0 0 0
0 0 0 0 0 0 0 0 0 0 0 0 0 0 0 0 0 0 0 0 0 0 0 0 0 0 0 0 0 0 0 0 0 0 0 0
0 0 0 0 0 0 0 0 0 0 0 0 0 0 0 0 0 0 0 0 0 0 0 0 0 0 0 0 0 0 0 0 0 0 0 0
0 0 0 0 0 0 0 0 0 0 0 0 0 0 0 0 0 0 0 0 0 0 0 0 0 0 0 0 0 0 0 0 0 0 0 0
0 0 0 0 0 0 0 0 0 0 0 0 0 0 0 0 0 0 0 0 0 0 0 0 0 0 0 0 0 0 0 0 0 0 0 0
0 0 0 0 0 0 0 0 0 0 0 0 0 0 0 0 0 0 0 0 0 0 0 0 0 0 0 0 0 0 0 0 0 0 0 0
0 0 0 0 0 0 0 0 0 0 0 0 0 0 0 0 0 0 0 0 0 0 0 0 0 0 0 0 0 0 0 0 0 0 0 0
0 0 0 0 0 0 0 0 0 0 0 0 0 0 0 0 0 0 0 0 0 0 0 0 0 0 0 0 0 0 0 0 0 0 0 0
0 0 0 0 0 0 0 0 0 0 0 0 0 0 0 0 0 0 0 0 0 0 0 0 0 0 0 0 0 0 0 0 0 0 0 0
0 0 0 0 0 0 0 0 0 0 0 0 0 0 0 0 0 0 0 0 0 0 0 0 0 0 0 0 0 0 0 0 0 0 0 0
0 0 0 0 0 0 0 0 0 0 0 0 0 0 0 0 0 0 0 0 0 0 0 0 0 0 0 0 0 0 0 0 0 0 0 0
0 0 0 0 0 0 0 0 0 0 0 0 0 0 0 0 0 0 0 0 0 0 0 0 0 0 0 0 0 0 0 0 0 0 0 0
0 0 0 0 0 0 0 0 0 0 0 0 0 0 0 0 0 0 0 0 0 0 0 0 0 0 0 0 0 0 0 0 0 0 0 0
0 0 0 0 0 0 0 0 0 0 0 0 0 0 0 0 0 0 0 0 0 0 0 0 0 0 0 0 0 0 0 0 0 0 0 0
0 0 0 0 0 0 0 0 0 0 0 0 0 0 0 0 0 0 0 0 0 0 0 0 0 0 0 0 0 0 0 0 0 0 0 0>;
	synaptics,pt10_gap_x = /bits/ 16 <
45 45 45 45 45 45 45 45 45 45 45 45 45 45 45 45 45 45 45 45 45 45 45 45 45 45 45 45 45 45 45 45 45 45 45 45
45 45 45 45 45 45 45 45 45 45 45 45 45 45 45 45 45 45 45 45 45 45 45 45 45 45 45 45 45 45 45 45 45 45 45 45
45 45 45 45 45 45 45 45 45 45 45 45 45 45 45 45 45 45 45 45 45 45 45 45 45 45 45 45 45 45 45 45 45 45 45 45
45 45 45 45 45 45 45 45 45 45 45 45 45 45 45 45 45 45 45 45 45 45 45 45 45 45 45 45 45 45 45 45 45 45 45 45
45 45 45 45 45 45 45 45 45 45 45 45 45 45 45 45 45 45 45 45 45 45 45 45 45 45 45 45 45 45 45 45 45 45 45 45
45 45 45 45 45 45 45 45 45 45 45 45 45 45 45 45 45 45 45 45 45 45 45 45 45 45 45 45 45 45 45 45 45 45 45 45
45 45 45 45 45 45 45 45 45 45 45 45 45 45 45 45 45 45 45 45 45 45 45 45 45 45 45 45 45 45 45 45 45 45 45 45
45 45 45 45 45 45 45 45 45 45 45 45 45 45 45 45 45 45 45 45 45 45 45 45 45 45 45 45 45 45 45 45 45 45 45 45
45 45 45 45 45 45 45 45 45 45 45 45 45 45 45 45 45 45 45 45 45 45 45 45 45 45 45 45 45 45 45 45 45 45 45 45
45 45 45 45 45 45 45 45 45 45 45 45 45 45 45 45 45 45 45 45 45 45 45 45 45 45 45 45 45 45 45 45 45 45 45 45
45 45 45 45 45 45 45 45 45 45 45 45 45 45 45 45 45 45 45 45 45 45 45 45 45 45 45 45 45 45 45 45 45 45 45 45
45 45 45 45 45 45 45 45 45 45 45 45 45 45 45 45 45 45 45 45 45 45 45 45 45 45 45 45 45 45 45 45 45 45 45 45
45 45 45 45 45 45 45 45 45 45 45 45 45 45 45 45 45 45 45 45 45 45 45 45 45 45 45 45 45 45 45 45 45 45 45 45
45 45 45 45 45 45 45 45 45 45 45 45 45 45 45 45 45 45 45 45 45 45 45 45 45 45 45 45 45 45 45 45 45 45 45 45
45 45 45 45 45 45 45 45 45 45 45 45 45 45 45 45 45 45 45 45 45 45 45 45 45 45 45 45 45 45 45 45 45 45 45 45
45 45 45 45 45 45 45 45 45 45 45 45 45 45 45 45 45 45 45 45 45 45 45 45 45 45 45 45 45 45 45 45 45 45 45 45>;
	synaptics,pt10_gap_y = /bits/ 16 <
45 45 45 45 45 45 45 45 45 45 45 45 45 45 45 45 45 45 45 45 45 45 45 45 45 45 45 45 45 45 45 45 45 45 45 45
45 45 45 45 45 45 45 45 45 45 45 45 45 45 45 45 45 45 45 45 45 45 45 45 45 45 45 45 45 45 45 45 45 45 45 45
45 45 45 45 45 45 45 45 45 45 45 45 45 45 45 45 45 45 45 45 45 45 45 45 45 45 45 45 45 45 45 45 45 45 45 45
45 45 45 45 45 45 45 45 45 45 45 45 45 45 45 45 45 45 45 45 45 45 45 45 45 45 45 45 45 45 45 45 45 45 45 45
45 45 45 45 45 45 45 45 45 45 45 45 45 45 45 45 45 45 45 45 45 45 45 45 45 45 45 45 45 45 45 45 45 45 45 45
45 45 45 45 45 45 45 45 45 45 45 45 45 45 45 45 45 45 45 45 45 45 45 45 45 45 45 45 45 45 45 45 45 45 45 45
45 45 45 45 45 45 45 45 45 45 45 45 45 45 45 45 45 45 45 45 45 45 45 45 45 45 45 45 45 45 45 45 45 45 45 45
45 45 45 45 45 45 45 45 45 45 45 45 45 45 45 45 45 45 45 45 45 45 45 45 45 45 45 45 45 45 45 45 45 45 45 45
45 45 45 45 45 45 45 45 45 45 45 45 45 45 45 45 45 45 45 45 45 45 45 45 45 45 45 45 45 45 45 45 45 45 45 45
45 45 45 45 45 45 45 45 45 45 45 45 45 45 45 45 45 45 45 45 45 45 45 45 45 45 45 45 45 45 45 45 45 45 45 45
45 45 45 45 45 45 45 45 45 45 45 45 45 45 45 45 45 45 45 45 45 45 45 45 45 45 45 45 45 45 45 45 45 45 45 45
45 45 45 45 45 45 45 45 45 45 45 45 45 45 45 45 45 45 45 45 45 45 45 45 45 45 45 45 45 45 45 45 45 45 45 45
45 45 45 45 45 45 45 45 45 45 45 45 45 45 45 45 45 45 45 45 45 45 45 45 45 45 45 45 45 45 45 45 45 45 45 45
45 45 45 45 45 45 45 45 45 45 45 45 45 45 45 45 45 45 45 45 45 45 45 45 45 45 45 45 45 45 45 45 45 45 45 45
45 45 45 45 45 45 45 45 45 45 45 45 45 45 45 45 45 45 45 45 45 45 45 45 45 45 45 45 45 45 45 45 45 45 45 45
45 45 45 45 45 45 45 45 45 45 45 45 45 45 45 45 45 45 45 45 45 45 45 45 45 45 45 45 45 45 45 45 45 45 45 45>;

	synaptics,pt11_high =  /bits/ 16 <
180 180 180 180 180 180 180 180 180 180 180 180 180 180 180 180 180 180 180 180 180 180 180 180 180 180 180 180 180 180 180 180 180 180 180 180
180 180 180 180 180 180 180 180 180 180 180 180 180 180 180 180 180 180 180 180 180 180 180 180 180 180 180 180 180 180 180 180 180 180 180 180
180 180 180 180 180 180 180 180 180 180 180 180 180 180 180 180 180 180 180 180 180 180 180 180 180 180 180 180 180 180 180 180 180 180 180 180
180 180 180 180 180 180 180 180 180 180 180 180 180 180 180 180 180 180 180 180 180 180 180 180 180 180 180 180 180 180 180 180 180 180 180 180
180 180 180 180 180 180 180 180 180 180 180 180 180 180 180 180 180 180 180 180 180 180 180 180 180 180 180 180 180 180 180 180 180 180 180 180
180 180 180 180 180 180 180 180 180 180 180 180 180 180 180 180 180 180 180 180 180 180 180 180 180 180 180 180 180 180 180 180 180 180 180 180
180 180 180 180 180 180 180 180 180 180 180 180 180 180 180 180 180 180 180 180 180 180 180 180 180 180 180 180 180 180 180 180 180 180 180 180
180 180 180 180 180 180 180 180 180 180 180 180 180 180 180 180 180 180 180 180 180 180 180 180 180 180 180 180 180 180 180 180 180 180 180 180
180 180 180 180 180 180 180 180 180 180 180 180 180 180 180 180 180 180 180 180 180 180 180 180 180 180 180 180 180 180 180 180 180 180 180 180
180 180 180 180 180 180 180 180 180 180 180 180 180 180 180 180 180 180 180 180 180 180 180 180 180 180 180 180 180 180 180 180 180 180 180 180
180 180 180 180 180 180 180 180 180 180 180 180 180 180 180 180 180 180 180 180 180 180 180 180 180 180 180 180 180 180 180 180 180 180 180 180
180 180 180 180 180 180 180 180 180 180 180 180 180 180 180 180 180 180 180 180 180 180 180 180 180 180 180 180 180 180 180 180 180 180 180 180
180 180 180 180 180 180 180 180 180 180 180 180 180 180 180 180 180 180 180 180 180 180 180 180 180 180 180 180 180 180 180 180 180 180 180 180
180 180 180 180 180 180 180 180 180 180 180 180 180 180 180 180 180 180 180 180 180 180 180 180 180 180 180 180 180 180 180 180 180 180 180 180
180 180 180 180 180 180 180 180 180 180 180 180 180 180 180 180 180 180 180 180 180 180 180 180 180 180 180 180 180 180 180 180 180 180 180 180
180 180 180 180 180 180 180 180 180 180 180 180 180 180 180 180 180 180 180 180 180 180 180 180 180 180 180 180 180 180 180 180 180 180 180 180>;
	synaptics,pt11_low = /bits/ 16 <
70 70 70 70 70 70 70 70 70 70 70 70 70 70 70 70 70 70 70 70 70 70 70 70 70 70 70 70 70 70 70 70 70 70 70 70
70 70 70 70 70 70 70 70 70 70 70 70 70 70 70 70 70 70 70 70 70 70 70 70 70 70 70 70 70 70 70 70 70 70 70 70
70 70 70 70 70 70 70 70 70 70 70 70 70 70 70 70 70 70 70 70 70 70 70 70 70 70 70 70 70 70 70 70 70 70 70 70
70 70 70 70 70 70 70 70 70 70 70 70 70 70 70 70 70 70 70 70 70 70 70 70 70 70 70 70 70 70 70 70 70 70 70 70
70 70 70 70 70 70 70 70 70 70 70 70 70 70 70 70 70 70 70 70 70 70 70 70 70 70 70 70 70 70 70 70 70 70 70 70
70 70 70 70 70 70 70 70 70 70 70 70 70 70 70 70 70 70 70 70 70 70 70 70 70 70 70 70 70 70 70 70 70 70 70 70
70 70 70 70 70 70 70 70 70 70 70 70 70 70 70 70 70 70 70 70 70 70 70 70 70 70 70 70 70 70 70 70 70 70 70 70
70 70 70 70 70 70 70 70 70 70 70 70 70 70 70 70 70 70 70 70 70 70 70 70 70 70 70 70 70 70 70 70 70 70 70 70
70 70 70 70 70 70 70 70 70 70 70 70 70 70 70 70 70 70 70 70 70 70 70 70 70 70 70 70 70 70 70 70 70 70 70 70
70 70 70 70 70 70 70 70 70 70 70 70 70 70 70 70 70 70 70 70 70 70 70 70 70 70 70 70 70 70 70 70 70 70 70 70
70 70 70 70 70 70 70 70 70 70 70 70 70 70 70 70 70 70 70 70 70 70 70 70 70 70 70 70 70 70 70 70 70 70 70 70
70 70 70 70 70 70 70 70 70 70 70 70 70 70 70 70 70 70 70 70 70 70 70 70 70 70 70 70 70 70 70 70 70 70 70 70
70 70 70 70 70 70 70 70 70 70 70 70 70 70 70 70 70 70 70 70 70 70 70 70 70 70 70 70 70 70 70 70 70 70 70 70
70 70 70 70 70 70 70 70 70 70 70 70 70 70 70 70 70 70 70 70 70 70 70 70 70 70 70 70 70 70 70 70 70 70 70 70
70 70 70 70 70 70 70 70 70 70 70 70 70 70 70 70 70 70 70 70 70 70 70 70 70 70 70 70 70 70 70 70 70 70 70 70
70 70 70 70 70 70 70 70 70 70 70 70 70 70 70 70 70 70 70 70 70 70 70 70 70 70 70 70 70 70 70 70 70 70 70 70>;

	synaptics,pt12_high = <
270000 270000 270000 270000 270000 270000 270000 270000 270000 270000 270000 270000 270000 270000 270000 270000 270000 270000 270000 270000 270000 270000 270000 270000 270000 270000 270000 270000 270000 270000 270000 270000 270000 270000 270000 270000 380000 380000 380000 380000 380000 380000 380000 380000 380000 380000 380000 380000 380000 380000 380000 380000>;
	 synaptics,pt12_low = <
170000 170000 170000 170000 170000 170000 170000 170000 170000 170000 170000 170000 170000 170000 170000 170000 170000 170000 170000 170000 170000 170000 170000 170000 170000 170000 170000 170000 170000 170000 170000 170000 170000 170000 170000 170000 270000 270000 270000 270000 270000 270000 270000 270000 270000 270000 270000 270000 270000 270000 270000 270000>;

	synaptics,pt16_high =  /bits/ 16 <
500 700 700 700 700 700 700 700 700 700 700 700 700 700 700 700 700 700 700 700 700 700 700 700 700 700 700 700 700 700 700 700 700 700 700 250
700 700 700 700 700 700 700 700 700 700 700 700 700 700 700 700 700 700 700 700 700 700 700 700 700 700 700 700 700 700 700 700 700 700 700 700
700 700 700 700 700 700 700 700 700 700 700 700 700 700 700 700 700 700 700 700 700 700 700 700 700 700 700 700 700 700 700 700 700 700 700 700
700 700 700 700 700 700 700 700 700 700 700 700 700 700 700 700 700 700 700 700 700 700 700 700 700 700 700 700 700 700 700 700 700 700 700 700
700 700 700 700 700 700 700 700 700 700 700 700 700 700 700 700 700 700 700 700 700 700 700 700 700 700 700 700 700 700 700 700 700 700 700 700
700 700 700 700 700 700 700 700 700 700 700 700 700 700 700 700 700 700 700 700 700 700 700 700 700 700 700 700 700 700 700 700 700 700 700 700
700 700 700 700 700 700 700 700 700 700 700 700 700 700 700 700 700 700 700 700 700 700 700 700 700 700 700 700 700 700 700 700 700 700 700 700
700 700 700 700 700 700 700 700 700 700 700 700 700 700 700 700 700 700 700 700 700 700 700 700 700 700 700 700 700 700 700 700 700 700 700 700
700 700 700 700 700 700 700 700 700 700 700 700 700 700 700 700 700 700 700 700 700 700 700 700 700 700 700 700 700 700 700 700 700 700 700 700
700 700 700 700 700 700 700 700 700 700 700 700 700 700 700 700 700 700 700 700 700 700 700 700 700 700 700 700 700 700 700 700 700 700 700 700
700 700 700 700 700 700 700 700 700 700 700 700 700 700 700 700 700 700 700 700 700 700 700 700 700 700 700 700 700 700 700 700 700 700 700 700
700 700 700 700 700 700 700 700 700 700 700 700 700 700 700 700 700 700 700 700 700 700 700 700 700 700 700 700 700 700 700 700 700 700 700 700
700 700 700 700 700 700 700 700 700 700 700 700 700 700 700 700 700 700 700 700 700 700 700 700 700 700 700 700 700 700 700 700 700 700 700 700
700 700 700 700 700 700 700 700 700 700 700 700 700 700 700 700 700 700 700 700 700 700 700 700 700 700 700 700 700 700 700 700 700 700 700 700
700 700 700 700 700 700 700 700 700 700 700 700 700 700 700 700 700 700 700 700 700 700 700 700 700 700 700 700 700 700 700 700 700 700 700 700
250 700 700 700 700 700 700 700 700 700 700 700 700 700 700 700 700 700 700 700 700 700 700 700 700 700 700 700 700 700 700 700 700 700 700 500>;
	synaptics,pt16_low = /bits/ 16 <
150 200 200 200 200 200 200 200 200 200 200 200 200 200 200 200 200 200 200 200 200 200 200 200 200 200 200 200 200 200 200 200 200 200 200 50
200 200 200 200 200 200 200 200 200 200 200 200 200 200 200 200 200 200 200 200 200 200 200 200 200 200 200 200 200 200 200 200 200 200 200 200
200 200 200 200 200 200 200 200 200 200 200 200 200 200 200 200 200 200 200 200 200 200 200 200 200 200 200 200 200 200 200 200 200 200 200 200
200 200 200 200 200 200 200 200 200 200 200 200 200 200 200 200 200 200 200 200 200 200 200 200 200 200 200 200 200 200 200 200 200 200 200 200
200 200 200 200 200 200 200 200 200 200 200 200 200 200 200 200 200 200 200 200 200 200 200 200 200 200 200 200 200 200 200 200 200 200 200 200
200 200 200 200 200 200 200 200 200 200 200 200 200 200 200 200 200 200 200 200 200 200 200 200 200 200 200 200 200 200 200 200 200 200 200 200
200 200 200 200 200 200 200 200 200 200 200 200 200 200 200 200 200 200 200 200 200 200 200 200 200 200 200 200 200 200 200 200 200 200 200 200
200 200 200 200 200 200 200 200 200 200 200 200 200 200 200 200 200 200 200 200 200 200 200 200 200 200 200 200 200 200 200 200 200 200 200 200
200 200 200 200 200 200 200 200 200 200 200 200 200 200 200 200 200 200 200 200 200 200 200 200 200 200 200 200 200 200 200 200 200 200 200 200
200 200 200 200 200 200 200 200 200 200 200 200 200 200 200 200 200 200 200 200 200 200 200 200 200 200 200 200 200 200 200 200 200 200 200 200
200 200 200 200 200 200 200 200 200 200 200 200 200 200 200 200 200 200 200 200 200 200 200 200 200 200 200 200 200 200 200 200 200 200 200 200
200 200 200 200 200 200 200 200 200 200 200 200 200 200 200 200 200 200 200 200 200 200 200 200 200 200 200 200 200 200 200 200 200 200 200 200
200 200 200 200 200 200 200 200 200 200 200 200 200 200 200 200 200 200 200 200 200 200 200 200 200 200 200 200 200 200 200 200 200 200 200 200
200 200 200 200 200 200 200 200 200 200 200 200 200 200 200 200 200 200 200 200 200 200 200 200 200 200 200 200 200 200 200 200 200 200 200 200
200 200 200 200 200 200 200 200 200 200 200 200 200 200 200 200 200 200 200 200 200 200 200 200 200 200 200 200 200 200 200 200 200 200 200 200
35 200 200 200 200 200 200 200 200 200 200 200 200 200 200 200 200 200 200 200 200 200 200 200 200 200 200 200 200 200 200 200 200 200 200 150>;

	synaptics,pt_tag_moisture = /bits/ 16 <
1000 1000 1000 1000 1000 1000 1000 1000 1000 1000 1000 1000 1000 1000 1000 1000 1000 1000 1000 1000 1000 1000 1000 1000 1000 1000 1000 1000 1000 1000 1000 1000 1000 1000 1000 0
1000 1000 1000 1000 1000 1000 1000 1000 1000 1000 1000 1000 1000 1000 1000 1000 1000 1000 1000 1000 1000 1000 1000 1000 1000 1000 1000 1000 1000 1000 1000 1000 1000 1000 1000 0
1000 1000 150 150 150 150 150 150 150 150 150 150 150 150 150 150 150 150 150 150 150 150 150 150 150 150 150 150 150 150 150 150 150 1000 1000 0
1000 1000 150 150 150 150 150 150 150 150 150 150 150 150 150 150 150 150 150 150 150 150 150 150 150 150 150 150 150 150 150 150 150 1000 1000 0
1000 1000 150 150 150 150 150 150 150 150 150 150 150 150 150 150 150 150 150 150 150 150 150 150 150 150 150 150 150 150 150 150 150 1000 1000 0
1000 1000 150 150 150 150 150 150 150 150 150 150 150 150 150 150 150 150 150 150 150 150 150 150 150 150 150 150 150 150 150 150 150 1000 1000 0
1000 1000 150 150 150 150 150 150 150 150 150 150 150 150 150 150 150 150 150 150 150 150 150 150 150 150 150 150 150 150 150 150 150 1000 1000 0
1000 1000 150 150 150 150 150 150 150 150 150 150 150 150 150 150 150 150 150 150 150 150 150 150 150 150 150 150 150 150 150 150 150 1000 1000 0
1000 1000 150 150 150 150 150 150 150 150 150 150 150 150 150 150 150 150 150 150 150 150 150 150 150 150 150 150 150 150 150 150 150 1000 1000 0
1000 1000 150 150 150 150 150 150 150 150 150 150 150 150 150 150 150 150 150 150 150 150 150 150 150 150 150 150 150 150 150 150 150 1000 1000 0
1000 1000 150 150 150 150 150 150 150 150 150 150 150 150 150 150 150 150 150 150 150 150 150 150 150 150 150 150 150 150 150 150 150 1000 1000 0
1000 1000 150 150 150 150 150 150 150 150 150 150 150 150 150 150 150 150 150 150 150 150 150 150 150 150 150 150 150 150 150 150 150 1000 1000 0
1000 1000 150 150 150 150 150 150 150 150 150 150 150 150 150 150 150 150 150 150 150 150 150 150 150 150 150 150 150 150 150 150 150 1000 1000 0
1000 1000 1000 1000 1000 1000 1000 1000 1000 1000 1000 1000 1000 1000 1000 1000 1000 1000 1000 1000 1000 1000 1000 1000 1000 1000 1000 1000 1000 1000 1000 1000 1000 1000 1000 0
1000 1000 1000 1000 1000 1000 1000 1000 1000 1000 1000 1000 1000 1000 1000 1000 1000 1000 1000 1000 1000 1000 1000 1000 1000 1000 1000 1000 1000 1000 1000 1000 1000 1000 1000 0
0 0 0 0 0 0 0 0 0 0 0 0 0 0 0 0 0 0 0 0 0 0 0 0 0 0 0 0 0 0 0 0 0 0 0 0>;

	/* For tg4b*/
	synaptics,pt05_high_b = /bits/ 16 <
466 1098 1240 1243 1241 1238 1237 1236 1257 1239 1239 1237 1235 1241 1241 1248 1259 1283 1142 1139 1141 1142 1141 1140 1140 1140 1139 1141 1142 1140 1139 1139 1140 1139 1024 429
946 1266 1260 1257 1254 1251 1248 1248 1280 1250 1251 1248 1243 1253 1246 1247 1249 1252 1240 1238 1240 1239 1242 1239 1241 1237 1240 1239 1241 1241 1237 1239 1241 1241 1242 1028
1046 1266 1059 1055 1053 1048 1045 1047 1045 1049 1048 1045 1041 1043 1043 1043 1044 1046 1038 1036 1038 1038 1040 1037 1038 1036 1039 1037 1039 1039 1034 1038 1039 1039 1241 1111
1046 1266 1058 1056 1052 1048 1044 1046 1045 1047 1047 1044 1040 1041 1040 1041 1040 1042 1038 1037 1038 1038 1039 1038 1038 1036 1040 1037 1039 1038 1033 1038 1039 1037 1239 1105
1045 1266 1057 1054 1051 1047 1044 1046 1044 1047 1047 1044 1038 1041 1038 1041 1039 1041 1038 1036 1038 1038 1038 1037 1038 1036 1040 1037 1040 1037 1033 1037 1039 1036 1238 1114
1045 1266 1057 1054 1052 1046 1043 1046 1045 1046 1047 1043 1039 1042 1037 1040 1038 1040 1038 1035 1038 1037 1039 1038 1039 1036 1039 1038 1041 1038 1033 1037 1039 1037 1238 1119
1044 1264 1057 1055 1052 1047 1043 1046 1045 1046 1047 1042 1038 1039 1037 1039 1038 1040 1038 1035 1038 1037 1039 1037 1039 1036 1039 1038 1041 1038 1033 1037 1038 1037 1237 1122
989 799 1229 1055 1051 1046 1043 1045 1045 1046 1047 1041 1038 1043 1037 1039 1037 1040 1038 1036 1038 1037 1038 1037 1039 1036 1039 1038 1040 1038 1033 1037 1038 1037 1237 1129
987 818 1236 1054 1051 1046 1043 1045 1044 1045 1046 1040 1037 1036 1036 1038 1036 1038 1039 1037 1038 1039 1040 1037 1040 1036 1039 1039 1042 1039 1034 1038 1039 1037 1237 1137
1043 1262 1057 1054 1050 1047 1043 1045 1044 1045 1046 1040 1037 1036 1036 1039 1037 1038 1038 1038 1040 1039 1039 1038 1040 1036 1040 1038 1042 1039 1034 1038 1039 1037 1237 1123
1043 1264 1056 1053 1049 1047 1043 1045 1043 1044 1045 1039 1038 1036 1036 1037 1036 1037 1039 1038 1040 1039 1040 1038 1040 1038 1040 1038 1041 1038 1034 1038 1038 1038 1237 1117
1043 1263 1055 1052 1049 1046 1043 1045 1043 1044 1045 1040 1038 1035 1037 1037 1036 1037 1040 1038 1039 1039 1039 1038 1040 1038 1039 1038 1041 1039 1034 1038 1038 1037 1236 1114
1042 1263 1054 1053 1048 1046 1042 1044 1043 1044 1044 1039 1038 1035 1037 1037 1036 1037 1039 1038 1040 1039 1039 1038 1039 1039 1039 1037 1040 1038 1034 1037 1037 1038 1235 1108
1042 1263 1053 1052 1047 1044 1041 1044 1042 1042 1043 1038 1037 1035 1036 1036 1036 1036 1039 1037 1040 1039 1039 1038 1041 1040 1038 1037 1041 1039 1035 1038 1037 1039 1238 1121
930 1261 1253 1251 1247 1243 1241 1243 1241 1242 1243 1239 1236 1235 1235 1235 1234 1235 1237 1236 1238 1239 1239 1238 1240 1258 1237 1236 1240 1238 1236 1239 1238 1248 1237 1019
366 1026 1177 1178 1177 1173 1171 1170 1169 1171 1170 1169 1165 1164 1165 1164 1163 1165 1211 1213 1209 1211 1207 1210 1207 1214 1207 1208 1204 1206 1204 1203 1207 1195 1109 524>;

	synaptics,pt05_low_b = /bits/ 16 <
85 514 599 601 600 598 598 597 609 599 599 598 596 600 600 604 611 625 540 538 540 540 540 539 539 539 539 540 541 539 538 539 539 539 470 71
423 615 611 609 608 606 604 604 623 605 606 604 601 607 603 603 605 606 599 598 599 599 600 598 600 597 599 599 600 600 597 598 600 600 601 472
483 615 611 608 607 604 602 603 602 604 604 602 600 601 601 601 602 603 598 597 598 598 599 598 598 597 599 597 598 599 596 598 599 598 600 522
483 615 610 609 606 604 602 603 602 603 604 601 599 600 599 600 599 600 598 597 598 598 599 598 598 597 599 597 599 598 595 598 599 598 599 518
482 615 610 608 606 603 601 603 602 603 603 601 598 600 598 600 598 600 598 597 598 598 598 598 598 597 599 597 599 598 595 597 598 597 598 524
482 615 610 607 606 603 601 603 602 603 603 601 598 600 598 599 598 599 598 596 598 597 598 598 598 597 599 598 600 598 595 597 598 597 598 527
482 613 610 608 606 603 601 603 602 603 603 600 598 599 597 599 598 599 598 596 598 598 598 598 599 597 599 598 600 598 595 598 598 597 598 529
448 335 593 608 606 603 601 602 602 603 603 600 598 601 598 599 598 599 598 597 598 598 598 597 599 597 599 598 600 598 595 597 598 597 598 533
447 346 597 608 606 603 601 602 602 602 603 599 598 597 597 598 597 598 599 597 598 598 599 598 599 597 599 598 600 599 596 598 598 598 597 538
481 613 610 607 605 603 601 602 602 602 603 599 598 597 597 598 597 598 598 598 599 598 599 598 599 597 599 598 601 599 596 598 598 597 597 529
481 614 609 607 605 603 601 602 601 602 602 599 598 597 597 598 597 598 599 598 599 599 599 598 599 598 599 598 600 598 596 598 598 598 597 525
481 613 608 607 604 603 601 602 601 602 602 599 598 596 597 597 597 597 599 598 599 598 598 598 599 598 599 598 600 598 596 598 598 597 597 523
481 613 608 607 604 603 600 602 601 602 602 599 598 596 597 597 597 598 599 598 599 598 598 598 599 598 598 598 599 598 596 598 597 598 596 520
480 613 607 606 604 602 600 602 600 600 601 598 597 596 597 597 597 597 599 598 599 599 599 598 600 599 598 598 600 599 596 598 598 599 598 528
413 612 607 606 604 601 600 601 600 600 601 598 597 596 596 596 596 596 597 597 598 599 599 598 599 610 598 597 599 598 597 598 598 604 597 467
47 471 561 562 562 559 558 557 557 558 557 556 554 554 554 554 553 554 582 583 581 582 580 581 579 584 579 580 577 579 578 577 579 572 521 107>;
	synaptics,pt05_gap_x_b = /bits/ 16 <
472 74 56 55 56 55 56 55 55 56 56 56 56 56 56 57 57 69 56 56 56 56 58 58 56 57 56 55 57 56 58 57 57 68 213
107 50 50 50 50 50 50 50 50 50 50 50 50 50 50 50 50 50 50 50 50 50 50 50 50 50 50 50 50 50 50 50 50 50 79
88 50 50 50 50 50 50 50 50 50 50 50 50 50 50 50 50 50 50 50 50 50 50 50 50 50 50 50 50 50 50 50 50 50 71
88 50 50 50 50 50 50 50 50 50 50 50 50 50 50 50 50 50 50 50 50 50 50 50 50 50 50 50 50 50 50 50 50 50 71
87 50 50 50 50 50 50 50 50 50 50 50 50 50 50 50 50 50 50 50 50 50 50 50 50 50 50 50 50 50 50 50 50 50 70
88 50 50 50 50 50 50 50 50 50 50 50 50 50 50 50 50 50 50 50 50 50 50 50 50 50 50 50 50 50 50 50 50 50 67
88 50 50 50 50 50 50 50 50 50 50 50 50 50 50 50 50 50 50 50 50 50 50 50 50 50 50 50 50 50 50 50 50 50 67
76 127 50 50 50 50 50 50 50 50 50 50 50 50 50 50 50 50 50 50 50 50 50 50 50 50 50 50 50 50 50 50 50 50 67
76 127 50 50 50 50 50 50 50 50 50 50 50 50 50 50 50 50 50 50 50 50 50 50 50 50 50 50 50 50 50 50 50 50 67
86 50 50 50 50 50 50 50 50 50 50 50 50 50 50 50 50 50 50 50 50 50 50 50 50 50 50 50 50 50 50 50 50 50 67
88 50 50 50 50 50 50 50 50 50 50 50 50 50 50 50 50 50 50 50 50 50 50 50 50 50 50 50 50 50 50 50 50 50 68
88 50 50 50 50 50 50 50 50 50 50 50 50 50 50 50 50 50 50 50 50 50 50 50 50 50 50 50 50 50 50 50 50 50 68
88 50 50 50 50 50 50 50 50 50 50 50 50 50 50 50 50 50 50 50 50 50 50 50 50 50 50 50 50 50 50 50 50 50 70
88 50 50 50 50 50 50 50 50 50 50 50 50 50 50 50 50 50 50 50 50 50 50 50 50 50 50 50 50 50 50 50 50 50 68
110 50 50 50 50 50 50 50 50 50 50 50 50 50 50 50 50 50 50 50 50 50 50 50 50 50 50 50 50 50 50 50 50 50 79
1023 77 56 56 57 56 56 56 55 56 56 56 56 56 56 56 56 62 57 56 55 56 56 55 55 56 56 56 56 56 55 56 56 65 206>;
	synaptics,pt05_gap_y_b = /bits/ 16 <
381 74 52 57 57 57 56 57 56 57 57 57 57 57 55 57 57 57 66 65 66 66 66 64 66 65 65 65 65 66 66 65 65 66 87 587
70 50 50 50 50 50 50 50 50 50 50 50 50 50 50 50 50 50 50 50 50 50 50 50 50 50 50 50 50 50 50 50 50 50 50 68
56 50 50 50 50 50 50 50 50 50 50 50 50 50 50 50 50 50 50 50 50 50 50 50 50 50 50 50 50 50 50 50 50 50 50 55
51 50 50 50 50 50 50 50 50 50 50 50 50 50 50 50 50 50 50 50 50 50 50 50 50 50 50 50 50 50 50 50 50 50 50 58
53 50 50 50 50 50 50 50 50 50 50 50 50 50 50 50 50 50 50 50 50 50 50 50 50 50 50 50 50 50 50 50 50 50 50 58
58 50 50 50 50 50 50 50 50 50 50 50 50 50 50 50 50 50 50 50 50 50 50 50 50 50 50 50 50 50 50 50 50 50 50 58
59 95 50 50 50 50 50 50 50 50 50 50 50 50 50 50 50 50 50 50 50 50 50 50 50 50 50 50 50 50 50 50 50 50 50 58
52 50 50 50 50 50 50 50 50 50 50 50 50 50 50 50 50 50 50 50 50 50 50 50 50 50 50 50 50 50 50 50 50 50 50 58
60 131 50 50 50 50 50 50 50 50 50 50 50 50 50 50 50 50 50 50 50 50 50 50 50 50 50 50 50 50 50 50 50 50 50 58
56 50 50 50 50 50 50 50 50 50 50 50 50 50 50 50 50 50 50 50 50 50 50 50 50 50 50 50 50 50 50 50 50 50 50 58
59 50 50 50 50 50 50 50 50 50 50 50 50 50 50 50 50 50 50 50 50 50 50 50 50 50 50 50 50 50 50 50 50 50 50 55
52 50 50 50 50 50 50 50 50 50 50 50 50 50 50 50 50 50 50 50 50 50 50 50 50 50 50 50 50 50 50 50 50 50 50 58
55 50 50 50 50 50 50 50 50 50 50 50 50 50 50 50 50 50 50 50 50 50 50 50 50 50 50 50 50 50 50 50 50 50 50 58
67 50 50 50 50 50 50 50 50 50 50 50 50 50 50 50 50 50 50 50 50 50 50 50 50 50 50 50 50 50 50 50 50 50 50 66
219 77 63 63 63 63 63 63 63 63 63 63 63 63 63 63 63 63 57 57 57 57 57 57 57 57 57 57 57 57 57 57 57 63 70 203>;

	synaptics,pt0a_high_b = /bits/ 16 <
30 30 30 30 30 30 30 30 30 30 30 30 30 30 30 30 30 30 30 30 30 30 30 30 30 30 30 30 30 30 30 30 30 30 30 30
30 30 30 30 30 30 30 30 30 30 30 30 30 30 30 30 30 30 30 30 30 30 30 30 30 30 30 30 30 30 30 30 30 30 30 30
30 30 30 30 30 30 30 30 30 30 30 30 30 30 30 30 30 30 30 30 30 30 30 30 30 30 30 30 30 30 30 30 30 30 30 30
30 30 30 30 30 30 30 30 30 30 30 30 30 30 30 30 30 30 30 30 30 30 30 30 30 30 30 30 30 30 30 30 30 30 30 30
30 30 30 30 30 30 30 30 30 30 30 30 30 30 30 30 30 30 30 30 30 30 30 30 30 30 30 30 30 30 30 30 30 30 30 30
30 30 30 30 30 30 30 30 30 30 30 30 30 30 30 30 30 30 30 30 30 30 30 30 30 30 30 30 30 30 30 30 30 30 30 30
30 30 30 30 30 30 30 30 30 30 30 30 30 30 30 30 30 30 30 30 30 30 30 30 30 30 30 30 30 30 30 30 30 30 30 30
30 30 30 30 30 30 30 30 30 30 30 30 30 30 30 30 30 30 30 30 30 30 30 30 30 30 30 30 30 30 30 30 30 30 30 30
30 30 30 30 30 30 30 30 30 30 30 30 30 30 30 30 30 30 30 30 30 30 30 30 30 30 30 30 30 30 30 30 30 30 30 30
30 30 30 30 30 30 30 30 30 30 30 30 30 30 30 30 30 30 30 30 30 30 30 30 30 30 30 30 30 30 30 30 30 30 30 30
30 30 30 30 30 30 30 30 30 30 30 30 30 30 30 30 30 30 30 30 30 30 30 30 30 30 30 30 30 30 30 30 30 30 30 30
30 30 30 30 30 30 30 30 30 30 30 30 30 30 30 30 30 30 30 30 30 30 30 30 30 30 30 30 30 30 30 30 30 30 30 30
30 30 30 30 30 30 30 30 30 30 30 30 30 30 30 30 30 30 30 30 30 30 30 30 30 30 30 30 30 30 30 30 30 30 30 30
30 30 30 30 30 30 30 30 30 30 30 30 30 30 30 30 30 30 30 30 30 30 30 30 30 30 30 30 30 30 30 30 30 30 30 30
30 30 30 30 30 30 30 30 30 30 30 30 30 30 30 30 30 30 30 30 30 30 30 30 30 30 30 30 30 30 30 30 30 30 30 30
30 30 30 30 30 30 30 30 30 30 30 30 30 30 30 30 30 30 30 30 30 30 30 30 30 30 30 30 30 30 30 30 30 30 30 30>;
	synaptics,pt0a_low_b = /bits/ 16 <
(-30) (-30) (-30) (-30) (-30) (-30) (-30) (-30) (-30) (-30) (-30) (-30) (-30) (-30) (-30) (-30) (-30) (-30) (-30) (-30) (-30) (-30) (-30) (-30) (-30) (-30) (-30) (-30) (-30) (-30) (-30) (-30) (-30) (-30) (-30) (-30)
(-30) (-30) (-30) (-30) (-30) (-30) (-30) (-30) (-30) (-30) (-30) (-30) (-30) (-30) (-30) (-30) (-30) (-30) (-30) (-30) (-30) (-30) (-30) (-30) (-30) (-30) (-30) (-30) (-30) (-30) (-30) (-30) (-30) (-30) (-30) (-30)
(-30) (-30) (-30) (-30) (-30) (-30) (-30) (-30) (-30) (-30) (-30) (-30) (-30) (-30) (-30) (-30) (-30) (-30) (-30) (-30) (-30) (-30) (-30) (-30) (-30) (-30) (-30) (-30) (-30) (-30) (-30) (-30) (-30) (-30) (-30) (-30)
(-30) (-30) (-30) (-30) (-30) (-30) (-30) (-30) (-30) (-30) (-30) (-30) (-30) (-30) (-30) (-30) (-30) (-30) (-30) (-30) (-30) (-30) (-30) (-30) (-30) (-30) (-30) (-30) (-30) (-30) (-30) (-30) (-30) (-30) (-30) (-30)
(-30) (-30) (-30) (-30) (-30) (-30) (-30) (-30) (-30) (-30) (-30) (-30) (-30) (-30) (-30) (-30) (-30) (-30) (-30) (-30) (-30) (-30) (-30) (-30) (-30) (-30) (-30) (-30) (-30) (-30) (-30) (-30) (-30) (-30) (-30) (-30)
(-30) (-30) (-30) (-30) (-30) (-30) (-30) (-30) (-30) (-30) (-30) (-30) (-30) (-30) (-30) (-30) (-30) (-30) (-30) (-30) (-30) (-30) (-30) (-30) (-30) (-30) (-30) (-30) (-30) (-30) (-30) (-30) (-30) (-30) (-30) (-30)
(-30) (-30) (-30) (-30) (-30) (-30) (-30) (-30) (-30) (-30) (-30) (-30) (-30) (-30) (-30) (-30) (-30) (-30) (-30) (-30) (-30) (-30) (-30) (-30) (-30) (-30) (-30) (-30) (-30) (-30) (-30) (-30) (-30) (-30) (-30) (-30)
(-30) (-30) (-30) (-30) (-30) (-30) (-30) (-30) (-30) (-30) (-30) (-30) (-30) (-30) (-30) (-30) (-30) (-30) (-30) (-30) (-30) (-30) (-30) (-30) (-30) (-30) (-30) (-30) (-30) (-30) (-30) (-30) (-30) (-30) (-30) (-30)
(-30) (-30) (-30) (-30) (-30) (-30) (-30) (-30) (-30) (-30) (-30) (-30) (-30) (-30) (-30) (-30) (-30) (-30) (-30) (-30) (-30) (-30) (-30) (-30) (-30) (-30) (-30) (-30) (-30) (-30) (-30) (-30) (-30) (-30) (-30) (-30)
(-30) (-30) (-30) (-30) (-30) (-30) (-30) (-30) (-30) (-30) (-30) (-30) (-30) (-30) (-30) (-30) (-30) (-30) (-30) (-30) (-30) (-30) (-30) (-30) (-30) (-30) (-30) (-30) (-30) (-30) (-30) (-30) (-30) (-30) (-30) (-30)
(-30) (-30) (-30) (-30) (-30) (-30) (-30) (-30) (-30) (-30) (-30) (-30) (-30) (-30) (-30) (-30) (-30) (-30) (-30) (-30) (-30) (-30) (-30) (-30) (-30) (-30) (-30) (-30) (-30) (-30) (-30) (-30) (-30) (-30) (-30) (-30)
(-30) (-30) (-30) (-30) (-30) (-30) (-30) (-30) (-30) (-30) (-30) (-30) (-30) (-30) (-30) (-30) (-30) (-30) (-30) (-30) (-30) (-30) (-30) (-30) (-30) (-30) (-30) (-30) (-30) (-30) (-30) (-30) (-30) (-30) (-30) (-30)
(-30) (-30) (-30) (-30) (-30) (-30) (-30) (-30) (-30) (-30) (-30) (-30) (-30) (-30) (-30) (-30) (-30) (-30) (-30) (-30) (-30) (-30) (-30) (-30) (-30) (-30) (-30) (-30) (-30) (-30) (-30) (-30) (-30) (-30) (-30) (-30)
(-30) (-30) (-30) (-30) (-30) (-30) (-30) (-30) (-30) (-30) (-30) (-30) (-30) (-30) (-30) (-30) (-30) (-30) (-30) (-30) (-30) (-30) (-30) (-30) (-30) (-30) (-30) (-30) (-30) (-30) (-30) (-30) (-30) (-30) (-30) (-30)
(-30) (-30) (-30) (-30) (-30) (-30) (-30) (-30) (-30) (-30) (-30) (-30) (-30) (-30) (-30) (-30) (-30) (-30) (-30) (-30) (-30) (-30) (-30) (-30) (-30) (-30) (-30) (-30) (-30) (-30) (-30) (-30) (-30) (-30) (-30) (-30)
(-30) (-30) (-30) (-30) (-30) (-30) (-30) (-30) (-30) (-30) (-30) (-30) (-30) (-30) (-30) (-30) (-30) (-30) (-30) (-30) (-30) (-30) (-30) (-30) (-30) (-30) (-30) (-30) (-30) (-30) (-30) (-30) (-30) (-30) (-30) (-30)>;

	synaptics,pt10_high_b = /bits/ 16 <
100 100 100 100 100 100 100 100 100 100 100 100 100 100 100 100 100 100 100 100 100 100 100 100 100 100 100 100 100 100 100 100 100 100 100 100
100 100 100 100 100 100 100 100 100 100 100 100 100 100 100 100 100 100 100 100 100 100 100 100 100 100 100 100 100 100 100 100 100 100 100 100
100 100 100 100 100 100 100 100 100 100 100 100 100 100 100 100 100 100 100 100 100 100 100 100 100 100 100 100 100 100 100 100 100 100 100 100
100 100 100 100 100 100 100 100 100 100 100 100 100 100 100 100 100 100 100 100 100 100 100 100 100 100 100 100 100 100 100 100 100 100 100 100
100 100 100 100 100 100 100 100 100 100 100 100 100 100 100 100 100 100 100 100 100 100 100 100 100 100 100 100 100 100 100 100 100 100 100 100
100 100 100 100 100 100 100 100 100 100 100 100 100 100 100 100 100 100 100 100 100 100 100 100 100 100 100 100 100 100 100 100 100 100 100 100
100 100 100 100 100 100 100 100 100 100 100 100 100 100 100 100 100 100 100 100 100 100 100 100 100 100 100 100 100 100 100 100 100 100 100 100
100 100 100 100 100 100 100 100 100 100 100 100 100 100 100 100 100 100 100 100 100 100 100 100 100 100 100 100 100 100 100 100 100 100 100 100
100 100 100 100 100 100 100 100 100 100 100 100 100 100 100 100 100 100 100 100 100 100 100 100 100 100 100 100 100 100 100 100 100 100 100 100
100 100 100 100 100 100 100 100 100 100 100 100 100 100 100 100 100 100 100 100 100 100 100 100 100 100 100 100 100 100 100 100 100 100 100 100
100 100 100 100 100 100 100 100 100 100 100 100 100 100 100 100 100 100 100 100 100 100 100 100 100 100 100 100 100 100 100 100 100 100 100 100
100 100 100 100 100 100 100 100 100 100 100 100 100 100 100 100 100 100 100 100 100 100 100 100 100 100 100 100 100 100 100 100 100 100 100 100
100 100 100 100 100 100 100 100 100 100 100 100 100 100 100 100 100 100 100 100 100 100 100 100 100 100 100 100 100 100 100 100 100 100 100 100
100 100 100 100 100 100 100 100 100 100 100 100 100 100 100 100 100 100 100 100 100 100 100 100 100 100 100 100 100 100 100 100 100 100 100 100
100 100 100 100 100 100 100 100 100 100 100 100 100 100 100 100 100 100 100 100 100 100 100 100 100 100 100 100 100 100 100 100 100 100 100 100
100 100 100 100 100 100 100 100 100 100 100 100 100 100 100 100 100 100 100 100 100 100 100 100 100 100 100 100 100 100 100 100 100 100 100 100>;
	synaptics,pt10_low_b = /bits/ 16 <
0 0 0 0 0 0 0 0 0 0 0 0 0 0 0 0 0 0 0 0 0 0 0 0 0 0 0 0 0 0 0 0 0 0 0 0
0 0 0 0 0 0 0 0 0 0 0 0 0 0 0 0 0 0 0 0 0 0 0 0 0 0 0 0 0 0 0 0 0 0 0 0
0 0 0 0 0 0 0 0 0 0 0 0 0 0 0 0 0 0 0 0 0 0 0 0 0 0 0 0 0 0 0 0 0 0 0 0
0 0 0 0 0 0 0 0 0 0 0 0 0 0 0 0 0 0 0 0 0 0 0 0 0 0 0 0 0 0 0 0 0 0 0 0
0 0 0 0 0 0 0 0 0 0 0 0 0 0 0 0 0 0 0 0 0 0 0 0 0 0 0 0 0 0 0 0 0 0 0 0
0 0 0 0 0 0 0 0 0 0 0 0 0 0 0 0 0 0 0 0 0 0 0 0 0 0 0 0 0 0 0 0 0 0 0 0
0 0 0 0 0 0 0 0 0 0 0 0 0 0 0 0 0 0 0 0 0 0 0 0 0 0 0 0 0 0 0 0 0 0 0 0
0 0 0 0 0 0 0 0 0 0 0 0 0 0 0 0 0 0 0 0 0 0 0 0 0 0 0 0 0 0 0 0 0 0 0 0
0 0 0 0 0 0 0 0 0 0 0 0 0 0 0 0 0 0 0 0 0 0 0 0 0 0 0 0 0 0 0 0 0 0 0 0
0 0 0 0 0 0 0 0 0 0 0 0 0 0 0 0 0 0 0 0 0 0 0 0 0 0 0 0 0 0 0 0 0 0 0 0
0 0 0 0 0 0 0 0 0 0 0 0 0 0 0 0 0 0 0 0 0 0 0 0 0 0 0 0 0 0 0 0 0 0 0 0
0 0 0 0 0 0 0 0 0 0 0 0 0 0 0 0 0 0 0 0 0 0 0 0 0 0 0 0 0 0 0 0 0 0 0 0
0 0 0 0 0 0 0 0 0 0 0 0 0 0 0 0 0 0 0 0 0 0 0 0 0 0 0 0 0 0 0 0 0 0 0 0
0 0 0 0 0 0 0 0 0 0 0 0 0 0 0 0 0 0 0 0 0 0 0 0 0 0 0 0 0 0 0 0 0 0 0 0
0 0 0 0 0 0 0 0 0 0 0 0 0 0 0 0 0 0 0 0 0 0 0 0 0 0 0 0 0 0 0 0 0 0 0 0
0 0 0 0 0 0 0 0 0 0 0 0 0 0 0 0 0 0 0 0 0 0 0 0 0 0 0 0 0 0 0 0 0 0 0 0>;
	synaptics,pt10_gap_x_b = /bits/ 16 <
30 30 30 30 30 30 30 30 30 30 30 30 30 30 30 30 30 30 30 30 30 30 30 30 30 30 30 30 30 30 30 30 30 30 30
30 30 30 30 30 30 30 30 30 30 30 30 30 30 30 30 30 30 30 30 30 30 30 30 30 30 30 30 30 30 30 30 30 30 30
30 30 30 30 30 30 30 30 30 30 30 30 30 30 30 30 30 30 30 30 30 30 30 30 30 30 30 30 30 30 30 30 30 30 30
30 30 30 30 30 30 30 30 30 30 30 30 30 30 30 30 30 30 30 30 30 30 30 30 30 30 30 30 30 30 30 30 30 30 30
30 30 30 30 30 30 30 30 30 30 30 30 30 30 30 30 30 30 30 30 30 30 30 30 30 30 30 30 30 30 30 30 30 30 30
30 30 30 30 30 30 30 30 30 30 30 30 30 30 30 30 30 30 30 30 30 30 30 30 30 30 30 30 30 30 30 30 30 30 30
30 30 30 30 30 30 30 30 30 30 30 30 30 30 30 30 30 30 30 30 30 30 30 30 30 30 30 30 30 30 30 30 30 30 30
30 30 30 30 30 30 30 30 30 30 30 30 30 30 30 30 30 30 30 30 30 30 30 30 30 30 30 30 30 30 30 30 30 30 30
30 30 30 30 30 30 30 30 30 30 30 30 30 30 30 30 30 30 30 30 30 30 30 30 30 30 30 30 30 30 30 30 30 30 30
30 30 30 30 30 30 30 30 30 30 30 30 30 30 30 30 30 30 30 30 30 30 30 30 30 30 30 30 30 30 30 30 30 30 30
30 30 30 30 30 30 30 30 30 30 30 30 30 30 30 30 30 30 30 30 30 30 30 30 30 30 30 30 30 30 30 30 30 30 30
30 30 30 30 30 30 30 30 30 30 30 30 30 30 30 30 30 30 30 30 30 30 30 30 30 30 30 30 30 30 30 30 30 30 30
30 30 30 30 30 30 30 30 30 30 30 30 30 30 30 30 30 30 30 30 30 30 30 30 30 30 30 30 30 30 30 30 30 30 30
30 30 30 30 30 30 30 30 30 30 30 30 30 30 30 30 30 30 30 30 30 30 30 30 30 30 30 30 30 30 30 30 30 30 30
30 30 30 30 30 30 30 30 30 30 30 30 30 30 30 30 30 30 30 30 30 30 30 30 30 30 30 30 30 30 30 30 30 30 30
30 30 30 30 30 30 30 30 30 30 30 30 30 30 30 30 30 30 30 30 30 30 30 30 30 30 30 30 30 30 30 30 30 30 30>;
	synaptics,pt10_gap_y_b = /bits/ 16 <
30 30 30 30 30 30 30 30 30 30 30 30 30 30 30 30 30 30 30 30 30 30 30 30 30 30 30 30 30 30 30 30 30 30 30 30
30 30 30 30 30 30 30 30 30 30 30 30 30 30 30 30 30 30 30 30 30 30 30 30 30 30 30 30 30 30 30 30 30 30 30 30
30 30 30 30 30 30 30 30 30 30 30 30 30 30 30 30 30 30 30 30 30 30 30 30 30 30 30 30 30 30 30 30 30 30 30 30
30 30 30 30 30 30 30 30 30 30 30 30 30 30 30 30 30 30 30 30 30 30 30 30 30 30 30 30 30 30 30 30 30 30 30 30
30 30 30 30 30 30 30 30 30 30 30 30 30 30 30 30 30 30 30 30 30 30 30 30 30 30 30 30 30 30 30 30 30 30 30 30
30 30 30 30 30 30 30 30 30 30 30 30 30 30 30 30 30 30 30 30 30 30 30 30 30 30 30 30 30 30 30 30 30 30 30 30
30 30 30 30 30 30 30 30 30 30 30 30 30 30 30 30 30 30 30 30 30 30 30 30 30 30 30 30 30 30 30 30 30 30 30 30
30 30 30 30 30 30 30 30 30 30 30 30 30 30 30 30 30 30 30 30 30 30 30 30 30 30 30 30 30 30 30 30 30 30 30 30
30 30 30 30 30 30 30 30 30 30 30 30 30 30 30 30 30 30 30 30 30 30 30 30 30 30 30 30 30 30 30 30 30 30 30 30
30 30 30 30 30 30 30 30 30 30 30 30 30 30 30 30 30 30 30 30 30 30 30 30 30 30 30 30 30 30 30 30 30 30 30 30
30 30 30 30 30 30 30 30 30 30 30 30 30 30 30 30 30 30 30 30 30 30 30 30 30 30 30 30 30 30 30 30 30 30 30 30
30 30 30 30 30 30 30 30 30 30 30 30 30 30 30 30 30 30 30 30 30 30 30 30 30 30 30 30 30 30 30 30 30 30 30 30
30 30 30 30 30 30 30 30 30 30 30 30 30 30 30 30 30 30 30 30 30 30 30 30 30 30 30 30 30 30 30 30 30 30 30 30
30 30 30 30 30 30 30 30 30 30 30 30 30 30 30 30 30 30 30 30 30 30 30 30 30 30 30 30 30 30 30 30 30 30 30 30
30 30 30 30 30 30 30 30 30 30 30 30 30 30 30 30 30 30 30 30 30 30 30 30 30 30 30 30 30 30 30 30 30 30 30 30>;

	synaptics,pt11_high_b = /bits/ 16 <
200 200 200 200 200 200 200 200 200 200 200 200 200 200 200 200 200 200 200 200 200 200 200 200 200 200 200 200 200 200 200 200 200 200 200 200
200 200 200 200 200 200 200 200 200 200 200 200 200 200 200 200 200 200 200 200 200 200 200 200 200 200 200 200 200 200 200 200 200 200 200 200
200 200 200 200 200 200 200 200 200 200 200 200 200 200 200 200 200 200 200 200 200 200 200 200 200 200 200 200 200 200 200 200 200 200 200 200
200 200 200 200 200 200 200 200 200 200 200 200 200 200 200 200 200 200 200 200 200 200 200 200 200 200 200 200 200 200 200 200 200 200 200 200
200 200 200 200 200 200 200 200 200 200 200 200 200 200 200 200 200 200 200 200 200 200 200 200 200 200 200 200 200 200 200 200 200 200 200 200
200 200 200 200 200 200 200 200 200 200 200 200 200 200 200 200 200 200 200 200 200 200 200 200 200 200 200 200 200 200 200 200 200 200 200 200
200 200 200 200 200 200 200 200 200 200 200 200 200 200 200 200 200 200 200 200 200 200 200 200 200 200 200 200 200 200 200 200 200 200 200 200
200 200 200 200 200 200 200 200 200 200 200 200 200 200 200 200 200 200 200 200 200 200 200 200 200 200 200 200 200 200 200 200 200 200 200 200
200 200 200 200 200 200 200 200 200 200 200 200 200 200 200 200 200 200 200 200 200 200 200 200 200 200 200 200 200 200 200 200 200 200 200 200
200 200 200 200 200 200 200 200 200 200 200 200 200 200 200 200 200 200 200 200 200 200 200 200 200 200 200 200 200 200 200 200 200 200 200 200
200 200 200 200 200 200 200 200 200 200 200 200 200 200 200 200 200 200 200 200 200 200 200 200 200 200 200 200 200 200 200 200 200 200 200 200
200 200 200 200 200 200 200 200 200 200 200 200 200 200 200 200 200 200 200 200 200 200 200 200 200 200 200 200 200 200 200 200 200 200 200 200
200 200 200 200 200 200 200 200 200 200 200 200 200 200 200 200 200 200 200 200 200 200 200 200 200 200 200 200 200 200 200 200 200 200 200 200
200 200 200 200 200 200 200 200 200 200 200 200 200 200 200 200 200 200 200 200 200 200 200 200 200 200 200 200 200 200 200 200 200 200 200 200
200 200 200 200 200 200 200 200 200 200 200 200 200 200 200 200 200 200 200 200 200 200 200 200 200 200 200 200 200 200 200 200 200 200 200 200
200 200 200 200 200 200 200 200 200 200 200 200 200 200 200 200 200 200 200 200 200 200 200 200 200 200 200 200 200 200 200 200 200 200 200 200>;
	synaptics,pt11_low_b = /bits/ 16 <
70 70 70 70 70 70 70 70 70 70 70 70 70 70 70 70 70 70 70 70 70 70 70 70 70 70 70 70 70 70 70 70 70 70 70 70
70 70 70 70 70 70 70 70 70 70 70 70 70 70 70 70 70 70 70 70 70 70 70 70 70 70 70 70 70 70 70 70 70 70 70 70
70 70 70 70 70 70 70 70 70 70 70 70 70 70 70 70 70 70 70 70 70 70 70 70 70 70 70 70 70 70 70 70 70 70 70 70
70 70 70 70 70 70 70 70 70 70 70 70 70 70 70 70 70 70 70 70 70 70 70 70 70 70 70 70 70 70 70 70 70 70 70 70
70 70 70 70 70 70 70 70 70 70 70 70 70 70 70 70 70 70 70 70 70 70 70 70 70 70 70 70 70 70 70 70 70 70 70 70
70 70 70 70 70 70 70 70 70 70 70 70 70 70 70 70 70 70 70 70 70 70 70 70 70 70 70 70 70 70 70 70 70 70 70 70
70 70 70 70 70 70 70 70 70 70 70 70 70 70 70 70 70 70 70 70 70 70 70 70 70 70 70 70 70 70 70 70 70 70 70 70
70 70 70 70 70 70 70 70 70 70 70 70 70 70 70 70 70 70 70 70 70 70 70 70 70 70 70 70 70 70 70 70 70 70 70 70
70 70 70 70 70 70 70 70 70 70 70 70 70 70 70 70 70 70 70 70 70 70 70 70 70 70 70 70 70 70 70 70 70 70 70 70
70 70 70 70 70 70 70 70 70 70 70 70 70 70 70 70 70 70 70 70 70 70 70 70 70 70 70 70 70 70 70 70 70 70 70 70
70 70 70 70 70 70 70 70 70 70 70 70 70 70 70 70 70 70 70 70 70 70 70 70 70 70 70 70 70 70 70 70 70 70 70 70
70 70 70 70 70 70 70 70 70 70 70 70 70 70 70 70 70 70 70 70 70 70 70 70 70 70 70 70 70 70 70 70 70 70 70 70
70 70 70 70 70 70 70 70 70 70 70 70 70 70 70 70 70 70 70 70 70 70 70 70 70 70 70 70 70 70 70 70 70 70 70 70
70 70 70 70 70 70 70 70 70 70 70 70 70 70 70 70 70 70 70 70 70 70 70 70 70 70 70 70 70 70 70 70 70 70 70 70
70 70 70 70 70 70 70 70 70 70 70 70 70 70 70 70 70 70 70 70 70 70 70 70 70 70 70 70 70 70 70 70 70 70 70 70
70 70 70 70 70 70 70 70 70 70 70 70 70 70 70 70 70 70 70 70 70 70 70 70 70 70 70 70 70 70 70 70 70 70 70 70>;

	synaptics,pt12_high_b = <
223146 233663 235531 234132 233358 233017 232948 232475 232275 232149 231789 231672 231901 232071 231831 231603 231609 230997 237642 236895 236618 236316 236194 235658 236161 235982 235907 235662 235697 235393 235336 235247 235351 235230 234912 218991 514938 518587 517696 516871 516753 517173 517135 517051 522389 523804 523821 523206 523005 523304 524604 519344>;
	synaptics,pt12_low_b = <
133887 140197 141318 140478 140014 139810 139768 139484 139364 139288 139072 139002 139140 139242 139098 138961 138964 138597 142585 142136 141970 141789 141715 141394 141696 141588 141543 141396 141417 141235 141201 141147 141210 141137 140946 131394 308962 311152 310617 310122 310051 310303 310280 310230 313433 314282 314292 313923 313802 313982 314761 311606>;

	synaptics,pt16_high_b = /bits/ 16 <
378 915 1068 1068 1067 1063 1057 1057 1054 1053 1049 1048 1042 1043 1045 1049 1058 1077 933 932 934 933 934 966 934 932 931 933 932 931 931 942 930 922 797 292
725 986 990 1003 992 984 980 981 980 980 979 1002 973 973 975 973 975 975 970 968 969 969 969 970 969 968 966 968 967 966 964 965 964 961 953 792
836 990 992 991 988 986 983 984 982 982 981 986 976 976 976 975 977 977 973 971 972 972 973 973 972 971 969 971 970 968 967 968 967 965 958 890
843 1000 1000 1008 997 995 991 992 990 990 990 1010 984 984 984 983 984 984 982 980 981 981 982 982 981 980 979 981 979 978 977 977 977 974 969 896
846 1001 1001 999 998 995 992 993 992 992 992 991 985 985 985 984 985 984 984 982 983 983 983 983 983 981 981 982 981 979 978 979 979 976 971 909
840 996 997 995 994 992 989 990 989 989 988 987 982 981 982 981 982 981 980 979 980 980 980 981 980 978 977 979 978 976 975 976 975 973 968 915
838 993 999 999 999 997 994 995 993 993 992 992 987 986 986 986 986 987 986 984 985 984 985 985 984 983 982 983 982 981 979 980 980 977 973 924
881 716 970 1000 999 997 994 995 993 994 993 992 988 987 987 986 987 986 986 985 986 985 986 986 985 983 982 984 983 981 980 981 981 978 973 934
880 732 978 1000 1000 998 995 996 994 994 993 993 988 987 988 987 988 987 987 986 987 986 987 987 986 985 984 985 984 983 981 982 982 979 974 944
843 998 1004 1005 1004 1002 999 1000 999 999 998 997 992 991 991 991 992 991 992 990 991 990 991 991 990 989 988 989 988 986 985 985 985 982 978 932
852 1008 1009 1007 1006 1004 1001 1002 1000 1001 1000 999 994 993 993 992 993 993 993 992 993 993 993 994 992 992 990 991 990 989 987 993 987 984 980 923
853 1009 1009 1006 1005 1003 1000 1001 999 1000 999 998 993 992 993 992 993 992 993 992 993 992 992 992 992 990 989 990 989 988 986 987 986 984 979 920
847 1003 1003 1000 999 997 994 996 994 994 994 993 988 987 987 987 987 987 988 986 987 987 987 987 986 985 984 985 984 983 981 983 981 979 973 906
838 995 996 994 993 991 988 989 988 988 988 987 982 981 981 980 981 981 983 982 983 982 982 982 982 980 980 981 980 979 978 978 978 975 969 917
718 993 995 994 993 991 988 990 988 988 987 987 981 981 981 980 981 981 984 982 983 982 983 983 982 980 980 981 980 979 978 979 978 974 968 802
237 819 985 986 986 984 982 983 982 982 981 981 975 975 975 974 975 975 1036 1030 1029 1027 1025 1029 1027 1024 1021 1021 1017 1020 1016 1016 1013 998 901 388>;

	synaptics,pt16_low_b = /bits/ 16 <
97 508 593 593 592 590 587 586 585 584 582 581 578 579 580 582 587 597 518 517 518 517 518 536 518 517 517 518 517 516 516 523 516 512 442 67
402 591 593 601 595 589 587 588 587 587 586 600 583 583 584 583 584 584 581 580 581 580 581 581 581 580 579 580 579 579 578 578 578 576 571 439
463 593 594 594 592 591 589 589 589 589 588 591 585 585 585 584 586 585 583 582 582 582 583 583 582 582 581 582 581 580 579 580 580 578 574 494
468 599 599 604 597 596 594 594 593 593 593 605 589 590 589 589 590 589 588 587 588 588 588 588 588 587 587 588 587 586 585 586 585 584 581 497
469 600 600 599 598 596 595 595 594 594 594 594 590 590 590 590 590 590 589 588 589 589 589 589 589 588 588 589 588 587 586 586 586 585 582 505
466 597 597 596 596 594 593 593 593 592 592 591 588 588 588 588 588 588 587 587 587 587 587 588 587 586 586 586 586 585 584 585 584 583 580 507
465 595 599 599 599 597 596 596 595 595 595 594 591 591 591 591 591 591 591 590 590 590 590 590 590 589 588 589 588 588 587 587 587 585 583 513
433 341 581 599 599 597 596 596 595 595 595 594 592 591 591 591 591 591 591 590 591 590 591 591 590 589 589 590 589 588 587 588 588 586 583 518
433 350 586 599 599 598 596 597 596 596 595 595 592 592 592 591 592 591 592 591 591 591 591 591 591 590 589 590 590 589 588 588 588 587 584 524
468 598 602 602 602 601 599 599 598 599 598 597 594 594 594 594 594 594 595 593 594 593 594 594 593 592 592 593 592 591 590 590 590 589 586 517
473 604 605 603 603 602 600 600 599 600 599 599 595 595 595 595 595 595 595 594 595 595 595 596 595 594 593 594 593 592 591 595 592 590 587 512
473 604 605 603 602 601 599 600 599 599 599 598 595 595 595 594 595 594 595 594 595 594 595 595 594 593 593 593 593 592 591 591 591 589 587 510
470 601 601 599 599 598 596 597 596 596 595 595 592 591 592 591 592 591 592 591 592 591 592 592 591 590 589 590 590 589 588 589 588 586 583 503
465 596 597 596 595 594 592 593 592 592 592 591 588 588 588 587 588 588 589 588 589 588 589 589 588 587 587 588 587 587 586 586 586 584 581 509
398 595 596 595 595 594 592 593 592 592 592 591 588 588 588 587 588 588 589 588 589 589 589 589 588 587 587 588 587 587 586 586 586 584 580 445
47 454 546 547 547 546 545 545 544 545 544 544 541 541 541 540 541 541 575 572 571 570 569 571 570 568 566 566 565 566 564 564 562 553 500 101>;

	synaptics,pt_tag_moisture_b = /bits/ 16 <
800 800 800 800 800 800 800 800 800 800 800 800 800 800 800 800 800 800 800 800 800 800 800 800 800 800 800 800 800 800 800 800 800 800 800 0
800 800 800 800 800 800 800 800 800 800 800 800 800 800 800 800 800 800 800 800 800 800 800 800 800 800 800 800 800 800 800 800 800 800 800 0
800 800 80 80 80 80 80 80 80 80 80 80 80 80 80 80 80 80 80 80 80 80 80 80 80 80 80 80 80 80 80 80 80 800 800 0
800 800 80 80 80 80 80 80 80 80 80 80 80 80 80 80 80 80 80 80 80 80 80 80 80 80 80 80 80 80 80 80 80 800 800 0
800 800 80 80 80 80 80 80 80 80 80 80 80 80 80 80 80 80 80 80 80 80 80 80 80 80 80 80 80 80 80 80 80 800 800 0
800 800 80 80 80 80 80 80 80 80 80 80 80 80 80 80 80 80 80 80 80 80 80 80 80 80 80 80 80 80 80 80 80 800 800 0
800 800 800 80 80 80 80 80 80 80 80 80 80 80 80 80 80 80 80 80 80 80 80 80 80 80 80 80 80 80 80 80 80 800 800 0
800 800 80 80 80 80 80 80 80 80 80 80 80 80 80 80 80 80 80 80 80 80 80 80 80 80 80 80 80 80 80 80 80 800 800 0
800 800 800 80 80 80 80 80 80 80 80 80 80 80 80 80 80 80 80 80 80 80 80 80 80 80 80 80 80 80 80 80 80 800 800 0
800 800 80 80 80 80 80 80 80 80 80 80 80 80 80 80 80 80 80 80 80 80 80 80 80 80 80 80 80 80 80 80 80 800 800 0
800 800 80 80 80 80 80 80 80 80 80 80 80 80 80 80 80 80 80 80 80 80 80 80 80 80 80 80 80 80 80 80 80 800 800 0
800 800 80 80 80 80 80 80 80 80 80 80 80 80 80 80 80 80 80 80 80 80 80 80 80 80 80 80 80 80 80 80 80 800 800 0
800 800 80 80 80 80 80 80 80 80 80 80 80 80 80 80 80 80 80 80 80 80 80 80 80 80 80 80 80 80 80 80 80 800 800 0
800 800 800 800 800 800 800 800 800 800 800 800 800 800 800 800 800 800 800 800 800 800 800 800 800 800 800 800 800 800 800 800 800 800 800 0
800 800 800 800 800 800 800 800 800 800 800 800 800 800 800 800 800 800 800 800 800 800 800 800 800 800 800 800 800 800 800 800 800 800 800 0
0 0 0 0 0 0 0 0 0 0 0 0 0 0 0 0 0 0 0 0 0 0 0 0 0 0 0 0 0 0 0 0 0 0 0 0>;

	/*ical limit */
	synaptics,pt05_high_b_ical = /bits/ 16 <
299 1085 1268 1268 1263 1259 1256 1254 1253 1253 1250 1244 1242 1244 1248 1253 1265 1284 1131 1131 1133 1131 1130 1163 1130 1130 1130 1130 1130 1128 1127 1140 1130 1127 980 249
885 1298 1290 1302 1286 1275 1274 1274 1274 1272 1272 1295 1265 1262 1265 1265 1265 1266 1262 1260 1262 1262 1262 1259 1260 1260 1260 1260 1262 1259 1256 1257 1259 1262 1265 968
1016 1295 1198 1194 1189 1186 1184 1184 1184 1183 1183 1183 1175 1175 1176 1176 1177 1176 1173 1173 1173 1175 1175 1170 1173 1173 1173 1173 1173 1172 1169 1169 1172 1175 1262 1083
1014 1295 1198 1203 1189 1186 1183 1183 1184 1183 1182 1201 1175 1173 1175 1175 1175 1173 1175 1173 1173 1175 1175 1172 1173 1173 1173 1173 1175 1172 1169 1170 1172 1175 1262 1080
1014 1295 1198 1193 1187 1184 1183 1183 1184 1183 1183 1177 1175 1173 1175 1175 1175 1173 1175 1173 1175 1175 1175 1172 1173 1173 1173 1173 1175 1172 1169 1170 1172 1175 1263 1092
1014 1295 1198 1193 1189 1186 1183 1183 1186 1183 1182 1177 1175 1173 1175 1175 1175 1173 1175 1175 1175 1175 1175 1172 1173 1173 1173 1173 1175 1172 1169 1170 1173 1176 1263 1101
1014 1295 1200 1194 1189 1184 1183 1183 1183 1182 1182 1177 1175 1173 1175 1173 1173 1173 1173 1173 1175 1175 1173 1170 1173 1173 1173 1173 1173 1170 1169 1170 1172 1175 1263 1107
1036 805 1294 1196 1187 1183 1182 1182 1183 1182 1182 1176 1173 1172 1173 1172 1172 1173 1173 1172 1173 1173 1173 1170 1172 1172 1172 1172 1173 1170 1169 1169 1172 1175 1262 1116
1033 817 1304 1194 1187 1183 1182 1180 1182 1182 1180 1175 1172 1170 1172 1172 1172 1170 1173 1172 1173 1173 1173 1170 1172 1172 1172 1172 1173 1170 1169 1170 1172 1175 1263 1125
1013 1295 1200 1191 1187 1183 1180 1180 1182 1180 1180 1175 1172 1170 1172 1172 1170 1170 1173 1172 1173 1173 1173 1169 1172 1172 1172 1172 1173 1170 1169 1169 1172 1173 1262 1109
1013 1293 1197 1190 1186 1183 1180 1180 1182 1180 1180 1175 1172 1170 1172 1172 1170 1170 1173 1172 1173 1173 1173 1172 1172 1172 1172 1172 1173 1170 1169 1176 1172 1173 1262 1100
1011 1292 1196 1190 1186 1183 1180 1180 1182 1180 1180 1175 1172 1170 1172 1172 1172 1170 1175 1173 1173 1175 1173 1170 1172 1172 1172 1172 1173 1170 1168 1169 1172 1173 1262 1094
1011 1290 1194 1189 1184 1182 1180 1180 1182 1180 1179 1175 1172 1170 1172 1170 1170 1170 1173 1173 1173 1175 1173 1170 1172 1172 1172 1172 1172 1170 1168 1170 1172 1173 1260 1085
1008 1290 1193 1189 1184 1182 1179 1179 1180 1179 1179 1173 1170 1169 1170 1170 1170 1169 1173 1173 1173 1175 1173 1170 1172 1172 1173 1172 1173 1170 1168 1169 1172 1173 1262 1101
864 1289 1281 1275 1269 1266 1265 1266 1266 1265 1265 1259 1256 1254 1256 1256 1256 1254 1260 1259 1260 1260 1260 1257 1259 1259 1259 1259 1259 1257 1254 1256 1257 1260 1265 963
170 984 1179 1179 1176 1173 1172 1173 1172 1172 1170 1166 1163 1161 1163 1163 1163 1163 1224 1220 1218 1217 1214 1215 1215 1215 1212 1212 1209 1211 1206 1206 1208 1194 1068 342>;
	synaptics,pt05_low_b_ical = /bits/ 16 <
22 104 122 122 121 121 120 120 120 120 120 119 119 119 120 120 121 123 108 108 108 108 108 111 108 108 108 108 108 108 108 109 108 108 93 17
84 124 124 125 123 122 122 122 122 122 122 124 121 121 121 121 121 121 121 121 121 121 121 121 121 121 121 121 121 120 120 120 121 121 121 92
97 124 123 123 122 122 122 122 122 122 122 122 121 121 121 121 121 121 121 121 121 121 121 121 121 121 121 121 121 120 120 120 120 120 121 104
97 124 123 124 122 122 122 122 122 122 122 124 121 121 121 121 121 121 121 121 121 121 121 121 121 121 121 121 121 120 120 120 121 121 121 103
97 124 123 123 122 122 122 122 122 122 122 121 121 121 121 121 121 121 121 121 121 121 121 121 121 121 121 121 121 120 120 120 121 121 121 104
97 124 123 123 122 122 122 122 122 122 122 121 121 121 121 121 121 121 121 121 121 121 121 121 121 121 121 121 121 121 120 120 121 121 121 105
97 124 123 123 122 122 122 122 122 122 122 121 121 121 121 121 121 121 121 121 121 121 121 121 121 121 121 121 121 120 120 120 121 120 121 106
90 70 120 123 122 122 122 122 122 122 122 121 121 121 121 121 121 121 121 121 121 121 121 120 121 121 121 121 121 120 120 120 120 120 121 107
90 72 121 123 122 122 122 122 122 121 122 121 121 121 121 121 121 121 121 121 121 121 121 121 121 121 121 121 121 120 120 120 120 120 121 107
97 124 123 123 122 122 122 122 122 121 121 121 121 121 121 121 121 121 121 121 121 121 121 121 121 121 121 121 121 120 120 120 120 120 120 106
97 124 123 122 122 122 122 122 122 121 121 121 121 121 121 121 121 121 121 121 121 121 121 121 121 121 121 121 121 120 120 121 120 120 120 105
97 124 123 122 122 122 122 122 122 121 121 121 121 121 121 121 121 121 121 121 121 121 121 121 121 121 121 121 121 120 120 120 120 120 121 104
97 124 123 122 122 122 122 122 121 121 121 121 120 120 121 121 120 121 121 121 121 121 121 120 121 121 121 121 121 120 120 120 121 120 121 104
96 123 123 122 122 121 121 121 121 121 121 121 120 120 120 120 120 120 121 121 121 121 121 120 121 121 121 120 121 120 120 120 120 120 121 105
82 123 123 122 122 121 121 121 121 121 121 120 120 120 120 120 120 120 121 121 121 121 121 120 120 121 120 120 121 120 120 120 120 120 121 92
11 94 112 112 112 112 112 112 112 112 112 111 111 111 111 111 111 111 117 117 117 116 116 116 117 116 116 116 115 116 115 115 115 114 102 24>;
	synaptics,pt05_gap_x_b_ical = /bits/ 16 <
442 400 400 400 400 400 400 400 400 400 400 400 400 400 400 400 400 400 400 400 400 400 400 400 400 400 400 400 400 400 400 400 400 400 183
400 400 400 400 400 400 400 400 400 400 400 400 400 400 400 400 400 400 400 400 400 400 400 400 400 400 400 400 400 400 400 400 400 400 400
400 400 400 400 400 400 400 400 400 400 400 400 400 400 400 400 400 400 400 400 400 400 400 400 400 400 400 400 400 400 400 400 400 400 400
400 400 400 400 400 400 400 400 400 400 400 400 400 400 400 400 400 400 400 400 400 400 400 400 400 400 400 400 400 400 400 400 400 400 400
400 400 400 400 400 400 400 400 400 400 400 400 400 400 400 400 400 400 400 400 400 400 400 400 400 400 400 400 400 400 400 400 400 400 400
400 400 400 400 400 400 400 400 400 400 400 400 400 400 400 400 400 400 400 400 400 400 400 400 400 400 400 400 400 400 400 400 400 400 400
400 400 400 400 400 400 400 400 400 400 400 400 400 400 400 400 400 400 400 400 400 400 400 400 400 400 400 400 400 400 400 400 400 400 400
400 400 400 400 400 400 400 400 400 400 400 400 400 400 400 400 400 400 400 400 400 400 400 400 400 400 400 400 400 400 400 400 400 400 400
400 400 400 400 400 400 400 400 400 400 400 400 400 400 400 400 400 400 400 400 400 400 400 400 400 400 400 400 400 400 400 400 400 400 400
400 400 400 400 400 400 400 400 400 400 400 400 400 400 400 400 400 400 400 400 400 400 400 400 400 400 400 400 400 400 400 400 400 400 400
400 400 400 400 400 400 400 400 400 400 400 400 400 400 400 400 400 400 400 400 400 400 400 400 400 400 400 400 400 400 400 400 400 400 400
400 400 400 400 400 400 400 400 400 400 400 400 400 400 400 400 400 400 400 400 400 400 400 400 400 400 400 400 400 400 400 400 400 400 400
400 400 400 400 400 400 400 400 400 400 400 400 400 400 400 400 400 400 400 400 400 400 400 400 400 400 400 400 400 400 400 400 400 400 400
400 400 400 400 400 400 400 400 400 400 400 400 400 400 400 400 400 400 400 400 400 400 400 400 400 400 400 400 400 400 400 400 400 400 400
400 400 400 400 400 400 400 400 400 400 400 400 400 400 400 400 400 400 400 400 400 400 400 400 400 400 400 400 400 400 400 400 400 400 400
993 400 400 400 400 400 400 400 400 400 400 400 400 400 400 400 400 400 400 400 400 400 400 400 400 400 400 400 400 400 400 400 400 400 176>;
	synaptics,pt05_gap_y_b_ical = /bits/ 16 <
351 400 400 400 400 400 400 400 400 400 400 400 400 400 400 400 400 400 400 400 400 400 400 400 400 400 400 400 400 400 400 400 400 400 400 557
400 400 400 400 400 400 400 400 400 400 400 400 400 400 400 400 400 400 400 400 400 400 400 400 400 400 400 400 400 400 400 400 400 400 400 400
400 400 400 400 400 400 400 400 400 400 400 400 400 400 400 400 400 400 400 400 400 400 400 400 400 400 400 400 400 400 400 400 400 400 400 400
400 400 400 400 400 400 400 400 400 400 400 400 400 400 400 400 400 400 400 400 400 400 400 400 400 400 400 400 400 400 400 400 400 400 400 400
400 400 400 400 400 400 400 400 400 400 400 400 400 400 400 400 400 400 400 400 400 400 400 400 400 400 400 400 400 400 400 400 400 400 400 400
400 400 400 400 400 400 400 400 400 400 400 400 400 400 400 400 400 400 400 400 400 400 400 400 400 400 400 400 400 400 400 400 400 400 400 400
400 400 400 400 400 400 400 400 400 400 400 400 400 400 400 400 400 400 400 400 400 400 400 400 400 400 400 400 400 400 400 400 400 400 400 400
400 400 400 400 400 400 400 400 400 400 400 400 400 400 400 400 400 400 400 400 400 400 400 400 400 400 400 400 400 400 400 400 400 400 400 400
400 400 400 400 400 400 400 400 400 400 400 400 400 400 400 400 400 400 400 400 400 400 400 400 400 400 400 400 400 400 400 400 400 400 400 400
400 400 400 400 400 400 400 400 400 400 400 400 400 400 400 400 400 400 400 400 400 400 400 400 400 400 400 400 400 400 400 400 400 400 400 400
400 400 400 400 400 400 400 400 400 400 400 400 400 400 400 400 400 400 400 400 400 400 400 400 400 400 400 400 400 400 400 400 400 400 400 400
400 400 400 400 400 400 400 400 400 400 400 400 400 400 400 400 400 400 400 400 400 400 400 400 400 400 400 400 400 400 400 400 400 400 400 400
400 400 400 400 400 400 400 400 400 400 400 400 400 400 400 400 400 400 400 400 400 400 400 400 400 400 400 400 400 400 400 400 400 400 400 400
400 400 400 400 400 400 400 400 400 400 400 400 400 400 400 400 400 400 400 400 400 400 400 400 400 400 400 400 400 400 400 400 400 400 400 400
189 400 400 400 400 400 400 400 400 400 400 400 400 400 400 400 400 400 400 400 400 400 400 400 400 400 400 400 400 400 400 400 400 400 400 173>;

	synaptics,pt12_high_b_ical = <
264071 279905 283494 282022 280898 280434 280450 279179 278808 278578 277855 277564 278340 278609 278015 277435 277728 276460 286793 286375 286084 285544 285480 284563 285377 285102 285024 284560 284375 283691 283860 283596 283453 283218 281905 259043 605791 615326 616849 616376 616352 616944 616291 616769 625727 627593 628378 626902 626198 626929 626116 612734>;
	synaptics,pt12_low_b_ical = <
105628 111962 113397 112808 112358 112173 112179 111671 111522 111430 111142 111025 111335 111443 111206 110974 111090 110583 114717 114550 114433 114217 114191 113825 114150 114040 114009 113823 113750 113475 113543 113438 113381 113286 112762 103616 242316 246130 246739 246550 246540 246777 246516 246707 250290 251037 251350 250760 250479 250771 250446 245094>;

	synaptics,pt05_high_ical = /bits/ 16 <
600 840 840 840 840 840 840 840 840 840 840 840 840 840 840 840 840 840 840 840 840 840 840 840 840 840 840 840 840 840 840 840 840 840 840 300
840 840 840 840 840 840 840 840 840 840 840 840 840 840 840 840 840 840 840 840 840 840 840 840 840 840 840 840 840 840 840 840 840 840 840 840
840 840 840 840 840 840 840 840 840 840 840 840 840 840 840 840 840 840 840 840 840 840 840 840 840 840 840 840 840 840 840 840 840 840 840 840
840 840 840 840 840 840 840 840 840 840 840 840 840 840 840 840 840 840 840 840 840 840 840 840 840 840 840 840 840 840 840 840 840 840 840 840
840 840 840 840 840 840 840 840 840 840 840 840 840 840 840 840 840 840 840 840 840 840 840 840 840 840 840 840 840 840 840 840 840 840 840 840
840 840 840 840 840 840 840 840 840 840 840 840 840 840 840 840 840 840 840 840 840 840 840 840 840 840 840 840 840 840 840 840 840 840 840 840
840 840 840 840 840 840 840 840 840 840 840 840 840 840 840 840 840 840 840 840 840 840 840 840 840 840 840 840 840 840 840 840 840 840 840 840
840 840 840 840 840 840 840 840 840 840 840 840 840 840 840 840 840 840 840 840 840 840 840 840 840 840 840 840 840 840 840 840 840 840 840 840
840 840 840 840 840 840 840 840 840 840 840 840 840 840 840 840 840 840 840 840 840 840 840 840 840 840 840 840 840 840 840 840 840 840 840 840
840 840 840 840 840 840 840 840 840 840 840 840 840 840 840 840 840 840 840 840 840 840 840 840 840 840 840 840 840 840 840 840 840 840 840 840
840 840 840 840 840 840 840 840 840 840 840 840 840 840 840 840 840 840 840 840 840 840 840 840 840 840 840 840 840 840 840 840 840 840 840 840
840 840 840 840 840 840 840 840 840 840 840 840 840 840 840 840 840 840 840 840 840 840 840 840 840 840 840 840 840 840 840 840 840 840 840 840
840 840 840 840 840 840 840 840 840 840 840 840 840 840 840 840 840 840 840 840 840 840 840 840 840 840 840 840 840 840 840 840 840 840 840 840
840 840 840 840 840 840 840 840 840 840 840 840 840 840 840 840 840 840 840 840 840 840 840 840 840 840 840 840 840 840 840 840 840 840 840 840
840 840 840 840 840 840 840 840 840 840 840 840 840 840 840 840 840 840 840 840 840 840 840 840 840 840 840 840 840 840 840 840 840 840 840 840
300 840 840 840 840 840 840 840 840 840 840 840 840 840 840 840 840 840 840 840 840 840 840 840 840 840 840 840 840 840 840 840 840 840 840 600>;
	synaptics,pt05_low_ical = /bits/ 16 <
50 100 100 100 100 100 100 100 100 100 100 100 100 100 100 100 100 100 100 100 100 100 100 100 100 100 100 100 100 100 100 100 100 100 100 13
100 100 100 100 100 100 100 100 100 100 100 100 100 100 100 100 100 100 100 100 100 100 100 100 100 100 100 100 100 100 100 100 100 100 100 100
100 100 100 100 100 100 100 100 100 100 100 100 100 100 100 100 100 100 100 100 100 100 100 100 100 100 100 100 100 100 100 100 100 100 100 100
100 100 100 100 100 100 100 100 100 100 100 100 100 100 100 100 100 100 100 100 100 100 100 100 100 100 100 100 100 100 100 100 100 100 100 100
100 100 100 100 100 100 100 100 100 100 100 100 100 100 100 100 100 100 100 100 100 100 100 100 100 100 100 100 100 100 100 100 100 100 100 100
100 100 100 100 100 100 100 100 100 100 100 100 100 100 100 100 100 100 100 100 100 100 100 100 100 100 100 100 100 100 100 100 100 100 100 100
100 100 100 100 100 100 100 100 100 100 100 100 100 100 100 100 100 100 100 100 100 100 100 100 100 100 100 100 100 100 100 100 100 100 100 100
100 100 100 100 100 100 100 100 100 100 100 100 100 100 100 100 100 100 100 100 100 100 100 100 100 100 100 100 100 100 100 100 100 100 100 100
100 100 100 100 100 100 100 100 100 100 100 100 100 100 100 100 100 100 100 100 100 100 100 100 100 100 100 100 100 100 100 100 100 100 100 100
100 100 100 100 100 100 100 100 100 100 100 100 100 100 100 100 100 100 100 100 100 100 100 100 100 100 100 100 100 100 100 100 100 100 100 100
100 100 100 100 100 100 100 100 100 100 100 100 100 100 100 100 100 100 100 100 100 100 100 100 100 100 100 100 100 100 100 100 100 100 100 100
100 100 100 100 100 100 100 100 100 100 100 100 100 100 100 100 100 100 100 100 100 100 100 100 100 100 100 100 100 100 100 100 100 100 100 100
100 100 100 100 100 100 100 100 100 100 100 100 100 100 100 100 100 100 100 100 100 100 100 100 100 100 100 100 100 100 100 100 100 100 100 100
100 100 100 100 100 100 100 100 100 100 100 100 100 100 100 100 100 100 100 100 100 100 100 100 100 100 100 100 100 100 100 100 100 100 100 100
100 100 100 100 100 100 100 100 100 100 100 100 100 100 100 100 100 100 100 100 100 100 100 100 100 100 100 100 100 100 100 100 100 100 100 100
13 100 100 100 100 100 100 100 100 100 100 100 100 100 100 100 100 100 100 100 100 100 100 100 100 100 100 100 100 100 100 100 100 100 100 50>;
	synaptics,pt05_gap_x_ical = /bits/ 16 <
95 60 45 45 45 45 45 45 45 45 45 45 45 45 45 45 45 45 45 45 45 45 45 45 45 45 45 45 45 45 45 45 45 45 95 95
75 45 42 42 42 42 42 42 42 42 42 42 42 42 42 42 42 42 42 42 42 42 42 42 42 42 42 42 42 42 42 42 42 42 75 75
45 45 42 42 42 42 42 42 42 42 42 42 42 42 42 42 42 42 42 42 42 42 42 42 42 42 42 42 42 42 42 42 42 42 60 45
45 45 42 42 42 42 42 42 42 42 42 42 42 42 42 42 42 42 42 42 42 42 42 42 42 42 42 42 42 42 42 42 42 42 60 45
45 45 42 42 42 42 42 42 42 42 42 42 42 42 42 42 42 42 42 42 42 42 42 42 42 42 42 42 42 42 42 42 42 42 60 45
45 45 42 42 42 42 42 42 42 42 42 42 42 42 42 42 42 42 42 42 42 42 42 42 42 42 42 42 42 42 42 42 42 42 60 45
45 60 42 42 42 42 42 42 42 42 42 42 42 42 42 42 42 42 42 42 42 42 42 42 42 42 42 42 42 42 42 42 42 42 60 45
60 60 42 42 42 42 42 42 42 42 42 42 42 42 42 42 42 42 42 42 42 42 42 42 42 42 42 42 42 42 42 42 42 42 60 45
60 60 42 42 42 42 42 42 42 42 42 42 42 42 42 42 42 42 42 42 42 42 42 42 42 42 42 42 42 42 42 42 42 42 60 45
45 45 42 42 42 42 42 42 42 42 42 42 42 42 42 42 42 42 42 42 42 42 42 42 42 42 42 42 42 42 42 42 42 42 60 45
45 45 42 42 42 42 42 42 42 42 42 42 42 42 42 42 42 42 42 42 42 42 42 42 42 42 42 42 42 42 42 42 42 42 60 45
45 45 42 42 42 42 42 42 42 42 42 42 42 42 42 42 42 42 42 42 42 42 42 42 42 42 42 42 42 42 42 42 42 42 60 45
45 45 42 42 42 42 42 42 42 42 42 42 42 42 42 42 42 42 42 42 42 42 42 42 42 42 42 42 42 42 42 42 42 42 60 45
60 45 42 42 42 42 42 42 42 42 42 42 42 42 42 42 42 42 42 42 42 42 42 42 42 42 42 42 42 42 42 42 42 42 60 60
95 60 45 45 45 45 45 45 45 45 45 45 45 45 45 45 45 45 45 45 45 45 45 45 45 45 45 45 45 45 45 45 45 45 60 75
95 60 42 42 42 42 42 42 42 42 42 42 42 42 42 42 42 42 42 42 42 42 42 42 42 42 42 42 42 42 42 42 42 60 75 45>;
	synaptics,pt05_gap_y_ical = /bits/ 16 <
95 60 45 45 45 45 45 45 45 45 45 45 45 45 45 45 45 45 45 45 45 45 45 45 45 45 45 45 45 45 45 45 45 45 95 95
75 45 42 42 42 42 42 42 42 42 42 42 42 42 42 42 42 42 42 42 42 42 42 42 42 42 42 42 42 42 42 42 42 42 75 75
45 45 42 42 42 42 42 42 42 42 42 42 42 42 42 42 42 42 42 42 42 42 42 42 42 42 42 42 42 42 42 42 42 42 60 45
45 45 42 42 42 42 42 42 42 42 42 42 42 42 42 42 42 42 42 42 42 42 42 42 42 42 42 42 42 42 42 42 42 42 60 45
45 45 42 42 42 42 42 42 42 42 42 42 42 42 42 42 42 42 42 42 42 42 42 42 42 42 42 42 42 42 42 42 42 42 60 45
45 45 42 42 42 42 42 42 42 42 42 42 42 42 42 42 42 42 42 42 42 42 42 42 42 42 42 42 42 42 42 42 42 42 60 45
45 60 42 42 42 42 42 42 42 42 42 42 42 42 42 42 42 42 42 42 42 42 42 42 42 42 42 42 42 42 42 42 42 42 60 45
60 60 42 42 42 42 42 42 42 42 42 42 42 42 42 42 42 42 42 42 42 42 42 42 42 42 42 42 42 42 42 42 42 42 60 45
60 60 42 42 42 42 42 42 42 42 42 42 42 42 42 42 42 42 42 42 42 42 42 42 42 42 42 42 42 42 42 42 42 42 60 45
45 45 42 42 42 42 42 42 42 42 42 42 42 42 42 42 42 42 42 42 42 42 42 42 42 42 42 42 42 42 42 42 42 42 60 45
45 45 42 42 42 42 42 42 42 42 42 42 42 42 42 42 42 42 42 42 42 42 42 42 42 42 42 42 42 42 42 42 42 42 60 45
45 45 42 42 42 42 42 42 42 42 42 42 42 42 42 42 42 42 42 42 42 42 42 42 42 42 42 42 42 42 42 42 42 42 60 45
45 45 42 42 42 42 42 42 42 42 42 42 42 42 42 42 42 42 42 42 42 42 42 42 42 42 42 42 42 42 42 42 42 42 60 45
60 45 42 42 42 42 42 42 42 42 42 42 42 42 42 42 42 42 42 42 42 42 42 42 42 42 42 42 42 42 42 42 42 42 60 60
95 60 45 45 45 45 45 45 45 45 45 45 45 45 45 45 45 45 45 45 45 45 45 45 45 45 45 45 45 45 45 45 45 45 60 75
95 60 42 42 42 42 42 42 42 42 42 42 42 42 42 42 42 42 42 42 42 42 42 42 42 42 42 42 42 42 42 42 42 60 75 45>;

	synaptics,pt12_high_ical = <
312000 312000 312000 312000 312000 312000 312000 312000 312000 312000 312000 312000 312000 312000 312000 312000 312000 312000 312000 312000 312000 312000 312000 312000 312000 312000 312000 312000 312000 312000 312000 312000 312000 312000 312000 312000 456000 456000 456000 456000 456000 456000 456000 456000 456000 456000 456000 456000 456000 456000 456000 456000>;
	synaptics,pt12_low_ical = <
128000 128000 128000 128000 128000 128000 128000 128000 128000 128000 128000 128000 128000 128000 128000 128000 128000 128000 128000 128000 128000 128000 128000 128000 128000 128000 128000 128000 128000 128000 128000 128000 128000 128000 128000 128000 216000 216000 216000 216000 216000 216000 216000 216000 216000 216000 216000 216000 216000 216000 216000 216000>;

};
