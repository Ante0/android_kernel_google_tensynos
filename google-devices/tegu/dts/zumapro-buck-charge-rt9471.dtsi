// SPDX-License-Identifier: GPL-2.0-only
/*
 * Buck Charge config for rt9471.
 * Intended to be included into the approriate I2C bus.
 *
 * Copyright 2023 Google LLC
 */

rt_swchg: rt-swchg@5b {
	compatible = "richtek,swchg";
	reg = <0x5b>;
	status = "okay";

	rt,intr_gpio = <&max77779_sgpio 6 GPIO_ACTIVE_LOW>;
	rt,ceb_gpio = <&max77779_sgpio 7 GPIO_ACTIVE_LOW>;
	rt9471_gpio: rt9471_gpio {
		gpio-controller;
		#gpio-cells = <2>;
		ngpios = <1>;
	};
	rt9471 {
		charger_name = "rt9471";
		interrupt-names = "wdt", "chg_mivr", "vbus_gd",
				  "bc12_done", "detach", "vac_ov",
				  "otg_fault", "chg_rdy", "chg_done";
		ichg = <1000000>;		/* uA */
		aicr = <800000>;		/* uA */
		mivr = <4400000>;		/* uV */
		vac_ovp = <10900>;		/* mV */
		cv = <4200000>;			/* uV */
		ieoc = <200000>;		/* uA */
		safe-tmr = <10>;		/* hour */
		wdt = <40>;			/* sec */
		/*
		 * 0: MIVR register
		 * 1: MIVR = VBAT + 200mV
		 * 2: MIVR = VBAT + 250mV
		 * >= 3: MIVR = VBAT + 300mV
		 */
		mivr-track = <0>;
		en-safe-tmr;
		/* en-te; */
		/* en-jeita; */
		/* dis-i2c-tout; */
		en-qon-rst;
		/* auto-aicr; */
	};
};
