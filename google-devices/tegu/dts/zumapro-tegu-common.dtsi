// SPDX-License-Identifier: GPL-2.0-only
/*
 * Zuma24 board device tree source
 *
 * Copyright 2023 Google LLC
 */

#include "zumapro/zumapro-common.dtsi"
#include "zuma/gs101-faceauth-dma-heap.dtsi"

#include "zuma-tegu-battery-common.dtsi"
#include "zuma-tegu-camera-pmic.dtsi"
#include "zuma-tegu-charging-common.dtsi"
#include "zuma/zuma-ripcurrent-gsa-gsc.dtsi"
#include "zumapro/zumapro-board-cp-s5300-sit.dtsi"
#include "zuma-tegu-cp-s5300-thermal-zone.dtsi"
#include "zumapro/zumapro-board-bluetooth_wakectrl.dtsi"
#include "zuma-tegu-ese.dtsi"
#include "zuma-tegu-nfc.dtsi"
#include "zumapro-tegu-audio-common-tas2572.dtsi"
#include "zuma-tegu-common-touch.dtsi"
#include "zumapro/zumapro-board-pcie.dtsi"
#include "zumapro/zumapro-board-pcie-cp-s5300.dtsi"
#include "zumapro-tegu-haptics.dtsi"
#include "zuma-tegu-thermal.dtsi"
#include "zuma-tegu-usb.dtsi"
#include "zuma-tegu-typec.dtsi"
#include "zumapro-tegu-usecases.dtsi"
#include "zumapro-tegu-sbbm.dtsi"

#include "zuma-tegu-battery.dtsi"
#include "zuma-tegu-charging.dtsi"
#include "zumapro-tegu-wcharger.dtsi"
#include "zumapro-tegu-audio.dtsi"
#include "zuma-tegu-camera.dtsi"
#include "zuma-tegu-display.dtsi"
#include "zuma-tegu-ldaf.dtsi"
#include "zuma-tegu-touch.dtsi"
#include "zumapro-tegu-udfps.dtsi"
#include "zuma-tegu-wlan.dtsi"
#include "zumapro-tegu-bcl.dtsi"
#include "zumapro/zumapro-16kb-dma-heap.dtsi"
