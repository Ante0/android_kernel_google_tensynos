// SPDX-License-Identifier: GPL-2.0-only
/*
 * Usecases specific to Tegu Platform
 *
 * Copyright 2023 Google LLC
 *
 */

/* system use cases */
&max77779_chg {
	/* external boost */
	max77779,extbst-ctl = <&rt9471_gpio 0 GPIO_ACTIVE_HIGH>; /* RT9470 USB_OTG */

	/* for OTG related usecase*/
	max77779,rx-to-rx-otg-en; /* support RX -> RX+OTG */
	max77779,ext-otg-only; /* use external OTG only */
	max77779,wcin-inlim-headroom = <40000>;
	max77779,wlc_notify_charge_disable;
};
