// SPDX-License-Identifier: GPL-2.0-only
/*
 * Charging device tree entries for the Caimito platform
 *
 * Copyright 2023 Google LLC
 *
 */
#include "zuma/zuma-charging.dtsi"

&google_charger {
	google,thermal-mitigation =
	<5000000 4820000 4640000 4460000 4280000 4100000 3920000 3740000 3560000
	 3380000 3200000 3020000 2840000 2660000 2480000 2300000 2120000 1940000
	 1760000 1580000 1400000 1220000 1040000  860000  680000  500000>;

	google,wlc-thermal-mitigation =
	<1000000 975000 950000 925000 900000 875000 850000 825000 800000
	 775000 750000 725000 700000 675000 650000 625000 600000 575000
	 550000 525000 500000 475000 450000 425000 400000 400000>;

	// thermal budgets
	google,thermal-mitigation-budgets =
	<3710000 3571000 3443000 3297000 3162000 3040000 2918000 2810000 2703000
	 2598000 2493000 2330000 2200000 2080000 1968000 1865000 1770000 1684000
	 1595000 1506000 1444000 1382000 1351000 1320000 1273000 1225000>;
	google,wlc-thermal-mitigation-budgets =
	<3710000 3571000 3443000 3297000 3162000 3040000 2918000 2810000 2703000
	 2598000 2493000 2330000 2200000 2080000 1968000 1865000 1770000 1684000
	 1595000 1506000 1444000 1382000 1351000 1320000 1273000 1225000>;
	google,therm-wlc-overrides-fcc;
	google,thermal-stats-lvl-map = <0 2 5 8 11>;

	google,wlc-thermal-dc-fan-alarm = <2>;
};
