// SPDX-License-Identifier: GPL-2.0-only
/*
 * Tegu board device tree source
 *
 * Copyright 2023 Google LLC
 */

/dts-v1/;
/plugin/;

#include "zumapro-tegu-common-dev1.dtsi"
#include "zumapro/zumapro-phone-ignss.dtsi"
#include "zuma/max777xx-fwupdate.dtsi"

/ {
	board_id = <0x60b01>;
	board_rev = <0x010000>;
	fragment@boardbase {
		target-path = "/";
		__overlay__ {
			model = "ZUMA PRO TEGU DEV 1.0 on ZUMA PRO A0";
			compatible = "google,ZUMA PRO TEGU", "google,ZUMA PRO";
		};
	};
};
