// SPDX-License-Identifier: GPL-2.0-only
/*
 * Tegu board device tree source
 *
 * Copyright 2024 Google LLC
 */

/dts-v1/;
/plugin/;

#include "zumapro-tegu-common.dtsi"
#include "zuma/zuma-cp-s5400-phone-gnss.dtsi"
#include "zuma-tegu-gnss-samsung.dtsi"
#include "zuma/max777xx-fwupdate.dtsi"
#include "zumapro-tegu-odpm-proto.dtsi"

/ {
	board_id = <0x60b02>;
	board_rev = <0x010101>;
	fragment@boardbase {
		target-path = "/";
		__overlay__ {
			model = "ZUMA PRO TEGU PROTO 1.1 Wingboard based on ZUMA PRO";
			compatible = "google,ZUMA PRO TEGU", "google,ZUMA PRO";
		};
	};
};
